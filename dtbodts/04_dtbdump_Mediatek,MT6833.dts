/dts-v1/;

/ {
	compatible = "Mediatek,MT6833", "Samsung,A13x EUR OPEN 12";
	dtbo-hw_rev = <0xc>;
	dtbo-hw_rev_end = <0x20>;

	__fixups__ {
		accdet = "/fragment@9:target:0", "/fragment@78:target:0";
		aud_gpio_i2s3_off = "/fragment@79:target:0";
		auxadc = "/fragment@smd/__overlay__/samsung_mobile_device/battery:io-channels:0", "/fragment@smd/__overlay__/samsung_mobile_device/sec_thermistor@3:io-channels:0", "/fragment@smd/__overlay__/samsung_mobile_device/sec_thermistor@2:io-channels:0", "/fragment@smd/__overlay__/samsung_mobile_device/sec_thermistor@1:io-channels:0", "/fragment@smd/__overlay__/samsung_mobile_device/sec_thermistor@0:io-channels:0", "/fragment@14:target:0", "/fragment@15/__overlay__:io-channels:0";
		chosen = "/fragment@0:target:0";
		dispsys_config = "/fragment@7:target:0";
		dsi0 = "/fragment@8:target:0", "/fragment@90:target:0";
		flashlights_mt6360 = "/fragment@82:target:0";
		gpio = "/fragment@24:target:0";
		gpio_usage_mapping = "/fragment@23:target:0";
		gps = "/fragment@12:target:0";
		i2c0 = "/fragment@17:target:0";
		i2c1 = "/fragment@18:target:0";
		i2c2 = "/fragment@86:target:0";
		i2c3 = "/fragment@19:target:0", "/fragment@74:target:0";
		i2c4 = "/fragment@87:target:0";
		i2c5 = "/fragment@20:target:0";
		i2c6 = "/fragment@21:target:0", "/fragment@75:target:0", "/fragment@76:target:0";
		i2c7 = "/fragment@22:target:0", "/fragment@60:target:0", "/fragment@63:target:0";
		i2c8 = "/fragment@88:target:0";
		i2c9 = "/fragment@89:target:0";
		infracfg_ao = "/fragment@smd/__overlay__/samsung_mobile_device/etspi-spi@0:clocks:16";
		kd_camera_hw1 = "/fragment@31:target:0", "/fragment@85:target:0";
		keypad = "/fragment@33:target:0";
		md1_sim1_hot_plug_eint = "/fragment@28:target:0";
		md_auxadc = "/fragment@15:target:0";
		msdc1 = "/fragment@27:target:0", "/fragment@80:target:0";
		mt6360_ldo = "/fragment@4:target:0", "/fragment@81:target:0";
		mt6360_pmic = "/fragment@2:target:0";
		mt6360_pmu = "/fragment@1:target:0";
		mt6360_typec = "/fragment@3:target:0", "/fragment@83:target:0";
		mt_pmic_vcamio_ldo_reg = "/fragment@29:target:0";
		mt_pmic_vfp_ldo_reg = "/fragment@48:target:0", "/fragment@74/__overlay__/pn547@2B:nfc_pvdd-supply:0";
		mt_pmic_vibr_ldo_reg = "/fragment@smd/__overlay__/samsung_mobile_device/dc_vibrator:dc_vib-supply:0", "/fragment@50:target:0";
		mt_pmic_vio28_ldo_reg = "/fragment@67:target:0";
		mt_pmic_vtp_ldo_reg = "/fragment@30:target:0", "/fragment@32/__overlay__:vtouch-supply:0", "/fragment@49:target:0";
		mtkfb = "/fragment@6:target:0";
		odm = "/fragment@10:target:0";
		pio = "/fragment@smd/__overlay__/samsung_mobile_device/mtk-charger:charger,gpio_ilim:0", "/fragment@smd/__overlay__/samsung_mobile_device/mtk-charger:charger,gpio_chgenb:0", "/fragment@smd/__overlay__/samsung_mobile_device/mtk_battery:BatteryID_GPIO:0", "/fragment@smd/__overlay__/samsung_mobile_device/etspi-spi@0:etspi-sleepPin:0", "/fragment@smd/__overlay__/samsung_mobile_device/etspi-spi@0:etspi-drdyPin:0", "/fragment@smd/__overlay__/fixed_regulator_grip_ldo:gpio:0", "/fragment@smd/__overlay__/fixed_regulator_rcam1_dvdd_1p05_ldo:gpio:0", "/fragment@smd/__overlay__/fixed_regulator_rcam1_afvdd_2p8_ldo:gpio:0", "/fragment@smd/__overlay__/fixed_regulator_cam_vddio_1p8_ldo:gpio:0", "/fragment@smd/__overlay__/fixed_regulator_fcam_a2p8_ldo:gpio:0", "/fragment@model/__overlay__:dtbo-lcd_id_1:0", "/fragment@model/__overlay__:dtbo-lcd_id_2:0", "/fragment@model/__overlay__:dtbo-lcd_id_3:0", "/fragment@1/__overlay__:mt6360,intr_gpio:0", "/fragment@3/__overlay__:mt6360pd,intr_gpio:0", "/fragment@5:target:0", "/fragment@8/__overlay__/panel1@0:reset-gpios:0", "/fragment@8/__overlay__/panel1@0:bias-gpios:0", "/fragment@8/__overlay__/panel1@0:bias-gpios:12", "/fragment@11:target:0", "/fragment@23/__overlay__:GPIO_SIM1_HOT_PLUG:0", "/fragment@23/__overlay__:GPIO_SIM2_SCLK:0", "/fragment@23/__overlay__:GPIO_SIM2_SRST:0", "/fragment@23/__overlay__:GPIO_SIM2_SIO:0", "/fragment@23/__overlay__:GPIO_SIM1_SIO:0", "/fragment@23/__overlay__:GPIO_SIM1_SRST:0", "/fragment@23/__overlay__:GPIO_SIM1_SCLK:0", "/fragment@23/__overlay__:GPIO_RF_PWREN_RST_PIN:0", "/fragment@23/__overlay__:GPIO_FDD_BAND_SUPPORT_DETECT_1ST_PIN:0", "/fragment@25/__overlay__:interrupt-parent:0", "/fragment@26/__overlay__:interrupt-parent:0", "/fragment@34:target:0", "/fragment@35:target:0", "/fragment@36:target:0", "/fragment@37:target:0", "/fragment@38/__overlay__/novatek@2:novatek,reset-gpio:0", "/fragment@38/__overlay__/novatek@2:novatek,irq-gpio:0", "/fragment@38/__overlay__/novatek@2:novatek,lcdid1-gpio:0", "/fragment@38/__overlay__/novatek@2:novatek,lcdid2-gpio:0", "/fragment@38/__overlay__/novatek@2:novatek,lcdid3-gpio:0", "/fragment@39:target:0", "/fragment@41:target:0", "/fragment@42:target:0", "/fragment@43:target:0", "/fragment@44:target:0", "/fragment@45/__overlay__/ovt_tcm@1:ovt,irq-gpio:0", "/fragment@45/__overlay__/ovt_tcm@1:ovt,cs-gpio:0", "/fragment@45/__overlay__/ovt_tcm@1:ovt,lcdid1-gpio:0", "/fragment@45/__overlay__/ovt_tcm@1:ovt,lcdid2-gpio:0", "/fragment@45/__overlay__/ovt_tcm@1:ovt,lcdid3-gpio:0", "/fragment@46:target:0", "/fragment@51:target:0", "/fragment@52:target:0", "/fragment@53:target:0", "/fragment@54:target:0", "/fragment@55/__overlay__/himax_ts@0:himax,rst-gpio:0", "/fragment@55/__overlay__/himax_ts@0:himax,irq-gpio:0", "/fragment@55/__overlay__/himax_ts@0:himax,lcdid1-gpio:0", "/fragment@55/__overlay__/himax_ts@0:himax,lcdid2-gpio:0", "/fragment@55/__overlay__/himax_ts@0:himax,lcdid3-gpio:0", "/fragment@56:target:0", "/fragment@58:target:0", "/fragment@59:target:0", "/fragment@60/__overlay__:gpios:0", "/fragment@60/__overlay__:gpios:12", "/fragment@60/__overlay__/a96t396@20:interrupt-parent:0", "/fragment@60/__overlay__/a96t396@20:irq_gpio:0", "/fragment@60/__overlay__/a96t396@20:ldo_en:0", "/fragment@61:target:0", "/fragment@62:target:0", "/fragment@63/__overlay__:gpios:0", "/fragment@63/__overlay__:gpios:12", "/fragment@63/__overlay__/a96t396_sub@21:interrupt-parent:0", "/fragment@63/__overlay__/a96t396_sub@21:irq_gpio:0", "/fragment@63/__overlay__/a96t396_sub@21:ldo_en:0", "/fragment@64:target:0", "/fragment@65:target:0", "/fragment@66:target:0", "/fragment@68:target:0", "/fragment@69:target:0", "/fragment@70:target:0", "/fragment@71:target:0", "/fragment@72:target:0", "/fragment@73:target:0", "/fragment@74/__overlay__/pn547@2B:interrupt-parent:0", "/fragment@74/__overlay__/pn547@2B:pn547,irq-gpio:0", "/fragment@74/__overlay__/pn547@2B:pn547,ven-gpio:0", "/fragment@74/__overlay__/pn547@2B:pn547,firm-gpio:0", "/fragment@74/__overlay__/pn547@2B:pn547,clk_req-gpio:0", "/fragment@74/__overlay__/pn547@2B:pn547,nfc-det-gpio:0", "/fragment@76/__overlay__/aw88230_amp@34:irq-gpio:0", "/fragment@84:target:0", "/fragment@lcd/__overlay__/lcd_fixed_regulator/__gpio_lcd_rst:gpio:0", "/fragment@lcd/__overlay__/lcd_fixed_regulator/__gpio_lcd_bl_en:gpio:0", "/fragment@lcd/__overlay__/smcdsd_board_td4160:gpio_con:0", "/fragment@lcd/__overlay__/smcdsd_board_nt36525c:gpio_con:0";
		pmic_clock_buffer_ctrl = "/fragment@16:target:0";
		sound = "/fragment@77:target:0";
		spi1 = "/fragment@38:target:0", "/fragment@40:target:0", "/fragment@45:target:0", "/fragment@47:target:0", "/fragment@55:target:0", "/fragment@57:target:0";
		subpmic_pmu_eint = "/fragment@25:target:0";
		tboard_thermistor1 = "/fragment@13:target:0";
		topckgen = "/fragment@smd/__overlay__/samsung_mobile_device/etspi-spi@0:clocks:0", "/fragment@smd/__overlay__/samsung_mobile_device/etspi-spi@0:clocks:8";
		touch = "/fragment@26:target:0", "/fragment@32:target:0";
	};

	__local_fixups__ {

		fragment@12 {

			__overlay__ {
				pinctrl-0 = <0x0>;
				pinctrl-1 = <0x0>;
				pinctrl-2 = <0x0>;
				pinctrl-3 = <0x0>;
				pinctrl-4 = <0x0>;
				pinctrl-5 = <0x0>;
				pinctrl-6 = <0x0>;
			};
		};

		fragment@38 {

			__overlay__ {

				novatek@2 {
					pinctrl-0 = <0x0 0x4 0x8 0xc 0x10 0x14 0x18 0x1c 0x20>;
					pinctrl-1 = <0x0 0x4 0x8 0xc 0x10 0x14 0x18 0x1c 0x20>;
					pinctrl-2 = <0x0 0x4 0x8 0xc 0x10 0x14 0x18 0x1c 0x20>;
				};
			};
		};

		fragment@45 {

			__overlay__ {

				ovt_tcm@1 {
					pinctrl-0 = <0x0 0x4 0x8 0xc 0x10 0x14 0x18 0x1c 0x20>;
					pinctrl-1 = <0x0 0x4 0x8 0xc 0x10 0x14 0x18 0x1c 0x20>;
					pinctrl-2 = <0x0 0x4 0x8 0xc 0x10 0x14 0x18 0x1c 0x20>;
				};
			};
		};

		fragment@55 {

			__overlay__ {

				himax_ts@0 {
					pinctrl-0 = <0x0 0x4 0x8 0xc 0x10 0x14 0x18 0x1c 0x20>;
					pinctrl-1 = <0x0 0x4 0x8 0xc 0x10 0x14 0x18 0x1c 0x20>;
					pinctrl-2 = <0x0 0x4 0x8 0xc 0x10 0x14 0x18 0x1c>;
				};
			};
		};

		fragment@6 {

			__overlay__ {
				pinctrl-0 = <0x0>;
				pinctrl-1 = <0x0>;
				pinctrl-2 = <0x0>;
				pinctrl-3 = <0x0>;
				pinctrl-4 = <0x0>;
				pinctrl-5 = <0x0>;
				pinctrl-6 = <0x0>;
			};
		};

		fragment@60 {

			__overlay__ {
				pinctrl-0 = <0x0 0x4>;

				a96t396@20 {
					pinctrl-0 = <0x0>;
				};
			};
		};

		fragment@63 {

			__overlay__ {
				pinctrl-0 = <0x0 0x4>;

				a96t396_sub@21 {
					pinctrl-0 = <0x0>;
				};
			};
		};

		fragment@7 {

			__overlay__ {
				pinctrl-0 = <0x0>;
				pinctrl-1 = <0x0>;
				pinctrl-2 = <0x0>;
			};
		};

		fragment@74 {

			__overlay__ {

				pn547@2B {
					pinctrl-0 = <0x0 0x4 0x8 0xc 0x10 0x14>;
					pinctrl-1 = <0x0 0x4 0x8 0xc 0x10>;
					pinctrl-2 = <0x0>;
				};
			};
		};

		fragment@77 {

			__overlay__ {

				mediatek,speaker-codec {
					sound-dai = <0x0>;
				};
			};
		};

		fragment@8 {

			__overlay__ {

				panel1@0 {

					port {

						endpoint {
							remote-endpoint = <0x0>;
						};
					};
				};

				ports {

					port {

						endpoint {
							remote-endpoint = <0x0>;
						};
					};
				};
			};
		};

		fragment@85 {

			__overlay__ {
				pinctrl-0 = <0x0>;
				pinctrl-1 = <0x0>;
				pinctrl-10 = <0x0>;
				pinctrl-11 = <0x0>;
				pinctrl-12 = <0x0>;
				pinctrl-13 = <0x0>;
				pinctrl-14 = <0x0>;
				pinctrl-15 = <0x0>;
				pinctrl-16 = <0x0>;
				pinctrl-17 = <0x0>;
				pinctrl-18 = <0x0>;
				pinctrl-19 = <0x0>;
				pinctrl-2 = <0x0>;
				pinctrl-20 = <0x0>;
				pinctrl-21 = <0x0>;
				pinctrl-22 = <0x0>;
				pinctrl-23 = <0x0>;
				pinctrl-24 = <0x0>;
				pinctrl-25 = <0x0>;
				pinctrl-26 = <0x0>;
				pinctrl-27 = <0x0>;
				pinctrl-28 = <0x0>;
				pinctrl-29 = <0x0>;
				pinctrl-3 = <0x0>;
				pinctrl-30 = <0x0>;
				pinctrl-31 = <0x0>;
				pinctrl-32 = <0x0>;
				pinctrl-33 = <0x0>;
				pinctrl-34 = <0x0>;
				pinctrl-35 = <0x0>;
				pinctrl-36 = <0x0>;
				pinctrl-37 = <0x0>;
				pinctrl-38 = <0x0>;
				pinctrl-39 = <0x0>;
				pinctrl-4 = <0x0>;
				pinctrl-40 = <0x0>;
				pinctrl-41 = <0x0>;
				pinctrl-42 = <0x0>;
				pinctrl-43 = <0x0>;
				pinctrl-44 = <0x0>;
				pinctrl-45 = <0x0>;
				pinctrl-46 = <0x0>;
				pinctrl-47 = <0x0>;
				pinctrl-48 = <0x0>;
				pinctrl-49 = <0x0>;
				pinctrl-5 = <0x0>;
				pinctrl-50 = <0x0>;
				pinctrl-51 = <0x0>;
				pinctrl-52 = <0x0>;
				pinctrl-53 = <0x0>;
				pinctrl-54 = <0x0>;
				pinctrl-6 = <0x0>;
				pinctrl-7 = <0x0>;
				pinctrl-8 = <0x0>;
				pinctrl-9 = <0x0>;
			};
		};

		fragment@lcd {

			__overlay__ {

				nt36525c_sharp {
					smcdsd_board = <0x0>;
					vrr_info = <0x0 0x4>;
				};

				panel {
					smcdsd_panel = <0x0>;
				};

				td4160_boe {
					smcdsd_board = <0x0>;
					vrr_info = <0x0 0x4>;
				};
			};
		};

		fragment@smd {

			__overlay__ {

				samsung_mobile_device {

					etspi-spi@0 {
						pinctrl-0 = <0x0 0x4>;
						pinctrl-1 = <0x0 0x4 0x8 0xc>;
						pinctrl-2 = <0x0 0x4 0x8 0xc 0x10>;
						pinctrl-3 = <0x0>;
						pinctrl-4 = <0x0>;
					};
				};
			};
		};
	};

	__symbols__ {
		__gpio_lcd_bl_en = "/fragment@lcd/__overlay__/lcd_fixed_regulator/__gpio_lcd_bl_en";
		__gpio_lcd_rst = "/fragment@lcd/__overlay__/lcd_fixed_regulator/__gpio_lcd_rst";
		__nt36525c_sharp_90 = "/fragment@lcd/__overlay__/__nt36525c_sharp_90";
		__td4160_boe_90 = "/fragment@lcd/__overlay__/__td4160_boe_90";
		a96t396 = "/fragment@60/__overlay__/a96t396@20";
		a96t396_sub = "/fragment@63/__overlay__/a96t396_sub@21";
		aw88230_amp = "/fragment@76/__overlay__/aw88230_amp@34";
		bat_gm30 = "/fragment@smd/__overlay__/samsung_mobile_device/mtk_battery";
		btp_irq = "/fragment@64/__overlay__/btp-irq";
		btp_irq_sleep = "/fragment@64/__overlay__/btp-irq-sleep";
		btp_sleep = "/fragment@65/__overlay__/btp_sleep_enable";
		camera0_mclk_2mA = "/fragment@84/__overlay__/camera0_mclk_2mA@gpio49";
		camera0_mclk_4mA = "/fragment@84/__overlay__/camera0_mclk_4mA@gpio49";
		camera0_mclk_6mA = "/fragment@84/__overlay__/camera0_mclk_6mA@gpio49";
		camera0_mclk_8mA = "/fragment@84/__overlay__/camera0_mclk_8mA@gpio49";
		camera0_mclk_off = "/fragment@84/__overlay__/camera0_mclk_gpio_mode@gpio49";
		camera0_rst_high = "/fragment@84/__overlay__/camera0_rst_output_high@gpio54";
		camera0_rst_low = "/fragment@84/__overlay__/camera0_rst_output_low@gpio54";
		camera0_vcama_off = "/fragment@84/__overlay__/camera0_vcama_output_low@gpio20";
		camera0_vcama_on = "/fragment@84/__overlay__/camera0_vcama_output_high@gpio20";
		camera0_vcamaf_off = "/fragment@84/__overlay__/camera0_vcamaf_output_low@gpio11";
		camera0_vcamaf_on = "/fragment@84/__overlay__/camera0_vcamaf_output_high@gpio11";
		camera0_vcamd_off = "/fragment@84/__overlay__/camera0_vcamd_output_low@gpio53";
		camera0_vcamd_on = "/fragment@84/__overlay__/camera0_vcamd_output_high@gpio53";
		camera1_mclk_2mA = "/fragment@84/__overlay__/camera1_mclk_2mA@gpio52";
		camera1_mclk_4mA = "/fragment@84/__overlay__/camera1_mclk_4mA@gpio52";
		camera1_mclk_6mA = "/fragment@84/__overlay__/camera1_mclk_6mA@gpio52";
		camera1_mclk_8mA = "/fragment@84/__overlay__/camera1_mclk_8mA@gpio52";
		camera1_mclk_off = "/fragment@84/__overlay__/camera1_mclk_gpio_mode@gpio52";
		camera1_rst_high = "/fragment@84/__overlay__/camera1_rst_output_high@gpio55";
		camera1_rst_low = "/fragment@84/__overlay__/camera1_rst_output_low@gpio55";
		camera1_vcama_off = "/fragment@84/__overlay__/camera1_vcama_output_low@gpio59";
		camera1_vcama_on = "/fragment@84/__overlay__/camera1_vcama_output_high@gpio59";
		camera1_vcamd_off = "/fragment@84/__overlay__/camera1_vcamd_output_low@gpio57";
		camera1_vcamd_on = "/fragment@84/__overlay__/camera1_vcamd_output_high@gpio57";
		camera2_mclk_2mA = "/fragment@84/__overlay__/camera2_mclk_2mA@gpio50";
		camera2_mclk_4mA = "/fragment@84/__overlay__/camera2_mclk_4mA@gpio50";
		camera2_mclk_6mA = "/fragment@84/__overlay__/camera2_mclk_6mA@gpio50";
		camera2_mclk_8mA = "/fragment@84/__overlay__/camera2_mclk_8mA@gpio50";
		camera2_mclk_off = "/fragment@84/__overlay__/camera2_mclk_gpio_mode@gpio50";
		camera2_rst_high = "/fragment@84/__overlay__/camera2_rst_output_high@gpio58";
		camera2_rst_low = "/fragment@84/__overlay__/camera2_rst_output_low@gpio58";
		camera2_vcama_off = "/fragment@84/__overlay__/camera2_vcama_output_low@gpio22";
		camera2_vcama_on = "/fragment@84/__overlay__/camera2_vcama_output_high@gpio22";
		camera2_vcamd_off = "/fragment@84/__overlay__/camera2_vcamd_output_low@gpio21";
		camera2_vcamd_on = "/fragment@84/__overlay__/camera2_vcamd_output_high@gpio21";
		camera3_mclk_2mA = "/fragment@84/__overlay__/camera3_mclk_2mA@gpio51";
		camera3_mclk_4mA = "/fragment@84/__overlay__/camera3_mclk_4mA@gpio51";
		camera3_mclk_6mA = "/fragment@84/__overlay__/camera3_mclk_6mA@gpio51";
		camera3_mclk_8mA = "/fragment@84/__overlay__/camera3_mclk_8mA@gpio51";
		camera3_mclk_off = "/fragment@84/__overlay__/camera3_mclk_gpio_mode@gpio51";
		camera3_rst_high = "/fragment@84/__overlay__/camera3_rst_output_high@gpio56";
		camera3_rst_low = "/fragment@84/__overlay__/camera3_rst_output_low@gpio56";
		camera3_vcama_off = "/fragment@84/__overlay__/camera3_vcama_output_low@gpio22";
		camera3_vcama_on = "/fragment@84/__overlay__/camera3_vcama_output_high@gpio22";
		camera3_vcamd_off = "/fragment@84/__overlay__/camera3_vcamd_output_low@gpio21";
		camera3_vcamd_on = "/fragment@84/__overlay__/camera3_vcamd_output_high@gpio21";
		camera_main_af_mtk = "/fragment@89/__overlay__/camera_main_af@18";
		camera_main_mtk = "/fragment@86/__overlay__/camera_main@5A";
		camera_main_two_mtk = "/fragment@88/__overlay__/camera_main_two@6E";
		camera_pins_default = "/fragment@84/__overlay__/camdefault";
		camera_sub_mtk = "/fragment@87/__overlay__/camera_sub@6E";
		camera_sub_two_mtk = "/fragment@88/__overlay__/camera_sub_two@20";
		camera_vcamio_off = "/fragment@84/__overlay__/camera_vcamio_output_low@gpio131";
		camera_vcamio_on = "/fragment@84/__overlay__/camera_vcamio_output_high@gpio131";
		clk_req_nc = "/fragment@70/__overlay__/clk_req_nc";
		dsi_out = "/fragment@8/__overlay__/ports/port/endpoint";
		firm_nc = "/fragment@69/__overlay__/firm_nc";
		gps_l1_lna_pins_dsp_ctrl = "/fragment@11/__overlay__/gps_l1_lna@1";
		gps_l1_lna_pins_oh = "/fragment@11/__overlay__/gps_l1_lna@2";
		gps_l1_lna_pins_ol = "/fragment@11/__overlay__/gps_l1_lna@0";
		gps_l5_lna_pins_dsp_ctrl = "/fragment@11/__overlay__/gps_l5_lna@1";
		gps_l5_lna_pins_oh = "/fragment@11/__overlay__/gps_l5_lna@2";
		gps_l5_lna_pins_ol = "/fragment@11/__overlay__/gps_l5_lna@0";
		gps_pins_default = "/fragment@11/__overlay__/gps_default";
		grip_i2c_scl = "/fragment@58/__overlay__/grip-i2c-scl";
		grip_i2c_sda = "/fragment@58/__overlay__/grip-i2c-sda";
		grip_int = "/fragment@59/__overlay__/grip-int";
		grip_sub_i2c_scl = "/fragment@61/__overlay__/grip-sub-i2c-scl";
		grip_sub_i2c_sda = "/fragment@61/__overlay__/grip-sub-i2c-sda";
		grip_sub_int = "/fragment@62/__overlay__/grip-sub-int";
		himax_default_miso = "/fragment@54/__overlay__/himax_default_miso";
		himax_tsp_id1_default = "/fragment@56/__overlay__/himax_tsp_id1_default";
		himax_tsp_id2_default = "/fragment@56/__overlay__/himax_tsp_id2_default";
		himax_tsp_id3_default = "/fragment@56/__overlay__/himax_tsp_id3_default";
		himax_tsp_intr_off = "/fragment@51/__overlay__/himax_tsp_intr_off";
		himax_tsp_intr_on = "/fragment@51/__overlay__/himax_tsp_intr_on";
		himax_tsp_off_clk = "/fragment@54/__overlay__/himax_tsp_off_clk";
		himax_tsp_off_cs = "/fragment@53/__overlay__/himax_tsp_off_cs";
		himax_tsp_off_miso = "/fragment@54/__overlay__/himax_tsp_off_miso";
		himax_tsp_off_mosi = "/fragment@54/__overlay__/himax_tsp_off_mosi";
		himax_tsp_on_clk = "/fragment@54/__overlay__/himax_tsp_on_clk";
		himax_tsp_on_cs = "/fragment@53/__overlay__/himax_tsp_on_cs";
		himax_tsp_on_miso = "/fragment@54/__overlay__/himax_tsp_on_miso";
		himax_tsp_on_mosi = "/fragment@54/__overlay__/himax_tsp_on_mosi";
		himax_tsp_reset_off = "/fragment@52/__overlay__/himax_tsp_reset_off";
		himax_tsp_reset_on = "/fragment@52/__overlay__/himax_tsp_reset_on";
		i2c_lcd_bias_mtk = "/fragment@17/__overlay__/i2c_lcd_bias@11";
		irq_nc = "/fragment@71/__overlay__/irq_nc";
		lcd_fixed_regulator = "/fragment@lcd/__overlay__/lcd_fixed_regulator";
		led0 = "/fragment@10/__overlay__/led@0";
		led1 = "/fragment@10/__overlay__/led@1";
		led2 = "/fragment@10/__overlay__/led@2";
		led3 = "/fragment@10/__overlay__/led@3";
		led4 = "/fragment@10/__overlay__/led@4";
		led5 = "/fragment@10/__overlay__/led@5";
		led6 = "/fragment@10/__overlay__/led@6";
		mtk_camera_eeprom0 = "/fragment@89/__overlay__/camera_eeprom0@B0";
		mtk_camera_eeprom1 = "/fragment@89/__overlay__/camera_eeprom1@6E";
		mtk_camera_eeprom2 = "/fragment@88/__overlay__/camera_eeprom2@A2";
		mtk_camera_eeprom3 = "/fragment@89/__overlay__/camera_eeprom3@A4";
		mtk_charger = "/fragment@smd/__overlay__/samsung_mobile_device/mtk-charger";
		mtkfb_pins_lcd_bias_enn0 = "/fragment@5/__overlay__/lcd_bias_enn0_gpio";
		mtkfb_pins_lcd_bias_enn1 = "/fragment@5/__overlay__/lcd_bias_enn1_gpio";
		mtkfb_pins_lcd_bias_enp0 = "/fragment@5/__overlay__/lcd_bias_enp0_gpio";
		mtkfb_pins_lcd_bias_enp1 = "/fragment@5/__overlay__/lcd_bias_enp1_gpio";
		mtkfb_pins_lcm_dsi_te = "/fragment@5/__overlay__/lcm_dsi_te";
		mtkfb_pins_lcm_rst_out0_gpio = "/fragment@5/__overlay__/lcm_rst_out0_gpio";
		mtkfb_pins_lcm_rst_out1_gpio = "/fragment@5/__overlay__/lcm_rst_out1_gpio";
		nfc_check = "/fragment@73/__overlay__/nfc_check";
		nfc_clk_req = "/fragment@70/__overlay__/nfc_clk_req";
		nfc_firm = "/fragment@69/__overlay__/nfc_firm";
		nfc_i2c_off = "/fragment@72/__overlay__/nfc_i2c_off";
		nfc_i2c_on = "/fragment@72/__overlay__/nfc_i2c_on";
		nfc_irq = "/fragment@71/__overlay__/nfc_irq";
		nfc_mtk = "/fragment@19/__overlay__/nfc@08";
		nfc_ven = "/fragment@68/__overlay__/nfc_ven";
		nt36523_default_miso = "/fragment@37/__overlay__/nt36523_default_miso";
		nt36523_tsp_id1_default = "/fragment@39/__overlay__/nt36523_tsp_id1_default";
		nt36523_tsp_id2_default = "/fragment@39/__overlay__/nt36523_tsp_id2_default";
		nt36523_tsp_id3_default = "/fragment@39/__overlay__/nt36523_tsp_id3_default";
		nt36523_tsp_intr_off = "/fragment@34/__overlay__/nt36523_tsp_intr_off";
		nt36523_tsp_intr_on = "/fragment@34/__overlay__/nt36523_tsp_intr_on";
		nt36523_tsp_off_clk = "/fragment@37/__overlay__/nt36523_tsp_off_clk";
		nt36523_tsp_off_cs = "/fragment@36/__overlay__/nt36523_tsp_off_cs";
		nt36523_tsp_off_miso = "/fragment@37/__overlay__/nt36523_tsp_off_miso";
		nt36523_tsp_off_mosi = "/fragment@37/__overlay__/nt36523_tsp_off_mosi";
		nt36523_tsp_on_clk = "/fragment@37/__overlay__/nt36523_tsp_on_clk";
		nt36523_tsp_on_cs = "/fragment@36/__overlay__/nt36523_tsp_on_cs";
		nt36523_tsp_on_miso = "/fragment@37/__overlay__/nt36523_tsp_on_miso";
		nt36523_tsp_on_mosi = "/fragment@37/__overlay__/nt36523_tsp_on_mosi";
		nt36523_tsp_reset_off = "/fragment@35/__overlay__/nt36523_tsp_reset_off";
		nt36523_tsp_reset_on = "/fragment@35/__overlay__/nt36523_tsp_reset_on";
		nt36525c_sharp = "/fragment@lcd/__overlay__/nt36525c_sharp";
		ovt_tsp_id1_default = "/fragment@46/__overlay__/ovt_tsp_id1_default";
		ovt_tsp_id2_default = "/fragment@46/__overlay__/ovt_tsp_id2_default";
		ovt_tsp_id3_default = "/fragment@46/__overlay__/ovt_tsp_id3_default";
		ovt_tsp_int_off = "/fragment@41/__overlay__/ovt_tsp_int_off";
		ovt_tsp_int_on = "/fragment@41/__overlay__/ovt_tsp_int_on";
		ovt_tsp_off_clk = "/fragment@44/__overlay__/ovt_tsp_off_clk";
		ovt_tsp_off_cs = "/fragment@43/__overlay__/ovt_tsp_off_cs";
		ovt_tsp_off_miso = "/fragment@44/__overlay__/ovt_tsp_off_miso";
		ovt_tsp_off_mosi = "/fragment@44/__overlay__/ovt_tsp_off_mosi";
		ovt_tsp_on_clk = "/fragment@44/__overlay__/ovt_tsp_on_clk";
		ovt_tsp_on_cs = "/fragment@43/__overlay__/ovt_tsp_on_cs";
		ovt_tsp_on_miso = "/fragment@44/__overlay__/ovt_tsp_on_miso";
		ovt_tsp_on_mosi = "/fragment@44/__overlay__/ovt_tsp_on_mosi";
		ovt_tsp_reset_off = "/fragment@42/__overlay__/ovt_tsp_reset_off";
		ovt_tsp_reset_on = "/fragment@42/__overlay__/ovt_tsp_reset_on";
		panel_in = "/fragment@8/__overlay__/panel1@0/port/endpoint";
		sec_ap_thermistor = "/fragment@smd/__overlay__/samsung_mobile_device/sec_thermistor@0";
		sec_battery = "/fragment@smd/__overlay__/samsung_mobile_device/battery";
		sec_battery_cable = "/fragment@smd/__overlay__/samsung_mobile_device/cable-info";
		sec_cp_thermistor = "/fragment@smd/__overlay__/samsung_mobile_device/sec_thermistor@2";
		sec_pa_thermistor = "/fragment@smd/__overlay__/samsung_mobile_device/sec_thermistor@1";
		sec_wf_thermistor = "/fragment@smd/__overlay__/samsung_mobile_device/sec_thermistor@3";
		smcdsd_board_nt36525c = "/fragment@lcd/__overlay__/smcdsd_board_nt36525c";
		smcdsd_board_td4160 = "/fragment@lcd/__overlay__/smcdsd_board_td4160";
		smd = "/fragment@smd/__overlay__/samsung_mobile_device";
		speaker_amp = "/fragment@75/__overlay__/speaker_amp@34";
		spi5_clr_clk = "/fragment@66/__overlay__/clr_clk";
		spi5_clr_cs = "/fragment@66/__overlay__/clr_cs";
		spi5_clr_miso = "/fragment@66/__overlay__/clr_miso";
		spi5_clr_mosi = "/fragment@66/__overlay__/clr_mosi";
		spi5_set_clk = "/fragment@66/__overlay__/set_clk";
		spi5_set_cs = "/fragment@66/__overlay__/set_cs";
		spi5_set_miso = "/fragment@66/__overlay__/set_miso";
		spi5_set_mosi = "/fragment@66/__overlay__/set_mosi";
		subpmic_ldo_mtk = "/fragment@20/__overlay__/subpmic_ldo@64";
		subpmic_mtk = "/fragment@20/__overlay__/subpmic@34";
		subpmic_pmic_mtk = "/fragment@20/__overlay__/subpmic_pmic@1a";
		td4160_boe = "/fragment@lcd/__overlay__/td4160_boe";
		tsp_himax = "/fragment@55/__overlay__/himax_ts@0";
		tsp_novatek = "/fragment@38/__overlay__/novatek@2";
		tsp_ovt = "/fragment@45/__overlay__/ovt_tcm@1";
		usb_tuning = "/fragment@model/__overlay__/usb_tuning";
		usb_type_c_mtk = "/fragment@20/__overlay__/usb_type_c@4e";
		ven_nc = "/fragment@68/__overlay__/ven_nc";
		vib_info = "/fragment@smd/__overlay__/samsung_mobile_device/vibrator_info";
		vibrator0 = "/fragment@10/__overlay__/vibrator@0";
	};

	fragment@0 {
		target = <0xffffffff>;

		__overlay__ {
			atag,videolfb-fb_base_h = <0x0>;
			atag,videolfb-fb_base_l = "~`P";
			atag,videolfb-fps = <0x1770>;
			atag,videolfb-islcm_inited = <0x0>;
			atag,videolfb-islcmfound = <0x1>;
			atag,videolfb-lcmname = "nt35595_fhd_dsi_cmd_truly_nt50358_drv";
			atag,videolfb-vramSize = <0x1be0000>;
		};
	};

	fragment@1 {
		target = <0xffffffff>;

		__overlay__ {
			disable_lpsd = <0x1>;
			mt6360,intr_gpio = <0xffffffff 0xa 0x0>;
			mt6360,intr_gpio_num = <0xa>;
		};
	};

	fragment@10 {
		target = <0xffffffff>;

		__overlay__ {

			led@0 {
				compatible = "mediatek,red";
				data = <0x1>;
				led_mode = <0x0>;
				phandle = <0x9c>;
				pwm_config = <0x0 0x0 0x0 0x0 0x0>;
			};

			led@1 {
				compatible = "mediatek,green";
				data = <0x1>;
				led_mode = <0x0>;
				phandle = <0x9d>;
				pwm_config = <0x0 0x0 0x0 0x0 0x0>;
			};

			led@2 {
				compatible = "mediatek,blue";
				data = <0x1>;
				led_mode = <0x0>;
				phandle = <0x9e>;
				pwm_config = <0x0 0x0 0x0 0x0 0x0>;
			};

			led@3 {
				compatible = "mediatek,jogball-backlight";
				data = <0x1>;
				led_mode = <0x0>;
				phandle = <0x9f>;
				pwm_config = <0x0 0x0 0x0 0x0 0x0>;
			};

			led@4 {
				compatible = "mediatek,keyboard-backlight";
				data = <0x1>;
				led_mode = <0x0>;
				phandle = <0xa0>;
				pwm_config = <0x0 0x0 0x0 0x0 0x0>;
			};

			led@5 {
				compatible = "mediatek,button-backlight";
				data = <0x1>;
				led_mode = <0x0>;
				phandle = <0xa1>;
				pwm_config = <0x0 0x0 0x0 0x0 0x0>;
			};

			led@6 {
				compatible;
				data = <0x1>;
				led_mode = <0x5>;
				phandle = <0xa2>;
				pwm_config = <0x0 0x1 0x0 0x0 0x0>;
			};

			vibrator@0 {
				compatible = "mediatek,vibrator";
				phandle = <0xa3>;
				vib_limit = <0x9>;
				vib_timer = <0x19>;
				vib_vol = <0x9>;
			};
		};
	};

	fragment@11 {
		target = <0xffffffff>;

		__overlay__ {

			gps_default {
				phandle = <0x15>;
			};

			gps_l1_lna@0 {
				phandle = <0x16>;

				pins_cmd_dat {
					output-low;
					pinmux = <0x5700>;
				};
			};

			gps_l1_lna@1 {
				phandle = <0x17>;

				pins_cmd_dat {
					pinmux = <0x5702>;
				};
			};

			gps_l1_lna@2 {
				phandle = <0x18>;

				pins_cmd_dat {
					output-high;
					pinmux = <0x5700>;
				};
			};

			gps_l5_lna@0 {
				phandle = <0x19>;

				pins_cmd_dat {
					output-low;
					pinmux = <0x5b00>;
				};
			};

			gps_l5_lna@1 {
				phandle = <0x1a>;

				pins_cmd_dat {
					pinmux = <0x5b04>;
				};
			};

			gps_l5_lna@2 {
				phandle = <0x1b>;

				pins_cmd_dat {
					output-high;
					pinmux = <0x5b00>;
				};
			};
		};
	};

	fragment@12 {
		target = <0xffffffff>;

		__overlay__ {
			pinctrl-0 = <0x15>;
			pinctrl-1 = <0x16>;
			pinctrl-2 = <0x17>;
			pinctrl-3 = <0x18>;
			pinctrl-4 = <0x19>;
			pinctrl-5 = <0x1a>;
			pinctrl-6 = <0x1b>;
			pinctrl-names = "default", "gps_l1_lna_disable", "gps_l1_lna_dsp_ctrl", "gps_l1_lna_enable", "gps_l5_lna_disable", "gps_l5_lna_dsp_ctrl", "gps_l5_lna_enable";
			status = "okay";
		};
	};

	fragment@13 {
		target = <0xffffffff>;

		__overlay__ {
			fixed_thermal;
		};
	};

	fragment@14 {
		target = <0xffffffff>;

		__overlay__ {

			adc_channel@ {
				compatible = "mediatek,adc_channel";
				mediatek,adc_fdd_rf_params_dynamic_custom_ch = <0x6>;
				mediatek,board_id = <0x3>;
				mediatek,board_id_2 = <0x4>;
				mediatek,temperature0 = <0x0>;
				mediatek,temperature1 = <0x1>;
				status = "okay";
			};
		};
	};

	fragment@15 {
		target = <0xffffffff>;

		__overlay__ {
			io-channels = <0xffffffff 0x6>;
		};
	};

	fragment@16 {
		target = <0xffffffff>;

		__overlay__ {
			mediatek,clkbuf-config = <0x2 0x1 0x1 0x2 0x0 0x0 0x1>;
			mediatek,clkbuf-controls-for-desense = <0x0 0x4 0x0 0x4 0x0 0x0 0x0>;
			mediatek,clkbuf-output-impedance = <0x6 0x4 0x4 0x4 0x0 0x0 0x4>;
			mediatek,clkbuf-quantity = <0x7>;
			status = "okay";
		};
	};

	fragment@17 {
		target = <0xffffffff>;

		__overlay__ {
			#address-cells = <0x1>;
			#size-cells = <0x0>;
			clock-frequency = <0x61a80>;
			mediatek,use-open-drain;

			i2c_lcd_bias@11 {
				compatible = "mediatek,i2c_lcd_bias";
				phandle = <0xa4>;
				reg = <0x11>;
				status = "okay";
			};
		};
	};

	fragment@18 {
		target = <0xffffffff>;

		__overlay__ {
			#address-cells = <0x1>;
			#size-cells = <0x0>;
			clock-frequency = <0x61a80>;
			mediatek,use-open-drain;
		};
	};

	fragment@19 {
		target = <0xffffffff>;

		__overlay__ {
			#address-cells = <0x1>;
			#size-cells = <0x0>;
			clock-frequency = <0x61a80>;
			mediatek,use-open-drain;

			nfc@08 {
				compatible = "mediatek,nfc";
				phandle = <0xa5>;
				reg = <0x8>;
				status = "okay";
			};
		};
	};

	fragment@2 {
		target = <0xffffffff>;

		__overlay__ {
			pwr_off_seq = <0x4000002>;
		};
	};

	fragment@20 {
		target = <0xffffffff>;

		__overlay__ {
			#address-cells = <0x1>;
			#size-cells = <0x0>;
			clock-frequency = <0x33e140>;
			mediatek,use-push-pull;

			subpmic@34 {
				compatible = "mediatek,subpmic";
				phandle = <0xa6>;
				reg = <0x34>;
				status = "okay";
			};

			subpmic_ldo@64 {
				compatible = "mediatek,subpmic_ldo";
				phandle = <0xa9>;
				reg = <0x64>;
				status = "okay";
			};

			subpmic_pmic@1a {
				compatible = "mediatek,subpmic_pmic";
				phandle = <0xa8>;
				reg = <0x1a>;
				status = "okay";
			};

			usb_type_c@4e {
				compatible = "mediatek,usb_type_c";
				phandle = <0xa7>;
				reg = <0x4e>;
				status = "okay";
			};
		};
	};

	fragment@21 {
		target = <0xffffffff>;

		__overlay__ {
			#address-cells = <0x1>;
			#size-cells = <0x0>;
			clock-frequency = <0x61a80>;
			mediatek,use-open-drain;
		};
	};

	fragment@22 {
		target = <0xffffffff>;

		__overlay__ {
			#address-cells = <0x1>;
			#size-cells = <0x0>;
			clock-frequency = <0x61a80>;
			mediatek,use-open-drain;
		};
	};

	fragment@23 {
		target = <0xffffffff>;

		__overlay__ {
			GPIO_FDD_BAND_SUPPORT_DETECT_1ST_PIN = <0xffffffff 0xb4 0x0>;
			GPIO_RF_PWREN_RST_PIN = <0xffffffff 0xaa 0x0>;
			GPIO_SIM1_HOT_PLUG = <0xffffffff 0x4d 0x0>;
			GPIO_SIM1_SCLK = <0xffffffff 0x7c 0x0>;
			GPIO_SIM1_SIO = <0xffffffff 0x7a 0x0>;
			GPIO_SIM1_SRST = <0xffffffff 0x7b 0x0>;
			GPIO_SIM2_SCLK = <0xffffffff 0x77 0x0>;
			GPIO_SIM2_SIO = <0xffffffff 0x79 0x0>;
			GPIO_SIM2_SRST = <0xffffffff 0x78 0x0>;
		};
	};

	fragment@24 {
		target = <0xffffffff>;

		__overlay__ {
			gpio_init_default = <0x0 0x0 0x0 0x0 0x1 0x0 0x1 0x1 0x0 0x0 0x0 0x1 0x0 0x1 0x2 0x0 0x0 0x0 0x0 0x0 0x1 0x3 0x0 0x0 0x0 0x0 0x0 0x1 0x4 0x0 0x0 0x0 0x0 0x0 0x1 0x5 0x0 0x0 0x0 0x0 0x0 0x1 0x6 0x0 0x0 0x0 0x1 0x0 0x0 0x7 0x0 0x1 0x1 0x1 0x0 0x1 0x8 0x7 0x0 0x0 0x1 0x0 0x1 0x9 0x0 0x0 0x0 0x1 0x1 0x1 0xa 0x0 0x0 0x0 0x1 0x1 0x1 0xb 0x0 0x1 0x0 0x1 0x0 0x1 0xc 0x0 0x0 0x0 0x0 0x0 0x1 0xd 0x0 0x0 0x0 0x0 0x0 0x1 0xe 0x0 0x0 0x0 0x0 0x0 0x1 0xf 0x0 0x0 0x0 0x1 0x1 0x1 0x10 0x0 0x0 0x0 0x0 0x0 0x1 0x11 0x0 0x0 0x0 0x0 0x0 0x1 0x12 0x0 0x0 0x0 0x1 0x0 0x1 0x13 0x0 0x0 0x0 0x0 0x0 0x1 0x14 0x0 0x1 0x0 0x1 0x0 0x1 0x15 0x0 0x1 0x0 0x1 0x0 0x1 0x16 0x0 0x1 0x0 0x1 0x0 0x1 0x17 0x7 0x0 0x0 0x1 0x0 0x1 0x18 0x7 0x0 0x0 0x1 0x0 0x1 0x19 0x7 0x0 0x0 0x1 0x0 0x1 0x1a 0x7 0x0 0x0 0x1 0x0 0x1 0x1b 0x1 0x0 0x0 0x0 0x0 0x1 0x1c 0x1 0x0 0x0 0x0 0x0 0x1 0x1d 0x1 0x0 0x0 0x0 0x0 0x1 0x1e 0x1 0x0 0x0 0x1 0x0 0x1 0x1f 0x2 0x0 0x0 0x0 0x0 0x1 0x20 0x2 0x0 0x0 0x0 0x0 0x1 0x21 0x2 0x0 0x0 0x0 0x0 0x1 0x22 0x2 0x0 0x0 0x1 0x0 0x1 0x23 0x1 0x0 0x0 0x0 0x0 0x1 0x24 0x1 0x0 0x0 0x0 0x0 0x1 0x25 0x1 0x0 0x0 0x0 0x0 0x1 0x26 0x1 0x0 0x0 0x1 0x0 0x1 0x27 0x0 0x0 0x0 0x1 0x0 0x1 0x28 0x0 0x0 0x0 0x0 0x0 0x1 0x29 0x1 0x0 0x0 0x0 0x0 0x1 0x2a 0x1 0x0 0x0 0x1 0x0 0x1 0x2b 0x1 0x0 0x0 0x0 0x0 0x1 0x2c 0x0 0x0 0x0 0x1 0x0 0x1 0x2d 0x0 0x0 0x0 0x0 0x2 0x0 0x2e 0x0 0x0 0x0 0x1 0x0 0x1 0x2f 0x0 0x0 0x0 0x1 0x0 0x1 0x30 0x0 0x1 0x0 0x1 0x0 0x1 0x31 0x1 0x1 0x0 0x0 0x0 0x1 0x32 0x1 0x1 0x0 0x0 0x0 0x1 0x33 0x1 0x1 0x0 0x0 0x0 0x1 0x34 0x1 0x1 0x0 0x0 0x0 0x1 0x35 0x0 0x1 0x0 0x1 0x0 0x1 0x36 0x0 0x1 0x0 0x1 0x0 0x1 0x37 0x0 0x1 0x0 0x1 0x0 0x1 0x38 0x0 0x1 0x0 0x1 0x0 0x1 0x39 0x0 0x1 0x0 0x1 0x0 0x1 0x3a 0x0 0x1 0x0 0x1 0x0 0x1 0x3b 0x0 0x1 0x0 0x1 0x0 0x1 0x3c 0x0 0x0 0x0 0x1 0x0 0x1 0x3d 0x1 0x0 0x0 0x1 0x1 0x1 0x3e 0x1 0x0 0x0 0x0 0x0 0x1 0x3f 0x0 0x0 0x0 0x1 0x0 0x0 0x40 0x0 0x0 0x0 0x1 0x0 0x0 0x4d 0x1 0x0 0x0 0x0 0x0 0x1 0x4e 0x0 0x0 0x0 0x1 0x0 0x1 0x4f 0x1 0x0 0x0 0x1 0x1 0x1 0x50 0x1 0x0 0x0 0x1 0x1 0x1 0x51 0x3 0x0 0x0 0x1 0x0 0x1 0x52 0x0 0x0 0x0 0x1 0x0 0x1 0x53 0x1 0x0 0x0 0x0 0x0 0x1 0x54 0x0 0x0 0x0 0x1 0x0 0x1 0x55 0x0 0x0 0x0 0x1 0x0 0x1 0x56 0x0 0x1 0x0 0x0 0x2 0x0 0x57 0x2 0x0 0x0 0x1 0x0 0x1 0x58 0x0 0x0 0x0 0x1 0x0 0x0 0x59 0x0 0x0 0x0 0x1 0x0 0x0 0x5a 0x0 0x0 0x0 0x1 0x0 0x0 0x5b 0x0 0x0 0x0 0x1 0x0 0x0 0x5c 0x0 0x0 0x0 0x1 0x0 0x0 0x5d 0x0 0x0 0x0 0x1 0x0 0x0 0x5e 0x0 0x0 0x0 0x1 0x0 0x1 0x5f 0x1 0x0 0x0 0x1 0x0 0x1 0x60 0x1 0x0 0x0 0x1 0x0 0x1 0x61 0x1 0x0 0x0 0x1 0x1 0x1 0x62 0x1 0x0 0x0 0x1 0x1 0x1 0x63 0x2 0x0 0x0 0x1 0x1 0x1 0x64 0x2 0x0 0x0 0x1 0x1 0x1 0x65 0x1 0x0 0x0 0x1 0x1 0x1 0x66 0x1 0x0 0x0 0x1 0x1 0x1 0x67 0x1 0x0 0x0 0x1 0x1 0x1 0x68 0x1 0x0 0x0 0x1 0x1 0x1 0x69 0x1 0x0 0x0 0x1 0x1 0x1 0x6a 0x1 0x0 0x0 0x1 0x1 0x1 0x6b 0x1 0x0 0x0 0x1 0x1 0x1 0x6c 0x1 0x0 0x0 0x1 0x1 0x1 0x6d 0x1 0x0 0x0 0x1 0x1 0x1 0x6e 0x1 0x0 0x0 0x1 0x1 0x1 0x6f 0x1 0x0 0x0 0x1 0x1 0x1 0x70 0x1 0x0 0x0 0x1 0x1 0x1 0x71 0x1 0x0 0x0 0x1 0x1 0x1 0x72 0x1 0x0 0x0 0x1 0x1 0x1 0x73 0x1 0x0 0x0 0x0 0x0 0x1 0x74 0x1 0x0 0x0 0x0 0x0 0x1 0x75 0x0 0x0 0x0 0x1 0x0 0x0 0x76 0x0 0x0 0x0 0x1 0x0 0x1 0x77 0x1 0x0 0x0 0x0 0x0 0x1 0x78 0x1 0x0 0x0 0x0 0x0 0x1 0x79 0x1 0x0 0x0 0x1 0x1 0x1 0x7a 0x1 0x0 0x0 0x1 0x1 0x1 0x7b 0x1 0x0 0x0 0x0 0x0 0x1 0x7c 0x1 0x0 0x0 0x0 0x0 0x1 0x7d 0x1 0x0 0x0 0x0 0x0 0x1 0x7e 0x1 0x0 0x0 0x1 0x1 0x1 0x7f 0x1 0x0 0x0 0x1 0x1 0x1 0x80 0x1 0x0 0x0 0x1 0x1 0x1 0x81 0x1 0x0 0x0 0x1 0x1 0x1 0x82 0x1 0x0 0x0 0x1 0x1 0x1 0x83 0x0 0x1 0x0 0x1 0x0 0x1 0x84 0x0 0x0 0x0 0x1 0x0 0x1 0x85 0x1 0x0 0x0 0x1 0x0 0x1 0x86 0x1 0x0 0x0 0x1 0x0 0x1 0x87 0x0 0x1 0x0 0x1 0x0 0x1 0x88 0x0 0x1 0x0 0x1 0x0 0x1 0x89 0x0 0x0 0x0 0x0 0x0 0x1 0x8a 0x0 0x1 0x0 0x0 0x2 0x0 0x8b 0x0 0x1 0x0 0x1 0x0 0x1 0x8c 0x0 0x1 0x0 0x1 0x0 0x1 0x8d 0x1 0x0 0x0 0x1 0x1 0x1 0x8e 0x1 0x0 0x0 0x1 0x1 0x1 0x8f 0x1 0x0 0x0 0x0 0x0 0x1 0x90 0x1 0x0 0x0 0x0 0x0 0x1 0x91 0x1 0x0 0x0 0x0 0x0 0x1 0x92 0x1 0x0 0x0 0x0 0x0 0x1 0x93 0x1 0x0 0x0 0x0 0x0 0x1 0x94 0x1 0x0 0x0 0x0 0x0 0x1 0x95 0x1 0x0 0x0 0x1 0x0 0x1 0x96 0x1 0x0 0x0 0x1 0x0 0x1 0x97 0x1 0x0 0x0 0x1 0x0 0x1 0x98 0x1 0x0 0x0 0x1 0x0 0x1 0x99 0x1 0x0 0x0 0x0 0x0 0x1 0x9a 0x1 0x0 0x0 0x0 0x0 0x1 0x9b 0x1 0x0 0x0 0x0 0x0 0x1 0x9c 0x0 0x0 0x0 0x1 0x0 0x0 0x9d 0x1 0x0 0x0 0x0 0x0 0x1 0x9e 0x1 0x0 0x0 0x0 0x0 0x1 0x9f 0x1 0x0 0x0 0x1 0x0 0x1 0xa0 0x1 0x0 0x0 0x1 0x0 0x1 0xa1 0x0 0x0 0x0 0x1 0x0 0x0 0xa2 0x0 0x0 0x0 0x1 0x0 0x0 0xa3 0x0 0x0 0x0 0x1 0x0 0x0 0xa4 0x1 0x0 0x0 0x1 0x0 0x1 0xa5 0x1 0x0 0x0 0x1 0x0 0x1 0xa6 0x0 0x0 0x0 0x0 0x0 0x0 0xa7 0x0 0x0 0x0 0x0 0x0 0x0 0xa8 0x1 0x0 0x0 0x1 0x0 0x1 0xa9 0x1 0x0 0x0 0x1 0x0 0x1 0xaa 0x0 0x1 0x1 0x0 0x0 0x1 0xab 0x0 0x1 0x0 0x1 0x0 0x1 0xac 0x0 0x0 0x0 0x0 0x2 0x0 0xad 0x0 0x0 0x0 0x0 0x2 0x0 0xae 0x0 0x0 0x0 0x0 0x2 0x0 0xaf 0x1 0x0 0x0 0x1 0x0 0x1 0xb0 0x1 0x0 0x0 0x1 0x0 0x1 0xb1 0x1 0x0 0x0 0x1 0x0 0x1 0xb2 0x1 0x0 0x0 0x1 0x0 0x1 0xb3 0x1 0x0 0x0 0x1 0x0 0x1 0xb4 0x0 0x0 0x0 0x0 0x0 0x0 0xb5 0x0 0x0 0x0 0x1 0x0 0x1 0xb6 0x0 0x0 0x0 0x1 0x0 0x1 0xb7 0x0 0x0 0x0 0x1 0x0 0x1 0xb8 0x0 0x0 0x0 0x1 0x0 0x1 0xb9 0x0 0x0 0x0 0x1 0x0 0x1 0xba 0x0 0x0 0x0 0x1 0x0 0x1 0xbb 0x0 0x0 0x0 0x1 0x0 0x1 0xbc 0x1 0x0 0x0 0x0 0x0 0x0 0xbd 0x1 0x0 0x0 0x1 0x0 0x0 0xbe 0x1 0x0 0x0 0x0 0x0 0x0 0xbf 0x1 0x0 0x0 0x1 0x0 0x0 0xc0 0x1 0x0 0x0 0x1 0x0 0x1 0xc1 0x1 0x0 0x0 0x1 0x0 0x1 0xc2 0x1 0x0 0x0 0x1 0x0 0x1 0xc3 0x1 0x0 0x0 0x1 0x0 0x1 0xc4 0x1 0x0 0x0 0x1 0x0 0x1 0xc5 0x1 0x0 0x0 0x1 0x0 0x1 0xc6 0x1 0x0 0x0 0x1 0x0 0x1 0xc7 0x1 0x0 0x0 0x1 0x0 0x1 0xc8 0x1 0x0 0x0 0x1 0x0 0x1>;
		};
	};

	fragment@25 {
		target = <0xffffffff>;

		__overlay__ {
			interrupt-parent = <0xffffffff>;
			interrupts = <0xa 0x2>;
			status = "okay";
		};
	};

	fragment@26 {
		target = <0xffffffff>;

		__overlay__ {
			interrupt-parent = <0xffffffff>;
			interrupts = <0xe 0x8>;
			status = "okay";
		};
	};

	fragment@27 {
		target = <0xffffffff>;

		__overlay__ {
			cd_level = [01];
		};
	};

	fragment@28 {
		target = <0xffffffff>;

		__overlay__ {
			compatible = "mediatek,md1_sim1_hot_plug_eint-eint";
			debounce = <0x0 0xc350>;
			dedicated = <0x0 0x0>;
			interrupts = <0x0 0x8>;
			sockettype = <0x0 0x0>;
			src_pin = <0x0 0x1>;
			status = "okay";
		};
	};

	fragment@29 {
		target = <0xffffffff>;

		__overlay__ {
			regulator-default-on = <0x1>;
			regulator-name = "vcamio";
			status = "okay";
		};
	};

	fragment@3 {
		target = <0xffffffff>;

		__overlay__ {
			mt6360pd,intr_gpio = <0xffffffff 0x9 0x0>;
			mt6360pd,intr_gpio_num = <0x9>;
		};
	};

	fragment@30 {
		target = <0xffffffff>;

		__overlay__ {
			regulator-default-on = <0x1>;
			regulator-name = "vtp";
			status = "okay";
		};
	};

	fragment@31 {
		target = <0xffffffff>;

		__overlay__ {
			status = "okay";
		};
	};

	fragment@32 {
		target = <0xffffffff>;

		__overlay__ {
			status = "okay";
			vtouch-supply = <0xffffffff>;
		};
	};

	fragment@33 {
		target = <0xffffffff>;

		__overlay__ {
			mediatek,kpd-hw-dl-key2 = <0x8>;
			mediatek,kpd-hw-init-map = <0x0 0x73 0x0 0x0 0x0 0x0 0x0 0x0 0x0 0x0 0x0 0x0 0x0 0x0 0x0 0x0 0x0 0x0 0x0 0x0 0x0 0x0 0x0 0x0 0x0 0x0 0x0 0x0 0x0 0x0 0x0 0x0 0x0 0x0 0x0 0x0 0x0 0x0 0x0 0x0 0x0 0x0 0x0 0x0 0x0 0x0 0x0 0x0 0x0 0x0 0x0 0x0 0x0 0x0 0x0 0x0 0x0 0x0 0x0 0x0 0x0 0x0 0x0 0x0 0x0 0x0 0x0 0x0 0x0 0x0 0x0 0x0>;
			mediatek,kpd-hw-map-num = <0x48>;
			mediatek,kpd-hw-pwrkey = <0x8>;
			mediatek,kpd-hw-rstkey = <0x11>;
			mediatek,kpd-key-debounce = <0x400>;
			mediatek,kpd-pwkey-gpio-din = <0x0>;
			mediatek,kpd-pwrkey-eint-gpio = <0x0>;
			mediatek,kpd-sw-pwrkey = <0x74>;
			mediatek,kpd-sw-rstkey = <0x72>;
			mediatek,kpd-use-extend-type = <0x0>;
			status = "okay";
		};
	};

	fragment@34 {
		target = <0xffffffff>;

		__overlay__ {

			nt36523_tsp_intr_off {
				phandle = <0x25>;

				pins_cmd_dat {
					bias-pull-down;
					input-enable;
					pinmux = <0xe00>;
					slew-rate = <0x0>;
				};
			};

			nt36523_tsp_intr_on {
				phandle = <0x1c>;

				pins_cmd_dat {
					bias-disable;
					pinmux = <0xe00>;
					slew-rate = <0x0>;
				};
			};
		};
	};

	fragment@35 {
		target = <0xffffffff>;

		__overlay__ {

			nt36523_tsp_reset_off {
				phandle = <0x26>;

				pins_cmd_dat {
					bias-disable;
					output-low;
					pinmux = <0x700>;
					slew-rate = <0x1>;
				};
			};

			nt36523_tsp_reset_on {
				phandle = <0x1d>;

				pins_cmd_dat {
					bias-disable;
					output-high;
					pinmux = <0x700>;
					slew-rate = <0x1>;
				};
			};
		};
	};

	fragment@36 {
		target = <0xffffffff>;

		__overlay__ {

			nt36523_tsp_off_cs {
				phandle = <0x27>;

				pins_cmd_dat {
					bias-disable;
					output-low;
					pinmux = <0x1c00>;
					slew-rate = <0x1>;
				};
			};

			nt36523_tsp_on_cs {
				phandle = <0x1e>;

				pins_cmd_dat {
					bias-disable;
					pinmux = <0x1c01>;
				};
			};
		};
	};

	fragment@37 {
		target = <0xffffffff>;

		__overlay__ {

			nt36523_default_miso {
				phandle = <0xaa>;

				pins_cmd_dat {
					bias-disable;
					output-low;
					pinmux = <0x1e00>;
					slew-rate = <0x0>;
				};
			};

			nt36523_tsp_off_clk {
				phandle = <0x28>;

				pins_cmd_dat {
					bias-disable;
					output-low;
					pinmux = <0x1b00>;
					slew-rate = <0x1>;
				};
			};

			nt36523_tsp_off_miso {
				phandle = <0x2a>;

				pins_cmd_dat {
					bias-pull-down;
					input-enable;
					pinmux = <0x1e00>;
					slew-rate = <0x0>;
				};
			};

			nt36523_tsp_off_mosi {
				phandle = <0x29>;

				pins_cmd_dat {
					bias-disable;
					output-low;
					pinmux = <0x1d00>;
					slew-rate = <0x1>;
				};
			};

			nt36523_tsp_on_clk {
				phandle = <0x1f>;

				pins_cmd_dat {
					bias-disable;
					pinmux = <0x1b01>;
				};
			};

			nt36523_tsp_on_miso {
				phandle = <0x21>;

				pins_cmd_dat {
					bias-disable;
					pinmux = <0x1e01>;
				};
			};

			nt36523_tsp_on_mosi {
				phandle = <0x20>;

				pins_cmd_dat {
					bias-disable;
					pinmux = <0x1d01>;
				};
			};
		};
	};

	fragment@38 {
		target = <0xffffffff>;

		__overlay__ {
			#address-cells = <0x1>;
			#size-cells = <0x0>;
			num-cs = <0x1>;
			status = "okay";

			novatek@2 {
				compatible = "novatek,NVT-ts-spi";
				novatek,enable_settings_aot;
				novatek,enable_sysinput_enabled;
				novatek,fw_name = "", "", "", "tsp_novatek/nt36525c_a13x_boe.bin", "", "", "tsp_novatek/nt36525c_a13x_sharp.bin";
				novatek,fw_name_mp = "", "", "", "tsp_novatek/nt36525c_a13x_mp_boe.bin", "", "", "tsp_novatek/nt36525c_a13x_mp_sharp.bin";
				novatek,irq-gpio = <0xffffffff 0xe 0x2002>;
				novatek,lcdid = <0x3 0x6>;
				novatek,lcdid1-gpio = <0xffffffff 0xac 0x0>;
				novatek,lcdid2-gpio = <0xffffffff 0xad 0x0>;
				novatek,lcdid3-gpio = <0xffffffff 0xae 0x0>;
				novatek,lcdtype = <0x0 0x0 0x0 0x2a6244 0x0 0x0 0x2af244>;
				novatek,mp-support-dt;
				novatek,name_lcd_bl_en = "gpio_lcd_bl_en";
				novatek,name_lcd_rst = "gpio_lcd_rst";
				novatek,name_lcd_vddi = "vcamio";
				novatek,prox_lp_scan_enabled;
				novatek,reset-gpio = <0xffffffff 0x7 0x0>;
				novatek,resolution = <0x2d0 0x640>;
				novatek,spi-rd-fast-addr = <0x3f310>;
				novatek,support_ear_detect_mode;
				novatek,swrst-n8-addr = <0x3f0fe>;
				phandle = <0xab>;
				pinctrl-0 = <0x1c 0x1d 0x1e 0x1f 0x20 0x21 0x22 0x23 0x24>;
				pinctrl-1 = <0x1c 0x1d 0x1e 0x1f 0x20 0x21 0x22 0x23 0x24>;
				pinctrl-2 = <0x25 0x26 0x27 0x28 0x29 0x2a 0x22 0x23 0x24>;
				pinctrl-names = "default", "on_state", "off_state";
				reg = <0x2>;
				spi-max-frequency = <0x927c00>;
				status = "okay";
			};
		};
	};

	fragment@39 {
		target = <0xffffffff>;

		__overlay__ {

			nt36523_tsp_id1_default {
				phandle = <0x22>;

				pins_cmd_dat {
					bias-disable;
					input-enable;
					pinmux = <0xac00>;
					slew-rate = <0x0>;
				};
			};

			nt36523_tsp_id2_default {
				phandle = <0x23>;

				pins_cmd_dat {
					bias-disable;
					input-enable;
					pinmux = <0xad00>;
					slew-rate = <0x0>;
				};
			};

			nt36523_tsp_id3_default {
				phandle = <0x24>;

				pins_cmd_dat {
					bias-disable;
					input-enable;
					pinmux = <0xae00>;
					slew-rate = <0x0>;
				};
			};
		};
	};

	fragment@4 {
		target = <0xffffffff>;

		__overlay__ {
			sdcard_hlact = <0x0>;
		};
	};

	fragment@40 {
		target = <0xffffffff>;

		__overlay__ {
			num-cs = <0x3>;
		};
	};

	fragment@41 {
		target = <0xffffffff>;

		__overlay__ {

			ovt_tsp_int_off {
				phandle = <0x34>;

				pins_cmd_dat {
					bias-pull-down;
					input-enable;
					pinmux = <0xe00>;
					slew-rate = <0x0>;
				};
			};

			ovt_tsp_int_on {
				phandle = <0x2b>;

				pins_cmd_dat {
					bias-disable;
					pinmux = <0xe00>;
					slew-rate = <0x0>;
				};
			};
		};
	};

	fragment@42 {
		target = <0xffffffff>;

		__overlay__ {

			ovt_tsp_reset_off {
				phandle = <0x35>;

				pins_cmd_dat {
					bias-disable;
					output-low;
					pinmux = <0x700>;
					slew-rate = <0x1>;
				};
			};

			ovt_tsp_reset_on {
				phandle = <0x2c>;

				pins_cmd_dat {
					bias-disable;
					output-high;
					pinmux = <0x700>;
					slew-rate = <0x1>;
				};
			};
		};
	};

	fragment@43 {
		target = <0xffffffff>;

		__overlay__ {

			ovt_tsp_off_cs {
				phandle = <0x37>;

				pins_cmd_dat {
					bias-disable;
					output-low;
					pinmux = <0x1c00>;
					slew-rate = <0x1>;
				};
			};

			ovt_tsp_on_cs {
				phandle = <0x2e>;

				pins_cmd_dat {
					bias-disable;
					pinmux = <0x1c01>;
				};
			};
		};
	};

	fragment@44 {
		target = <0xffffffff>;

		__overlay__ {

			ovt_tsp_off_clk {
				phandle = <0x39>;

				pins_cmd_dat {
					bias-disable;
					output-low;
					pinmux = <0x1b00>;
					slew-rate = <0x1>;
				};
			};

			ovt_tsp_off_miso {
				phandle = <0x36>;

				pins_cmd_dat {
					bias-pull-down;
					input-enable;
					pinmux = <0x1e00>;
					slew-rate = <0x0>;
				};
			};

			ovt_tsp_off_mosi {
				phandle = <0x38>;

				pins_cmd_dat {
					bias-disable;
					output-low;
					pinmux = <0x1d00>;
					slew-rate = <0x1>;
				};
			};

			ovt_tsp_on_clk {
				phandle = <0x30>;

				pins_cmd_dat {
					bias-disable;
					pinmux = <0x1b01>;
				};
			};

			ovt_tsp_on_miso {
				phandle = <0x2d>;

				pins_cmd_dat {
					bias-disable;
					pinmux = <0x1e01>;
				};
			};

			ovt_tsp_on_mosi {
				phandle = <0x2f>;

				pins_cmd_dat {
					bias-disable;
					pinmux = <0x1d01>;
				};
			};
		};
	};

	fragment@45 {
		target = <0xffffffff>;

		__overlay__ {
			#address-cells = <0x1>;
			#size-cells = <0x0>;
			num-cs = <0x1>;
			status = "okay";

			ovt_tcm@1 {
				compatible = "ovt,tcm-spi";
				ovt,area-size = <0x30 0x51 0x1e>;
				ovt,block-delay-us = <0x0>;
				ovt,byte-delay-us = <0x0>;
				ovt,cs-gpio = <0xffffffff 0x1c 0x0>;
				ovt,enable_settings_aot;
				ovt,enable_sysinput_enabled;
				ovt,fw_name = "tsp_ovt/td4160_a13x_boe.bin";
				ovt,irq-gpio = <0xffffffff 0xe 0x2008>;
				ovt,irq-on-state = <0x0>;
				ovt,lcdid = <0x0>;
				ovt,lcdid1-gpio = <0xffffffff 0xac 0x0>;
				ovt,lcdid2-gpio = <0xffffffff 0xad 0x0>;
				ovt,lcdid3-gpio = <0xffffffff 0xae 0x0>;
				ovt,lcdtype = <0x2a6220>;
				ovt,prox_lp_scan_enabled;
				ovt,regulator_lcd_bl = "gpio_lcd_bl_en";
				ovt,regulator_lcd_reset = "gpio_lcd_rst";
				ovt,regulator_lcd_vdd = "vcamio";
				ovt,spi-mode = <0x3>;
				ovt,support_cs_gpio_control;
				ovt,support_ear_detect_mode;
				ovt,support_spay_gesture_mode;
				ovt,ubl-byte-delay-us = <0x14>;
				ovt,ubl-max-freq = <0x6acfc0>;
				phandle = <0xac>;
				pinctrl-0 = <0x2b 0x2c 0x2d 0x2e 0x2f 0x30 0x31 0x32 0x33>;
				pinctrl-1 = <0x2b 0x2c 0x2d 0x2e 0x2f 0x30 0x31 0x32 0x33>;
				pinctrl-2 = <0x34 0x35 0x36 0x37 0x38 0x39 0x31 0x32 0x33>;
				pinctrl-names = "default", "on_state", "off_state";
				reg = <0x1>;
				spi-max-frequency = <0x6acfc0>;
				status = "okay";
			};
		};
	};

	fragment@46 {
		target = <0xffffffff>;

		__overlay__ {

			ovt_tsp_id1_default {
				phandle = <0x31>;

				pins_cmd_dat {
					bias-disable;
					input-enable;
					pinmux = <0xac00>;
					slew-rate = <0x0>;
				};
			};

			ovt_tsp_id2_default {
				phandle = <0x32>;

				pins_cmd_dat {
					bias-disable;
					input-enable;
					pinmux = <0xad00>;
					slew-rate = <0x0>;
				};
			};

			ovt_tsp_id3_default {
				phandle = <0x33>;

				pins_cmd_dat {
					bias-disable;
					input-enable;
					pinmux = <0xae00>;
					slew-rate = <0x0>;
				};
			};
		};
	};

	fragment@47 {
		target = <0xffffffff>;

		__overlay__ {
			num-cs = <0x3>;
		};
	};

	fragment@48 {
		target = <0xffffffff>;

		__overlay__ {
			regulator-max-microvolt = <0x1b7740>;
			regulator-min-microvolt = <0x1b7740>;
		};
	};

	fragment@49 {
		target = <0xffffffff>;

		__overlay__ {
			regulator-always-on;
			regulator-max-microvolt = <0x1b7740>;
			regulator-min-microvolt = <0x1b7740>;
		};
	};

	fragment@5 {
		target = <0xffffffff>;

		__overlay__ {

			lcd_bias_enn0_gpio {
				phandle = <0xf>;

				pins_cmd_dat {
					output-low;
					pinmux = <0x8a00>;
					slew-rate = <0x1>;
				};
			};

			lcd_bias_enn1_gpio {
				phandle = <0xe>;

				pins_cmd_dat {
					output-high;
					pinmux = <0x8a00>;
					slew-rate = <0x1>;
				};
			};

			lcd_bias_enp0_gpio {
				phandle = <0xd>;

				pins_cmd_dat {
					output-low;
					pinmux = <0x8900>;
					slew-rate = <0x1>;
				};
			};

			lcd_bias_enp1_gpio {
				phandle = <0xc>;

				pins_cmd_dat {
					output-high;
					pinmux = <0x8900>;
					slew-rate = <0x1>;
				};
			};

			lcm_dsi_te {
				phandle = <0x12>;

				pins_cmd_dat {
					pinmux = <0x5401>;
				};
			};

			lcm_rst_out0_gpio {
				phandle = <0x11>;

				pins_cmd_dat {
					output-low;
					pinmux = <0x5600>;
					slew-rate = <0x1>;
				};
			};

			lcm_rst_out1_gpio {
				phandle = <0x10>;

				pins_cmd_dat {
					output-high;
					pinmux = <0x5600>;
					slew-rate = <0x1>;
				};
			};
		};
	};

	fragment@50 {
		target = <0xffffffff>;

		__overlay__ {
			regulator-max-microvolt = <0x325aa0>;
			regulator-min-microvolt = <0x325aa0>;
		};
	};

	fragment@51 {
		target = <0xffffffff>;

		__overlay__ {

			himax_tsp_intr_off {
				phandle = <0x43>;

				pins_cmd_dat {
					bias-pull-down;
					input-enable;
					pinmux = <0xe00>;
					slew-rate = <0x0>;
				};
			};

			himax_tsp_intr_on {
				phandle = <0x3a>;

				pins_cmd_dat {
					bias-disable;
					pinmux = <0xe00>;
					slew-rate = <0x0>;
				};
			};
		};
	};

	fragment@52 {
		target = <0xffffffff>;

		__overlay__ {

			himax_tsp_reset_off {
				phandle = <0xad>;

				pins_cmd_dat {
					bias-disable;
					output-low;
					pinmux = <0x700>;
					slew-rate = <0x1>;
				};
			};

			himax_tsp_reset_on {
				phandle = <0x3b>;

				pins_cmd_dat {
					bias-disable;
					output-high;
					pinmux = <0x700>;
					slew-rate = <0x1>;
				};
			};
		};
	};

	fragment@53 {
		target = <0xffffffff>;

		__overlay__ {

			himax_tsp_off_cs {
				phandle = <0x45>;

				pins_cmd_dat {
					bias-disable;
					output-low;
					pinmux = <0x1c00>;
					slew-rate = <0x1>;
				};
			};

			himax_tsp_on_cs {
				phandle = <0x3d>;

				pins_cmd_dat {
					bias-disable;
					pinmux = <0x1c01>;
				};
			};
		};
	};

	fragment@54 {
		target = <0xffffffff>;

		__overlay__ {

			himax_default_miso {
				phandle = <0xae>;

				pins_cmd_dat {
					bias-disable;
					output-low;
					pinmux = <0x1e00>;
					slew-rate = <0x0>;
				};
			};

			himax_tsp_off_clk {
				phandle = <0x47>;

				pins_cmd_dat {
					bias-disable;
					output-low;
					pinmux = <0x1b00>;
					slew-rate = <0x1>;
				};
			};

			himax_tsp_off_miso {
				phandle = <0x44>;

				pins_cmd_dat {
					bias-pull-down;
					input-enable;
					pinmux = <0x1e00>;
					slew-rate = <0x0>;
				};
			};

			himax_tsp_off_mosi {
				phandle = <0x46>;

				pins_cmd_dat {
					bias-disable;
					output-low;
					pinmux = <0x1d00>;
					slew-rate = <0x1>;
				};
			};

			himax_tsp_on_clk {
				phandle = <0x3f>;

				pins_cmd_dat {
					bias-disable;
					pinmux = <0x1b01>;
				};
			};

			himax_tsp_on_miso {
				phandle = <0x3c>;

				pins_cmd_dat {
					bias-disable;
					pinmux = <0x1e01>;
				};
			};

			himax_tsp_on_mosi {
				phandle = <0x3e>;

				pins_cmd_dat {
					bias-disable;
					pinmux = <0x1d01>;
				};
			};
		};
	};

	fragment@55 {
		target = <0xffffffff>;

		__overlay__ {
			#address-cells = <0x1>;
			#size-cells = <0x0>;
			num-cs = <0x1>;
			status = "okay";

			himax_ts@0 {
				compatible = "himax,hxcommon";
				himax,display-coords = <0x2d0 0x640>;
				himax,enable_sysinput_enabled;
				himax,fix_touch_info = <0x20 0x12 0x0 0x2d0 0x640 0xa 0x1 0x1>;
				himax,fw_name = "", "", "", "", "", "tsp_himax/hx83108a_a13x.bin";
				himax,irq-gpio = <0xffffffff 0xe 0x0>;
				himax,lcdid = <0x5>;
				himax,lcdid1-gpio = <0xffffffff 0xac 0x0>;
				himax,lcdid2-gpio = <0xffffffff 0xad 0x0>;
				himax,lcdid3-gpio = <0xffffffff 0xae 0x0>;
				himax,lcdtype = <0x0 0x0 0x0 0x0 0x0 0x2a6234>;
				himax,name_lcd_bl_en = "gpio_lcd_bl_en";
				himax,name_lcd_rst = "gpio_lcd_rst";
				himax,name_lcd_vddi = "vcamio";
				himax,notch-setting = <0x11f 0x13f>;
				himax,one_frame_delay = <0x14>;
				himax,panel-coords = <0x2d0 0x640>;
				himax,project_name = "A13X", "A136";
				himax,prox_lp_scan_enabled;
				himax,report_type = <0x1>;
				himax,rst-gpio = <0xffffffff 0x7 0x0>;
				himax,support_ear_detect_mode;
				himax,support_spay_gesture_mode;
				phandle = <0xaf>;
				pinctrl-0 = <0x3a 0x3b 0x3c 0x3d 0x3e 0x3f 0x40 0x41 0x42>;
				pinctrl-1 = <0x3a 0x3b 0x3c 0x3d 0x3e 0x3f 0x40 0x41 0x42>;
				pinctrl-2 = <0x43 0x44 0x45 0x46 0x47 0x40 0x41 0x42>;
				pinctrl-names = "default", "on_state", "off_state";
				reg = <0x0>;
				spi-max-frequency = <0x989680>;
				support_aot;
			};
		};
	};

	fragment@56 {
		target = <0xffffffff>;

		__overlay__ {

			himax_tsp_id1_default {
				phandle = <0x40>;

				pins_cmd_dat {
					bias-disable;
					input-enable;
					pinmux = <0xac00>;
					slew-rate = <0x0>;
				};
			};

			himax_tsp_id2_default {
				phandle = <0x41>;

				pins_cmd_dat {
					bias-disable;
					input-enable;
					pinmux = <0xad00>;
					slew-rate = <0x0>;
				};
			};

			himax_tsp_id3_default {
				phandle = <0x42>;

				pins_cmd_dat {
					bias-disable;
					input-enable;
					pinmux = <0xae00>;
					slew-rate = <0x0>;
				};
			};
		};
	};

	fragment@57 {
		target = <0xffffffff>;

		__overlay__ {
			num-cs = <0x3>;
		};
	};

	fragment@58 {
		target = <0xffffffff>;

		__overlay__ {

			grip-i2c-scl {
				phandle = <0x49>;

				pins_cmd_dat {
					bias-pull-up;
					drive-strength = <0x2>;
					input-enable;
					pinmux = <0x6f00>;
				};
			};

			grip-i2c-sda {
				phandle = <0x48>;

				pins_cmd_dat {
					bias-pull-up;
					drive-strength = <0x2>;
					input-enable;
					pinmux = <0x7000>;
				};
			};
		};
	};

	fragment@59 {
		target = <0xffffffff>;

		__overlay__ {

			grip-int {
				phandle = <0x4a>;

				pins_cmd_dat {
					bias-disable;
					drive-strength = <0x2>;
					input-enable;
					pinmux = <0x1100>;
				};
			};
		};
	};

	fragment@6 {
		target = <0xffffffff>;

		__overlay__ {
			pinctrl-0 = <0xc>;
			pinctrl-1 = <0xd>;
			pinctrl-2 = <0xe>;
			pinctrl-3 = <0xf>;
			pinctrl-4 = <0x10>;
			pinctrl-5 = <0x11>;
			pinctrl-6 = <0x12>;
			pinctrl-names = "lcd_bias_enp1_gpio", "lcd_bias_enp0_gpio", "lcd_bias_enn1_gpio", "lcd_bias_enn0_gpio", "lcm_rst_out1_gpio", "lcm_rst_out0_gpio", "mode_te_te";
			status = "okay";
		};
	};

	fragment@60 {
		target = <0xffffffff>;

		__overlay__ {
			#address-cells = <0x1>;
			#size-cells = <0x0>;
			clock-frequency = <0x186a0>;
			gpios = <0xffffffff 0x70 0x0 0xffffffff 0x6f 0x0>;
			pinctrl-0 = <0x48 0x49>;
			status = "okay";

			a96t396@20 {
				compatible = "a96t396";
				firmup_cmd = <0x90>;
				fw_path = "abov/a96t396_a13x_eur_main.bin";
				interrupt-parent = <0xffffffff>;
				interrupts = <0x11 0x0>;
				irq_gpio = <0xffffffff 0x11 0x0>;
				ldo_en = <0xffffffff 0x8b 0x0>;
				multi_use = <0x1>;
				phandle = <0xb0>;
				pinctrl-0 = <0x4a>;
				pinctrl-names = "default";
				reg = <0x20>;
				unknown_ch_selection = <0x3>;
			};
		};
	};

	fragment@61 {
		target = <0xffffffff>;

		__overlay__ {

			grip-sub-i2c-scl {
				phandle = <0x4c>;

				pins_cmd_dat {
					bias-pull-up;
					drive-strength = <0x2>;
					input-enable;
					pinmux = <0x6f00>;
				};
			};

			grip-sub-i2c-sda {
				phandle = <0x4b>;

				pins_cmd_dat {
					bias-pull-up;
					drive-strength = <0x2>;
					input-enable;
					pinmux = <0x7000>;
				};
			};
		};
	};

	fragment@62 {
		target = <0xffffffff>;

		__overlay__ {

			grip-sub-int {
				phandle = <0x4d>;

				pins_cmd_dat {
					bias-disable;
					drive-strength = <0x2>;
					input-enable;
					pinmux = <0x1200>;
				};
			};
		};
	};

	fragment@63 {
		target = <0xffffffff>;

		__overlay__ {
			#address-cells = <0x1>;
			#size-cells = <0x0>;
			clock-frequency = <0x186a0>;
			gpios = <0xffffffff 0x70 0x0 0xffffffff 0x6f 0x0>;
			pinctrl-0 = <0x4b 0x4c>;
			status = "okay";

			a96t396_sub@21 {
				compatible = "a96t396_sub";
				firmup_cmd = <0x90>;
				fw_path = "abov/a96t396_a13x_eur_sub.bin";
				interrupt-parent = <0xffffffff>;
				interrupts = <0x12 0x0>;
				irq_gpio = <0xffffffff 0x12 0x0>;
				ldo_en = <0xffffffff 0x8b 0x0>;
				multi_use = <0x0>;
				phandle = <0xb1>;
				pinctrl-0 = <0x4d>;
				pinctrl-names = "default";
				reg = <0x21>;
				unknown_ch_selection = <0x3>;
			};
		};
	};

	fragment@64 {
		target = <0xffffffff>;

		__overlay__ {

			btp-irq {
				phandle = <0x2>;

				pins_cmd_dat {
					bias-disable;
					drive-strength = <0x1>;
					pinmux = <0xf00>;
				};
			};

			btp-irq-sleep {
				phandle = <0xb>;

				pins_cmd_dat {
					bias-pull-down;
					drive-strength = <0x1>;
					input-enable;
					pinmux = <0xf00>;
				};
			};
		};
	};

	fragment@65 {
		target = <0xffffffff>;

		__overlay__ {

			btp_sleep_enable {
				phandle = <0x1>;

				pins_cmd_dat {
					bias-pull-down;
					drive-strength = <0x1>;
					pinmux = <0x3000>;
				};
			};
		};
	};

	fragment@66 {
		target = <0xffffffff>;

		__overlay__ {

			clr_clk {
				phandle = <0xa>;

				pins_cmd_dat {
					bias-pull-down;
					drive-strength = <0x1>;
					output-low;
					pinmux = <0x2300>;
					slew-rate = <0x0>;
				};
			};

			clr_cs {
				phandle = <0x8>;

				pins_cmd_dat {
					bias-pull-down;
					drive-strength = <0x1>;
					output-low;
					pinmux = <0x2400>;
					slew-rate = <0x0>;
				};
			};

			clr_miso {
				phandle = <0x7>;

				pins_cmd_dat {
					bias-pull-down;
					drive-strength = <0x1>;
					input-enable;
					pinmux = <0x2600>;
					slew-rate = <0x0>;
				};
			};

			clr_mosi {
				phandle = <0x9>;

				pins_cmd_dat {
					bias-pull-down;
					drive-strength = <0x1>;
					output-low;
					pinmux = <0x2500>;
					slew-rate = <0x0>;
				};
			};

			set_clk {
				phandle = <0x6>;

				pins_cmd_dat {
					drive-strength = <0x4>;
					pinmux = <0x2301>;
				};
			};

			set_cs {
				phandle = <0x4>;

				pins_cmd_dat {
					drive-strength = <0x4>;
					pinmux = <0x2401>;
				};
			};

			set_miso {
				phandle = <0x3>;

				pins_cmd_dat {
					drive-strength = <0x4>;
					pinmux = <0x2601>;
				};
			};

			set_mosi {
				phandle = <0x5>;

				pins_cmd_dat {
					drive-strength = <0x4>;
					pinmux = <0x2501>;
				};
			};
		};
	};

	fragment@67 {
		target = <0xffffffff>;

		__overlay__ {
			regulator-max-microvolt = <0x325aa0>;
			regulator-min-microvolt = <0x325aa0>;
			regulator-name = "VDD_BTP_3P3";
		};
	};

	fragment@68 {
		target = <0xffffffff>;

		__overlay__ {

			nfc_ven {
				phandle = <0x4e>;

				pins_cmd_dat {
					bias-disable;
					output-low;
					pinmux = <0x8800>;
				};
			};

			ven_nc {
				phandle = <0x54>;

				pins_cmd_dat {
					bias-pull-down;
					input-enable;
					pinmux = <0x8800>;
				};
			};
		};
	};

	fragment@69 {
		target = <0xffffffff>;

		__overlay__ {

			firm_nc {
				phandle = <0x55>;

				pins_cmd_dat {
					bias-pull-down;
					input-enable;
					pinmux = <0x8900>;
				};
			};

			nfc_firm {
				phandle = <0x4f>;

				pins_cmd_dat {
					bias-disable;
					output-low;
					pinmux = <0x8900>;
				};
			};
		};
	};

	fragment@7 {
		target = <0xffffffff>;

		__overlay__ {
			pinctrl-0 = <0x10>;
			pinctrl-1 = <0x11>;
			pinctrl-2 = <0x12>;
			pinctrl-names = "lcm_rst_out1_gpio", "lcm_rst_out0_gpio", "mode_te_te";
			status = "okay";
		};
	};

	fragment@70 {
		target = <0xffffffff>;

		__overlay__ {

			clk_req_nc {
				phandle = <0x56>;

				pins_cmd_dat {
					bias-pull-down;
					input-enable;
					pinmux = <0xd00>;
				};
			};

			nfc_clk_req {
				phandle = <0x50>;

				pins_cmd_dat {
					bias-pull-down;
					input-enable;
					pinmux = <0xd00>;
				};
			};
		};
	};

	fragment@71 {
		target = <0xffffffff>;

		__overlay__ {

			irq_nc {
				phandle = <0x57>;

				pins_cmd_dat {
					bias-pull-down;
					input-enable;
					pinmux = <0x500>;
				};
			};

			nfc_irq {
				phandle = <0x51>;

				pins_cmd_dat {
					bias-pull-down;
					input-enable;
					pinmux = <0x500>;
				};
			};
		};
	};

	fragment@72 {
		target = <0xffffffff>;

		__overlay__ {

			nfc_i2c_off {
				phandle = <0x58>;

				pins_cmd_dat {
					bias-pull-down;
					input-enable;
					pinmux = <0x6700 0x6800>;
				};
			};

			nfc_i2c_on {
				phandle = <0x52>;

				pins_cmd_dat {
					bias-pull-up;
					pinmux = <0x6701 0x6801>;
				};
			};
		};
	};

	fragment@73 {
		target = <0xffffffff>;

		__overlay__ {

			nfc_check {
				phandle = <0x53>;

				pins_cmd_dat {
					bias-disable;
					input-enable;
					pinmux = <0xb500>;
				};
			};
		};
	};

	fragment@74 {
		target = <0xffffffff>;

		__overlay__ {
			clock-frequency = <0x61a80>;
			mediatek,use-open-drain;
			status = "ok";

			pn547@2B {
				compatible = "pn547";
				interrupt-parent = <0xffffffff>;
				interrupts = <0x5 0x1 0x5 0x0>;
				nfc_pvdd-supply = <0xffffffff>;
				pinctrl-0 = <0x4e 0x4f 0x50 0x51 0x52 0x53>;
				pinctrl-1 = <0x54 0x55 0x56 0x57 0x58>;
				pinctrl-2 = <0x58>;
				pinctrl-names = "default", "nfc_nc", "i2c_off";
				pn547,ap_vendor = "mtk";
				pn547,clk_req-gpio = <0xffffffff 0xd 0x0>;
				pn547,clk_req_wake;
				pn547,firm-gpio = <0xffffffff 0x89 0x0>;
				pn547,irq-gpio = <0xffffffff 0x5 0x0>;
				pn547,ldo_control;
				pn547,nfc-det-gpio = <0xffffffff 0xb5 0x0>;
				pn547,ven-gpio = <0xffffffff 0x88 0x0>;
				reg = <0x2b>;
			};
		};
	};

	fragment@75 {
		target = <0xffffffff>;

		__overlay__ {

			speaker_amp@34 {
				phandle = <0xb2>;
				status = "disabled";
			};
		};
	};

	fragment@76 {
		target = <0xffffffff>;

		__overlay__ {
			#address-cells = <0x1>;
			#size-cells = <0x0>;
			clock-frequency = <0x61a80>;
			id = <0x12>;
			status = "okay";

			aw88230_amp@34 {
				#sound-dai-cells = <0x0>;
				aw-cali-mode = "none";
				compatible = "mediatek,speaker_amp";
				irq-gpio = <0xffffffff 0x10 0x0>;
				phandle = <0x59>;
				reg = <0x34>;
				sound-channel = <0x0>;
				status = "okay";
			};
		};
	};

	fragment@77 {
		target = <0xffffffff>;

		__overlay__ {
			mtk_spk_i2s_in = <0x0>;
			mtk_spk_i2s_out = <0x3>;

			mediatek,speaker-codec {
				sound-dai = <0x59>;
			};
		};
	};

	fragment@78 {
		target = <0xffffffff>;

		__overlay__ {
			headset-four-key-threshold = <0x0 0xa3 0xc4 0x116 0x1f5>;
			headset-vol-threshold = <0x0 0x27e 0x27f 0x7d0 0xa28>;
		};
	};

	fragment@79 {
		target = <0xffffffff>;

		__overlay__ {

			pins_cmd_dat {
				bias-disable;
				pinmux = <0x2800 0x2900 0x2b00>;
				slew-rate = <0x1>;
			};
		};
	};

	fragment@8 {
		target = <0xffffffff>;

		__overlay__ {
			#address-cells = <0x1>;
			#size-cells = <0x0>;
			status = "okay";

			panel1@0 {
				bias-gpios = <0xffffffff 0x89 0x0 0xffffffff 0x8a 0x0>;
				compatible = "k6833v1,hx83108a,vdo", "k6833v1,nt36525c,vdo";
				pinctrl-names = "default";
				reg = <0x0>;
				reset-gpios = <0xffffffff 0x56 0x0>;

				port {

					endpoint {
						phandle = <0x14>;
						remote-endpoint = <0x13>;
					};
				};
			};

			ports {

				port {

					endpoint {
						phandle = <0x13>;
						remote-endpoint = <0x14>;
					};
				};
			};
		};
	};

	fragment@80 {
		target = <0xffffffff>;

		__overlay__ {
			cd_level = [01];
		};
	};

	fragment@81 {
		target = <0xffffffff>;

		__overlay__ {
			sdcard_det_en = <0x0>;
			sdcard_hlact = <0x0>;
		};
	};

	fragment@82 {
		target = <0xffffffff>;

		__overlay__ {
			compatible = "mediatek,flashlights_mt6360";
			factory_current = <0x7>;
			flash_current = <0x20>;
			flashlight_current = <0x0 0x1 0x2 0x3 0x4>;
			torch_current = <0x7>;
		};
	};

	fragment@83 {
		target = <0xffffffff>;

		__overlay__ {

			pd-data {
				pd,id-vdo-data = <0xd14004e8 0x0 0x68600000 0x41800000 0x0 0x21800000>;
				pd,pid = <0x6860>;
				pd,vid = <0x4e8>;
			};
		};
	};

	fragment@84 {
		target = <0xffffffff>;

		__overlay__ {

			camdefault {
				phandle = <0x5a>;
			};

			camera0_mclk_2mA@gpio49 {
				phandle = <0x66>;

				pins_cmd_dat {
					drive-strength = <0x0>;
					pinmux = <0x3101>;
				};
			};

			camera0_mclk_4mA@gpio49 {
				phandle = <0x67>;

				pins_cmd_dat {
					drive-strength = <0x1>;
					pinmux = <0x3101>;
				};
			};

			camera0_mclk_6mA@gpio49 {
				phandle = <0x68>;

				pins_cmd_dat {
					drive-strength = <0x2>;
					pinmux = <0x3101>;
				};
			};

			camera0_mclk_8mA@gpio49 {
				phandle = <0x69>;

				pins_cmd_dat {
					drive-strength = <0x3>;
					pinmux = <0x3101>;
				};
			};

			camera0_mclk_gpio_mode@gpio49 {
				phandle = <0x65>;

				pins_cmd_dat {
					drive-strength = <0x3>;
					pinmux = <0x3100>;
				};
			};

			camera0_rst_output_high@gpio54 {
				phandle = <0x5c>;

				pins_cmd_dat {
					output-high;
					pinmux = <0x3600>;
					slew-rate = <0x1>;
				};
			};

			camera0_rst_output_low@gpio54 {
				phandle = <0x5b>;

				pins_cmd_dat {
					output-low;
					pinmux = <0x3600>;
					slew-rate = <0x1>;
				};
			};

			camera0_vcama_output_high@gpio20 {
				phandle = <0x5e>;

				pins_cmd_dat {
					output-high;
					pinmux = <0x1400>;
					slew-rate = <0x1>;
				};
			};

			camera0_vcama_output_low@gpio20 {
				phandle = <0x5d>;

				pins_cmd_dat {
					output-low;
					pinmux = <0x1400>;
					slew-rate = <0x1>;
				};
			};

			camera0_vcamaf_output_high@gpio11 {
				phandle = <0x64>;

				pins_cmd_dat {
					output-high;
					pinmux = <0xb00>;
					slew-rate = <0x1>;
				};
			};

			camera0_vcamaf_output_low@gpio11 {
				phandle = <0x63>;

				pins_cmd_dat {
					output-low;
					pinmux = <0xb00>;
					slew-rate = <0x1>;
				};
			};

			camera0_vcamd_output_high@gpio53 {
				phandle = <0x60>;

				pins_cmd_dat {
					output-high;
					pinmux = <0x3500>;
					slew-rate = <0x1>;
				};
			};

			camera0_vcamd_output_low@gpio53 {
				phandle = <0x5f>;

				pins_cmd_dat {
					output-low;
					pinmux = <0x3500>;
					slew-rate = <0x1>;
				};
			};

			camera1_mclk_2mA@gpio52 {
				phandle = <0x71>;

				pins_cmd_dat {
					drive-strength = <0x0>;
					pinmux = <0x3401>;
				};
			};

			camera1_mclk_4mA@gpio52 {
				phandle = <0x72>;

				pins_cmd_dat {
					drive-strength = <0x1>;
					pinmux = <0x3401>;
				};
			};

			camera1_mclk_6mA@gpio52 {
				phandle = <0x73>;

				pins_cmd_dat {
					drive-strength = <0x2>;
					pinmux = <0x3401>;
				};
			};

			camera1_mclk_8mA@gpio52 {
				phandle = <0x74>;

				pins_cmd_dat {
					drive-strength = <0x3>;
					pinmux = <0x3401>;
				};
			};

			camera1_mclk_gpio_mode@gpio52 {
				phandle = <0x70>;

				pins_cmd_dat {
					drive-strength = <0x1>;
					pinmux = <0x3400>;
				};
			};

			camera1_rst_output_high@gpio55 {
				phandle = <0x6b>;

				pins_cmd_dat {
					output-high;
					pinmux = <0x3700>;
				};
			};

			camera1_rst_output_low@gpio55 {
				phandle = <0x6a>;

				pins_cmd_dat {
					output-low;
					pinmux = <0x3700>;
				};
			};

			camera1_vcama_output_high@gpio59 {
				phandle = <0x6d>;

				pins_cmd_dat {
					output-high;
					pinmux = <0x3b00>;
					slew-rate = <0x1>;
				};
			};

			camera1_vcama_output_low@gpio59 {
				phandle = <0x6c>;

				pins_cmd_dat {
					output-low;
					pinmux = <0x3b00>;
					slew-rate = <0x1>;
				};
			};

			camera1_vcamd_output_high@gpio57 {
				phandle = <0x6f>;

				pins_cmd_dat {
					output-high;
					pinmux = <0x3900>;
					slew-rate = <0x1>;
				};
			};

			camera1_vcamd_output_low@gpio57 {
				phandle = <0x6e>;

				pins_cmd_dat {
					output-low;
					pinmux = <0x3900>;
					slew-rate = <0x1>;
				};
			};

			camera2_mclk_2mA@gpio50 {
				phandle = <0x7c>;

				pins_cmd_dat {
					drive-strength = <0x0>;
					pinmux = <0x3201>;
				};
			};

			camera2_mclk_4mA@gpio50 {
				phandle = <0x7d>;

				pins_cmd_dat {
					drive-strength = <0x1>;
					pinmux = <0x3201>;
				};
			};

			camera2_mclk_6mA@gpio50 {
				phandle = <0x7e>;

				pins_cmd_dat {
					drive-strength = <0x2>;
					pinmux = <0x3201>;
				};
			};

			camera2_mclk_8mA@gpio50 {
				phandle = <0x7f>;

				pins_cmd_dat {
					drive-strength = <0x3>;
					pinmux = <0x3201>;
				};
			};

			camera2_mclk_gpio_mode@gpio50 {
				phandle = <0x7b>;

				pins_cmd_dat {
					drive-strength = <0x2>;
					pinmux = <0x3200>;
				};
			};

			camera2_rst_output_high@gpio58 {
				phandle = <0x76>;

				pins_cmd_dat {
					output-high;
					pinmux = <0x3a00>;
				};
			};

			camera2_rst_output_low@gpio58 {
				phandle = <0x75>;

				pins_cmd_dat {
					output-low;
					pinmux = <0x3a00>;
				};
			};

			camera2_vcama_output_high@gpio22 {
				phandle = <0x78>;

				pins_cmd_dat {
					output-high;
					pinmux = <0x1600>;
					slew-rate = <0x1>;
				};
			};

			camera2_vcama_output_low@gpio22 {
				phandle = <0x77>;

				pins_cmd_dat {
					output-low;
					pinmux = <0x1600>;
					slew-rate = <0x1>;
				};
			};

			camera2_vcamd_output_high@gpio21 {
				phandle = <0x7a>;

				pins_cmd_dat {
					output-high;
					pinmux = <0x1500>;
					slew-rate = <0x1>;
				};
			};

			camera2_vcamd_output_low@gpio21 {
				phandle = <0x79>;

				pins_cmd_dat {
					output-low;
					pinmux = <0x1500>;
					slew-rate = <0x1>;
				};
			};

			camera3_mclk_2mA@gpio51 {
				phandle = <0x87>;

				pins_cmd_dat {
					drive-strength = <0x0>;
					pinmux = <0x3301>;
				};
			};

			camera3_mclk_4mA@gpio51 {
				phandle = <0x88>;

				pins_cmd_dat {
					drive-strength = <0x1>;
					pinmux = <0x3301>;
				};
			};

			camera3_mclk_6mA@gpio51 {
				phandle = <0x89>;

				pins_cmd_dat {
					drive-strength = <0x2>;
					pinmux = <0x3301>;
				};
			};

			camera3_mclk_8mA@gpio51 {
				phandle = <0x8a>;

				pins_cmd_dat {
					drive-strength = <0x3>;
					pinmux = <0x3301>;
				};
			};

			camera3_mclk_gpio_mode@gpio51 {
				phandle = <0x86>;

				pins_cmd_dat {
					drive-strength = <0x2>;
					pinmux = <0x3300>;
				};
			};

			camera3_rst_output_high@gpio56 {
				phandle = <0x81>;

				pins_cmd_dat {
					output-high;
					pinmux = <0x3800>;
				};
			};

			camera3_rst_output_low@gpio56 {
				phandle = <0x80>;

				pins_cmd_dat {
					output-low;
					pinmux = <0x3800>;
				};
			};

			camera3_vcama_output_high@gpio22 {
				phandle = <0x83>;

				pins_cmd_dat {
					output-high;
					pinmux = <0x1600>;
					slew-rate = <0x1>;
				};
			};

			camera3_vcama_output_low@gpio22 {
				phandle = <0x82>;

				pins_cmd_dat {
					output-low;
					pinmux = <0x1600>;
					slew-rate = <0x1>;
				};
			};

			camera3_vcamd_output_high@gpio21 {
				phandle = <0x85>;

				pins_cmd_dat {
					output-high;
					pinmux = <0x1500>;
					slew-rate = <0x1>;
				};
			};

			camera3_vcamd_output_low@gpio21 {
				phandle = <0x84>;

				pins_cmd_dat {
					output-low;
					pinmux = <0x1500>;
					slew-rate = <0x1>;
				};
			};

			camera_vcamio_output_high@gpio131 {
				phandle = <0x62>;

				pins_cmd_dat {
					output-high;
					pinmux = <0x8300>;
				};
			};

			camera_vcamio_output_low@gpio131 {
				phandle = <0x61>;

				pins_cmd_dat {
					output-low;
					pinmux = <0x8300>;
				};
			};
		};
	};

	fragment@85 {
		target = <0xffffffff>;

		__overlay__ {
			pinctrl-0 = <0x5a>;
			pinctrl-1 = <0x5b>;
			pinctrl-10 = <0x64>;
			pinctrl-11 = <0x65>;
			pinctrl-12 = <0x66>;
			pinctrl-13 = <0x67>;
			pinctrl-14 = <0x68>;
			pinctrl-15 = <0x69>;
			pinctrl-16 = <0x6a>;
			pinctrl-17 = <0x6b>;
			pinctrl-18 = <0x6c>;
			pinctrl-19 = <0x6d>;
			pinctrl-2 = <0x5c>;
			pinctrl-20 = <0x6e>;
			pinctrl-21 = <0x6f>;
			pinctrl-22 = <0x61>;
			pinctrl-23 = <0x62>;
			pinctrl-24 = <0x70>;
			pinctrl-25 = <0x71>;
			pinctrl-26 = <0x72>;
			pinctrl-27 = <0x73>;
			pinctrl-28 = <0x74>;
			pinctrl-29 = <0x75>;
			pinctrl-3 = <0x5d>;
			pinctrl-30 = <0x76>;
			pinctrl-31 = <0x77>;
			pinctrl-32 = <0x78>;
			pinctrl-33 = <0x79>;
			pinctrl-34 = <0x7a>;
			pinctrl-35 = <0x61>;
			pinctrl-36 = <0x62>;
			pinctrl-37 = <0x7b>;
			pinctrl-38 = <0x7c>;
			pinctrl-39 = <0x7d>;
			pinctrl-4 = <0x5e>;
			pinctrl-40 = <0x7e>;
			pinctrl-41 = <0x7f>;
			pinctrl-42 = <0x80>;
			pinctrl-43 = <0x81>;
			pinctrl-44 = <0x82>;
			pinctrl-45 = <0x83>;
			pinctrl-46 = <0x84>;
			pinctrl-47 = <0x85>;
			pinctrl-48 = <0x61>;
			pinctrl-49 = <0x62>;
			pinctrl-5 = <0x5f>;
			pinctrl-50 = <0x86>;
			pinctrl-51 = <0x87>;
			pinctrl-52 = <0x88>;
			pinctrl-53 = <0x89>;
			pinctrl-54 = <0x8a>;
			pinctrl-6 = <0x60>;
			pinctrl-7 = <0x61>;
			pinctrl-8 = <0x62>;
			pinctrl-9 = <0x63>;
			pinctrl-names = "default", "cam0_rst0", "cam0_rst1", "cam0_ldo_vcama_0", "cam0_ldo_vcama_1", "cam0_ldo_vcamd_0", "cam0_ldo_vcamd_1", "cam0_ldo_vcamio_0", "cam0_ldo_vcamio_1", "cam0_ldo_vcamaf_0", "cam0_ldo_vcamaf_1", "cam0_mclk_off", "cam0_mclk_2mA", "cam0_mclk_4mA", "cam0_mclk_6mA", "cam0_mclk_8mA", "cam1_rst0", "cam1_rst1", "cam1_ldo_vcama_0", "cam1_ldo_vcama_1", "cam1_ldo_vcamd_0", "cam1_ldo_vcamd_1", "cam1_ldo_vcamio_0", "cam1_ldo_vcamio_1", "cam1_mclk_off", "cam1_mclk_2mA", "cam1_mclk_4mA", "cam1_mclk_6mA", "cam1_mclk_8mA", "cam2_rst0", "cam2_rst1", "cam2_ldo_vcama_0", "cam2_ldo_vcama_1", "cam2_ldo_vcamd_0", "cam2_ldo_vcamd_1", "cam2_ldo_vcamio_0", "cam2_ldo_vcamio_1", "cam2_mclk_off", "cam2_mclk_2mA", "cam2_mclk_4mA", "cam2_mclk_6mA", "cam2_mclk_8mA", "cam3_rst0", "cam3_rst1", "cam3_ldo_vcama_0", "cam3_ldo_vcama_1", "cam3_ldo_vcamd_0", "cam3_ldo_vcamd_1", "cam3_ldo_vcamio_0", "cam3_ldo_vcamio_1", "cam3_mclk_off", "cam3_mclk_2mA", "cam3_mclk_4mA", "cam3_mclk_6mA", "cam3_mclk_8mA";
			status = "okay";

			vendor {
				check_sensor_vendor;
				front_sensor_id = <0xd3>;
				max_camera_num = <0x4>;
				max_supported_camera = <0x4>;
				rear2_sensor_id = <0xd3>;
				rear3_sensor_id = <0xd2>;
				rear_sensor_id = <0x78>;
				supported_cameraId = <0x0 0x1 0x34 0x36>;
				use_dualcam_set_cal;

				camera_info0 {
					afcal_type = <0x14>;
					cal_memory = <0x2>;
					companion = <0x0>;
					core_voltage = <0x0>;
					dual_open = <0x0>;
					isp = <0x0>;
					ois = <0x0>;
					position = <0x0>;
					read_version = <0x0>;
					upgrade = <0x0>;
					use_adaptive_mipi = <0x1>;
					valid = <0x1>;
				};

				camera_info1 {
					cal_memory = <0x3>;
					companion = <0x0>;
					core_voltage = <0x0>;
					dual_open = <0x0>;
					isp = <0x0>;
					ois = <0x0>;
					position = <0x1>;
					read_version = <0x0>;
					upgrade = <0x0>;
					use_adaptive_mipi = <0x0>;
					valid = <0x1>;
				};

				camera_info2 {
					cal_memory = <0x3>;
					companion = <0x0>;
					core_voltage = <0x0>;
					dual_open = <0x1>;
					isp = <0x0>;
					ois = <0x0>;
					position = <0x2>;
					read_version = <0x0>;
					upgrade = <0x0>;
					use_adaptive_mipi = <0x0>;
					valid = <0x1>;
				};

				camera_info3 {
					cal_memory = <0x2>;
					companion = <0x0>;
					core_voltage = <0x0>;
					dual_open = <0x0>;
					isp = <0x0>;
					ois = <0x0>;
					position = <0x4>;
					read_version = <0x0>;
					upgrade = <0x0>;
					use_adaptive_mipi = <0x0>;
					valid = <0x1>;
				};
			};
		};
	};

	fragment@86 {
		target = <0xffffffff>;

		__overlay__ {
			#address-cells = <0x1>;
			#size-cells = <0x0>;
			clock-frequency = <0xf4240>;
			mediatek,use-open-drain;

			camera_main@5A {
				compatible = "mediatek,camera_main";
				phandle = <0xb3>;
				reg = <0x2d>;
				status = "okay";
			};
		};
	};

	fragment@87 {
		target = <0xffffffff>;

		__overlay__ {
			#address-cells = <0x1>;
			#size-cells = <0x0>;
			clock-frequency = <0x61a80>;
			mediatek,use-open-drain;

			camera_sub@6E {
				compatible = "mediatek,camera_sub";
				phandle = <0xb4>;
				reg = <0x37>;
				status = "okay";
			};
		};
	};

	fragment@88 {
		target = <0xffffffff>;

		__overlay__ {
			#address-cells = <0x1>;
			#size-cells = <0x0>;
			clock-frequency = <0x61a80>;
			mediatek,use-open-drain;

			camera_eeprom2@A2 {
				compatible = "mediatek,camera_eeprom";
				phandle = <0xb7>;
				reg = <0x50>;
				status = "okay";
			};

			camera_main_two@6E {
				compatible = "mediatek,camera_main_two";
				phandle = <0xb5>;
				reg = <0x37>;
				status = "okay";
			};

			camera_sub_two@20 {
				compatible = "mediatek,camera_sub_two";
				phandle = <0xb6>;
				reg = <0x10>;
				status = "okay";
			};
		};
	};

	fragment@89 {
		target = <0xffffffff>;

		__overlay__ {
			#address-cells = <0x1>;
			#size-cells = <0x0>;
			clock-frequency = <0x61a80>;
			mediatek,use-open-drain;

			camera_eeprom0@B0 {
				compatible = "mediatek,camera_eeprom";
				phandle = <0xb8>;
				reg = <0x58>;
				status = "okay";
			};

			camera_eeprom1@6E {
				compatible = "mediatek,camera_eeprom";
				phandle = <0xb9>;
				reg = <0x37>;
				status = "okay";
			};

			camera_eeprom3@A4 {
				compatible = "mediatek,camera_eeprom";
				phandle = <0xba>;
				reg = <0x52>;
				status = "okay";
			};

			camera_main_af@18 {
				compatible = "mediatek,camera_main_af";
				phandle = <0xbb>;
				reg = <0xc>;
				status = "okay";
			};
		};
	};

	fragment@9 {
		target = <0xffffffff>;

		__overlay__ {
			accdet-mic-mode = <0x2>;
			accdet-mic-vol = <0x6>;
			accdet-plugout-debounce = <0x1>;
			eint_comp_vth = <0x2>;
			eint_detect_mode = <0x1>;
			eint_use_ext_res = <0x1>;
			headset-four-key-threshold = <0x0 0x53 0x73 0xbd 0x190>;
			headset-mode-setting = <0x500 0x500 0x1 0x1f0 0x1000 0x1000 0x20 0x44 0x4 0x1 0xe 0x3 0x3 0x5 0xe>;
			headset-three-key-threshold = <0x0 0x50 0xdc 0x190>;
			headset-three-key-threshold-CDD = <0x0 0x79 0xc0 0x258>;
			headset-vol-threshold = <0x0 0x24e 0x24f 0x7d0 0xa28>;
			moisture-ver = <0x1>;
			moisture-vm = <0x64>;
			moisture-water-r = <0xc350>;
			moisture_detect_enable = <0x1>;
			moisture_detect_mode = <0x1>;
			moisture_use_ext_res = <0x1>;
			status = "okay";
		};
	};

	fragment@90 {
		target = <0xffffffff>;

		__overlay__ {

			panel1@0 {
				bias-gpios;
				compatible = "smcdsd_panel";
				pm-enable-gpios;
				reset-gpios;
			};
		};
	};

	fragment@lcd {
		target-path = [2f 00];

		__overlay__ {

			__nt36525c_sharp_90 {
				drm_params-vrefresh = <0x5a>;
				lcm_params-dsi-vertical_frontporch = <0x1c>;
				phandle = <0x8f>;
			};

			__td4160_boe_90 {
				drm_params-vrefresh = <0x5a>;
				lcm_params-dsi-vertical_frontporch = <0x96>;
				phandle = <0x8c>;
			};

			lcd_fixed_regulator {
				compatible = "simple-bus";
				phandle = <0xbc>;

				__gpio_lcd_bl_en {
					compatible = "regulator-fixed";
					enable-active-high;
					gpio = <0xffffffff 0x8a 0x0>;
					phandle = <0xbe>;
					regulator-boot-on;
					regulator-name = "gpio_lcd_bl_en";
				};

				__gpio_lcd_rst {
					compatible = "regulator-fixed";
					enable-active-high;
					gpio = <0xffffffff 0x56 0x0>;
					phandle = <0xbd>;
					regulator-boot-on;
					regulator-name = "gpio_lcd_rst";
				};
			};

			nt36525c_sharp {
				drm_params-vrefresh = <0x3c>;
				ext_params-dyn_fps-vact_timing_fps = <0x5a>;
				id_match = <0xffffff 0x2af244>;
				lcm_params-dsi-cont_clock = <0x1>;
				lcm_params-dsi-data_rate = <0x4ae>;
				lcm_params-dsi-horizontal_backporch = <0x22>;
				lcm_params-dsi-horizontal_frontporch = <0x18>;
				lcm_params-dsi-horizontal_sync_active = <0x2>;
				lcm_params-dsi-lane_num = <0x3>;
				lcm_params-dsi-mode = <0x2>;
				lcm_params-dsi-ssc_disable = <0x1>;
				lcm_params-dsi-vertical_backporch = <0x14a>;
				lcm_params-dsi-vertical_frontporch = <0x3f0>;
				lcm_params-dsi-vertical_sync_active = <0x2>;
				lcm_params-physical_height = <0x97>;
				lcm_params-physical_width = <0x44>;
				lcm_params-resolution = <0x2d0 0x640>;
				lcm_params-types = <0x2>;
				phandle = <0x8e>;
				smcdsd_board = <0x90>;
				vrr_info = <0x8e 0x8f>;
			};

			panel {
				compatible = "samsung,mtk-dsi-panel";
				smcdsd_panel = <0x8b>;
			};

			smcdsd_board_nt36525c {
				gpio_con = <0xffffffff 0x2d 0x0>;
				phandle = <0x90>;

				panel_power_disable {
					type = "delay,usleep", "3000", "regulator,disable", "gpio_lcd_bl_en", "delay,usleep", "5000", "regulator,disable", "vcamio", "delay,msleep", "33";
				};

				panel_power_enable {
					type = "regulator,enable", "vcamio", "delay,usleep", "2000", "regulator,enable", "gpio_lcd_bl_en", "delay,usleep", "2000";
				};

				panel_regulator_init {
					type = "regulator,enable", "vcamio", "regulator,enable", "gpio_lcd_rst", "regulator,enable", "gpio_lcd_bl_en";
				};

				panel_reset_disable {
					type = "delay,msleep", "60", "regulator,disable", "gpio_lcd_rst", "delay,usleep", "5000";
				};

				panel_reset_enable {
					type = "delay,usleep", "10000", "regulator,enable", "gpio_lcd_rst", "delay,usleep", "5000", "regulator,disable", "gpio_lcd_rst", "delay,usleep", "3500", "regulator,enable", "gpio_lcd_rst", "delay,usleep", "10000";
				};
			};

			smcdsd_board_td4160 {
				gpio_con = <0xffffffff 0x2d 0x0>;
				phandle = <0x8d>;

				panel_power_disable {
					type = "delay,usleep", "3000", "regulator,disable", "gpio_lcd_bl_en", "delay,usleep", "5000", "regulator,disable", "vcamio", "delay,usleep", "15000";
				};

				panel_power_enable {
					type = "regulator,enable", "vcamio", "delay,usleep", "1000", "regulator,enable", "gpio_lcd_bl_en", "delay,usleep", "1000";
				};

				panel_regulator_init {
					type = "regulator,enable", "vcamio", "regulator,enable", "gpio_lcd_rst", "regulator,enable", "gpio_lcd_bl_en";
				};

				panel_reset_disable {
					type = "delay,msleep", "70", "regulator,disable", "gpio_lcd_rst", "delay,usleep", "10000";
				};

				panel_reset_enable {
					type = "delay,usleep", "1000", "regulator,enable", "gpio_lcd_rst", "delay,usleep", "2000", "regulator,disable", "gpio_lcd_rst", "delay,usleep", "2000", "regulator,enable", "gpio_lcd_rst", "delay,msleep", "20";
				};
			};

			td4160_boe {
				drm_params-vrefresh = <0x3c>;
				ext_params-dyn_fps-vact_timing_fps = <0x5a>;
				id_match = <0xffffff 0x2a6220>;
				lcm_params-dsi-cont_clock = <0x1>;
				lcm_params-dsi-data_rate = <0x342>;
				lcm_params-dsi-horizontal_backporch = <0x14>;
				lcm_params-dsi-horizontal_frontporch = <0x40>;
				lcm_params-dsi-horizontal_sync_active = <0x2>;
				lcm_params-dsi-lane_num = <0x4>;
				lcm_params-dsi-mode = <0x3>;
				lcm_params-dsi-ssc_disable = <0x1>;
				lcm_params-dsi-vertical_backporch = <0xc>;
				lcm_params-dsi-vertical_frontporch = <0x409>;
				lcm_params-dsi-vertical_sync_active = <0x4>;
				lcm_params-physical_height = <0x97>;
				lcm_params-physical_width = <0x44>;
				lcm_params-resolution = <0x2d0 0x640>;
				lcm_params-types = <0x2>;
				phandle = <0x8b>;
				smcdsd_board = <0x8d>;
				vrr_info = <0x8b 0x8c>;
			};
		};
	};

	fragment@led {
		target-path = "/disp_leds/";

		__overlay__ {
			compatible;
		};
	};

	fragment@model {
		target-path = [2f 00];

		__overlay__ {
			dtbo-hw_rev = <0x0>;
			dtbo-hw_rev_end = <0xff>;
			dtbo-lcd_id_1 = <0xffffffff 0xac 0x0>;
			dtbo-lcd_id_2 = <0xffffffff 0xad 0x0>;
			dtbo-lcd_id_3 = <0xffffffff 0xae 0x0>;

			firmware {

				android {
					compatible = "android,firmware";

					vbmeta {
						compatible = "android,vbmeta";
						parts = "vbmeta,boot,system,vendor,product,odm,prism,optics,vbmeta_system,recovery,lk,tee1";
					};
				};
			};

			shub {
				acc-lsm6dsl-position = <0x0>;
				acc-motor-coef = <0x14>;
				compatible = "shub";
				mag-ak09918c-array = [b1 4f 9d f3 5b e6 00 e7 d5 35 60 5b c3 e4 fe d7 ff 3f 32 16 be f9 9a 34 0b e7 fb];
				mag-ak09918c-position = <0x2>;
			};

			usb_notifier {
				compatible = "samsung,usb-notifier";
				disable_host_wakelock;
			};

			usb_tuning {
				compatible = "mediatek,phy_tuning";
				phandle = <0x9b>;

				tune@1 {
					label = "term_vref_sel";
					mask = <0x7>;
					offset = <0x4>;
					shift = <0x8>;
					value = <0x2>;
				};

				tune@2 {
					label = "vrt_ref_sel";
					mask = <0x7>;
					offset = <0x4>;
					shift = <0xc>;
					value = <0x3>;
				};

				tune@3 {
					label = "intr_cal";
					mask = <0x1f>;
					offset = <0x4>;
					shift = <0x13>;
					value = <0x19>;
				};

				tune@4 {
					label = "hstx_srctrl";
					mask = <0x7>;
					offset = <0x14>;
					shift = <0xc>;
					value = <0x1>;
				};

				tune@5 {
					label = "hstx_srcal_en";
					mask = <0x1>;
					offset = <0x14>;
					shift = <0xf>;
					value = <0x0>;
				};

				tune@6 {
					label = "sqth";
					mask = <0xf>;
					offset = <0x18>;
					shift = <0x0>;
					value = <0x2>;
				};

				tune@7 {
					label = "discth";
					mask = <0xf>;
					offset = <0x18>;
					shift = <0x4>;
					value = <0x7>;
				};

				tune@8 {
					label = "enhance";
					mask = <0x3>;
					offset = <0x18>;
					shift = <0x1e>;
					value = <0x3>;
				};
			};
		};
	};

	fragment@pwm {
		target-path = "/pwmleds/";

		__overlay__ {
			compatible;
		};
	};

	fragment@smd {
		target-path = [2f 00];

		__overlay__ {

			fixed_regulator_cam_vddio_1p8_ldo {
				compatible = "regulator-fixed";
				enable-active-high;
				gpio = <0xffffffff 0x83 0x0>;
				regulator-name = "cam_vddio_1p8_ldo";
				skip-gpio-request;
			};

			fixed_regulator_fcam_a2p8_ldo {
				compatible = "regulator-fixed";
				enable-active-high;
				gpio = <0xffffffff 0x46 0x0>;
				regulator-name = "fcam_a2p8_ldo";
				skip-gpio-request;
			};

			fixed_regulator_grip_ldo {
				compatible = "regulator-fixed";
				enable-active-high;
				gpio = <0xffffffff 0x10 0x0>;
				regulator-name = "grip_ldo";
				skip-gpio-request;
			};

			fixed_regulator_rcam1_afvdd_2p8_ldo {
				compatible = "regulator-fixed";
				enable-active-high;
				gpio = <0xffffffff 0xb 0x0>;
				regulator-name = "rcam1_afvdd_2p8_ldo";
				skip-gpio-request;
			};

			fixed_regulator_rcam1_dvdd_1p05_ldo {
				compatible = "regulator-fixed";
				enable-active-high;
				gpio = <0xffffffff 0x35 0x0>;
				regulator-name = "rcam1_dvdd_1p05_ldo";
				skip-gpio-request;
			};

			samsung_mobile_device {
				#address-cells = <0x1>;
				#size-cells = <0x0>;
				compatible = "simple-bus";
				phandle = <0x91>;

				abc_hub {
					compatible = "samsung,abc_hub";
					status = "okay";

					bootc {
						bootc,time_spec_eng = <0x249f0>;
						bootc,time_spec_fac = <0x186a0>;
						bootc,time_spec_user = <0x186a0>;
					};
				};

				battery {
					battery,adc_check_count = <0x5>;
					battery,age_data = <0x0 0x10fe 0x10b8 0x109a 0x5d 0x12c 0x10ea 0x10a4 0x1086 0x5c 0x190 0x10d6 0x1090 0x1072 0x5b 0x2bc 0x10c2 0x107c 0x105e 0x5a 0x3e8 0x1090 0x104a 0x102c 0x59>;
					battery,batt_data_version = <0x1>;
					battery,battery_check_type = <0x0>;
					battery,battery_full_capacity = <0x1388>;
					battery,cable_check_type = <0x4>;
					battery,cable_source_type = <0x1>;
					battery,charger_name = "mtk-charger";
					battery,charging_reset_time = <0x0>;
					battery,charging_total_time = <0x3840>;
					battery,chg_charging_limit_current = <0x76c>;
					battery,chg_float_voltage = <0x10fe>;
					battery,chg_gpio_full_check = <0x0>;
					battery,chg_high_temp = <0x226>;
					battery,chg_high_temp_recovery = <0x208>;
					battery,chg_input_limit_current = <0x3e8>;
					battery,chg_polarity_full_check = <0x1>;
					battery,chg_temp_check_type = <0x1>;
					battery,chg_temp_table_adc = <0x169 0x1a5 0x1cf 0x21d 0x282 0x2f6 0x38f 0x3e8 0x47f 0x541 0x63d 0x73d 0x830 0x8d7 0xa2e 0xb5f 0xc7b 0xd8a 0xe89 0xf6e 0x101e 0x101e 0x101e>;
					battery,chg_temp_table_data = <0x384 0x352 0x320 0x2ee 0x2bc 0x28a 0x258 0x226 0x1f4 0x1c2 0x190 0x15e 0x12c 0xfa 0xc8 0x96 0x64 0x32 0x0 0xffffffce 0xffffff9c 0xffffff6a 0xffffff38>;
					battery,chg_thermal_source = <0x2>;
					battery,chip_vendor = "MTK";
					battery,cisd_alg_index = <0x8>;
					battery,cisd_max_voltage_thr = <0x1388>;
					battery,cv_data = <0xa0f 0x334 0xb98 0x9ff 0x352 0xaa8 0x948 0x370 0x9b8 0x805 0x38e 0x8a1 0x69a 0x3ac 0x74e 0x342 0x3ca 0x35b 0x231 0x3de 0x107 0x1d9 0x3e8 0x0>;
					battery,dynamic_cv_factor;
					battery,expired_time = <0x2ee0>;
					battery,fuelgauge_name = "mtk-fg-battery";
					battery,full_check_count = <0x1>;
					battery,full_check_type = <0x2>;
					battery,full_check_type_2nd = <0x2>;
					battery,full_condition_soc = <0x5d>;
					battery,full_condition_type = <0x9>;
					battery,full_condition_vcell = <0x109a>;
					battery,health_condition = <0x384 0x0 0x4b0 0x0 0x5dc 0x0>;
					battery,high_temp_float = <0x1036>;
					battery,high_temp_topoff = <0xfa>;
					battery,hv_charging_total_time = <0x2a30>;
					battery,ignore_cisd_index = <0x0 0x0>;
					battery,ignore_cisd_index_d = <0x0 0x50>;
					battery,low_temp_float = <0x10fe>;
					battery,low_temp_topoff = <0xfa>;
					battery,max_charging_charge_power = <0x3a98>;
					battery,max_charging_current = <0x9c4>;
					battery,max_input_current = <0xbb8>;
					battery,max_input_voltage = <0x2328>;
					battery,mix_high_chg_temp = <0x1f4>;
					battery,mix_high_temp = <0x1a4>;
					battery,mix_high_temp_recovery = <0x186>;
					battery,monitor_initial_count = <0x0>;
					battery,normal_charging_total_time = <0x4650>;
					battery,overheatlimit_recovery = <0x2a8>;
					battery,overheatlimit_threshold = <0x2bc>;
					battery,ovp_uvlo_check_type = <0x3>;
					battery,pd_charging_charge_power = <0x3a98>;
					battery,pd_comm_cap;
					battery,polling_time = <0xa 0x1e 0x1e 0x1e 0xe10>;
					battery,polling_type = <0x1>;
					battery,pre_afc_input_current = <0x1f4>;
					battery,pre_afc_work_delay = <0x7d0>;
					battery,pre_wc_afc_input_current = <0x1f4>;
					battery,pre_wc_afc_work_delay = <0xfa0>;
					battery,prepare_ta_delay = <0x0>;
					battery,recharge_check_count = <0x1>;
					battery,recharge_condition_soc = <0x62>;
					battery,recharge_condition_type = <0x4>;
					battery,recharge_condition_vcell = <0x10b8>;
					battery,recharging_expired_time = <0x1518>;
					battery,recharging_total_time = <0x1518>;
					battery,rp_current_abnormal_rp3 = <0x708>;
					battery,rp_current_rdu_rp3 = <0x834>;
					battery,rp_current_rp1 = <0x1f4>;
					battery,rp_current_rp2 = <0x5dc>;
					battery,rp_current_rp3 = <0xbb8>;
					battery,siop_charging_limit_current = <0x3e8>;
					battery,siop_curr_type_num = <0x3>;
					battery,siop_fcc_20 = <0xffff 0xffff 0xffff>;
					battery,siop_hv_charging_limit_current = <0x3e8>;
					battery,siop_hv_input_limit_current = <0x2bc>;
					battery,siop_hv_input_limit_current_2nd = <0x226>;
					battery,siop_icl_20 = <0x3e8 0x3e8 0x3e8>;
					battery,siop_input_limit_current = <0x4b0>;
					battery,siop_scenarios = <0x14>;
					battery,sleep_mode_limit_current = <0x1f4>;
					battery,slowcharging_usb_bootcomplete;
					battery,standard_curr = <0x9c4>;
					battery,store_mode_charging_max = <0x46>;
					battery,store_mode_charging_min = <0x3c>;
					battery,swelling_drop_float_voltage = <0x1036>;
					battery,swelling_high_rechg_voltage = <0xfa0>;
					battery,swelling_high_temp_block = <0x19a>;
					battery,swelling_high_temp_recov = <0x186>;
					battery,swelling_low_rechg_voltage = <0x1068>;
					battery,swelling_low_temp_block_1st = <0x96>;
					battery,swelling_low_temp_block_2nd = <0x32>;
					battery,swelling_low_temp_recov_1st = <0xaa>;
					battery,swelling_low_temp_recov_2nd = <0x46>;
					battery,technology = <0x2>;
					battery,temp_adc_type = <0x1>;
					battery,temp_check_count = <0x1>;
					battery,temp_check_type = <0x1>;
					battery,temp_high_recovery_event = <0x1e0>;
					battery,temp_high_recovery_lpm = <0x1e0>;
					battery,temp_high_recovery_normal = <0x1e0>;
					battery,temp_high_threshold_event = <0x1f4>;
					battery,temp_high_threshold_lpm = <0x1f4>;
					battery,temp_high_threshold_normal = <0x1f4>;
					battery,temp_highlimit_recovery_event = <0x30c>;
					battery,temp_highlimit_recovery_lpm = <0x30c>;
					battery,temp_highlimit_recovery_normal = <0x30c>;
					battery,temp_highlimit_threshold_event = <0x320>;
					battery,temp_highlimit_threshold_lpm = <0x320>;
					battery,temp_highlimit_threshold_normal = <0x320>;
					battery,temp_low_recovery_event = <0x14>;
					battery,temp_low_recovery_lpm = <0x14>;
					battery,temp_low_recovery_normal = <0x14>;
					battery,temp_low_threshold_event = <0x0>;
					battery,temp_low_threshold_lpm = <0x0>;
					battery,temp_low_threshold_normal = <0x0>;
					battery,temp_table_adc = <0xcd 0x113 0x130 0x13a 0x171 0x1ac 0x200 0x24f 0x2ad 0x31a 0x39c 0x429 0x4bf 0x562 0x606 0x697 0x73e 0x7db 0x86a 0x8ec 0x976 0x9ca 0xa0a>;
					battery,temp_table_data = <0x384 0x352 0x320 0x2ee 0x2bc 0x28a 0x258 0x226 0x1f4 0x1c2 0x190 0x15e 0x12c 0xfa 0xc8 0x96 0x64 0x32 0x0 0xffffffce 0xffffff9c 0xffffff6a 0xffffff38>;
					battery,thermal_source = <0x4>;
					battery,ttf_capacity = <0x10fe>;
					battery,ttf_hv_charge_current = <0x9b0>;
					battery,usb_charging_total_time = <0x8ca0>;
					battery,usb_temp_check_type = <0x0>;
					battery,usb_thermal_source = <0x5>;
					battery,vendor = "Battery";
					battery,volt_from_pmic;
					battery,wc_full_input_limit_current = <0x64>;
					battery,wire_cold_cool3_thresh = <0x0>;
					battery,wire_cool1_current = <0x9c4>;
					battery,wire_cool1_normal_thresh = <0xb4>;
					battery,wire_cool2_cool1_thresh = <0x96>;
					battery,wire_cool2_current = <0x47e>;
					battery,wire_cool3_cool2_thresh = <0x32>;
					battery,wire_cool3_current = <0x1ea>;
					battery,wire_normal_warm_thresh = <0x1a4>;
					battery,wire_warm_current = <0x6d6>;
					battery,wire_warm_overheat_thresh = <0x1f4>;
					battery,wireless_cc_cv = <0x55>;
					battery,wireless_otg_input_current = <0x384>;
					battery,wpc_charging_limit_current = <0x3e8>;
					battery,wpc_high_recovery_normal = <0x1ae>;
					battery,wpc_high_temp = <0x17c>;
					battery,wpc_high_temp_recovery = <0x168>;
					battery,wpc_high_threshold_normal = <0x1c2>;
					battery,wpc_input_limit_current = <0x258>;
					battery,wpc_lcd_on_high_temp = <0x17c>;
					battery,wpc_lcd_on_high_temp_rec = <0x168>;
					battery,wpc_lcd_on_input_limit_current = <0x1c2>;
					battery,wpc_low_recovery_normal = <0x14>;
					battery,wpc_low_threshold_normal = <0x0>;
					battery,wpc_store_charging_limit_current = <0x190>;
					battery,wpc_store_high_temp = <0x168>;
					battery,wpc_store_high_temp_recovery = <0x154>;
					battery,wpc_store_lcd_on_charging_limit_current = <0x190>;
					battery,wpc_store_lcd_on_high_temp = <0x168>;
					battery,wpc_store_lcd_on_high_temp_rec = <0x12c>;
					battery,wpc_temp_check_type = <0x0>;
					battery,wpc_temp_control_source = <0x1>;
					battery,wpc_temp_lcd_on_control_source = <0x1>;
					battery,wpc_thermal_source = <0x5>;
					compatible = "samsung,sec-battery";
					io-channel-names = "adc-chg-temp", "n/a", "n/a", "n/a", "n/a";
					io-channels = <0xffffffff 0x3>;
					phandle = <0x94>;
					pinctrl-names = "default";
					status = "okay";
				};

				cable-info {
					default_charging_current = <0x834>;
					default_input_current = <0x708>;
					full_check_current_1st = <0x1f4>;
					full_check_current_2nd = <0xfa>;
					phandle = <0x9a>;

					current_group_1 {
						cable_number = <0x2 0x13 0x15 0x16 0x17>;
						charging_current = <0x1f4>;
						input_current = <0x1f4>;
					};

					current_group_10 {
						cable_number = <0xb 0xe 0x10 0x1c 0x23>;
						charging_current = <0x9c4>;
						input_current = <0x28a>;
					};

					current_group_11 {
						cable_number = <0x1d 0x25>;
						charging_current = <0x4b0>;
						input_current = <0x1f4>;
					};

					current_group_12 {
						cable_number = <0x1 0x4 0x1e>;
						charging_current = <0x226>;
						input_current = <0x1db>;
					};

					current_group_13 {
						cable_number = <0x22>;
						charging_current = <0x92e>;
						input_current = <0x4b0>;
					};

					current_group_2 {
						cable_number = <0x19 0x1f>;
						charging_current = <0x3e8>;
						input_current = <0x3e8>;
					};

					current_group_3 {
						cable_number = <0x5 0x20>;
						charging_current = <0x5dc>;
						input_current = <0x5dc>;
					};

					current_group_4 {
						cable_number = <0x6 0x7 0x8 0x11 0x12 0x28>;
						charging_current = <0x9c4>;
						input_current = <0x672>;
					};

					current_group_5 {
						cable_number = <0x9>;
						charging_current = <0x9c4>;
						input_current = <0x672>;
					};

					current_group_6 {
						cable_number = <0xa 0xc 0xf 0x1b 0x21 0x24>;
						charging_current = <0x9c4>;
						input_current = <0x320>;
					};

					current_group_7 {
						cable_number = <0xd>;
						charging_current = <0x9c4>;
						input_current = <0x2bc>;
					};

					current_group_8 {
						cable_number = <0x18>;
						charging_current = <0x1c2>;
						input_current = <0x3e8>;
					};

					current_group_9 {
						cable_number = <0x1a>;
						charging_current = <0x708>;
						input_current = <0x708>;
					};
				};

				dc_vibrator {
					compatible = "samsung,dc_vibrator";
					dc_vib,motor_type = "COINDC";
					dc_vib,regulator_name = "dc_vib";
					dc_vib-supply = <0xffffffff>;
					status = "okay";
				};

				etspi-spi@0 {
					#gpio-cells = <0x2>;
					clock-names = "parent-clk", "sel-clk", "spi-clk";
					clocks = <0xffffffff 0x9 0xffffffff 0xb3 0xffffffff 0x4a>;
					compatible = "etspi,et5xx";
					etspi-chipid = "ET528";
					etspi-drdyPin = <0xffffffff 0xf 0x0>;
					etspi-orient = <0x2>;
					etspi-regulator = "VDD_BTP_3P3";
					etspi-sleepPin = <0xffffffff 0x30 0x0>;
					gpio-controller;
					pinctrl-0 = <0x1 0x2>;
					pinctrl-1 = <0x3 0x4 0x5 0x6>;
					pinctrl-2 = <0x1 0x7 0x8 0x9 0xa>;
					pinctrl-3 = <0x2>;
					pinctrl-4 = <0xb>;
					pinctrl-names = "default", "pins_poweron", "pins_poweroff", "pins_poweron_tz", "pins_poweroff_tz";
					reg = <0x0>;
					spi-max-frequency = <0x17d7840>;

					controller-data {
						mediatek,tckdly = <0x1>;
					};
				};

				input_booster {
					#address-cells = <0x1>;
					#size-cells = <0x0>;
					allowed_resources = "0,1";
					compatible = "input_booster";
					cpu_cluster_policy = "6,0";
					ib_release_values = "-1,16,0";
					max_cluster_count = [33 00];
					max_resource_count = [33 00];
					resValcount = [32 00];
					status = "okay";

					booster_key@1 {
						input_booster,head_time = <0xc8>;
						input_booster,label = "key";
						input_booster,tail_time = <0x0>;
						input_booster,type = <0x0>;

						inputbooster,resource {
							compatible = "resource";

							resource@1 {
								resource,label = "CPU";
								resource,value = <0x137090 0x0>;
							};

							resource@2 {
								resource,label = "DDR";
								resource,value = <0x0 0x0>;
							};
						};
					};

					booster_key@2 {
						input_booster,head_time = <0x1>;
						input_booster,label = "touchkey";
						input_booster,tail_time = <0x12c>;
						input_booster,type = <0x1>;

						inputbooster,resource {
							compatible = "resource";

							resource@1 {
								resource,label = "CPU";
								resource,value = <0x0 0xfe650>;
							};

							resource@2 {
								resource,label = "DDR";
								resource,value = <0x0 0x0>;
							};
						};
					};

					booster_key@3 {
						input_booster,head_time = <0x82>;
						input_booster,label = "touch";
						input_booster,tail_time = <0x1f4>;
						input_booster,type = <0x2>;

						inputbooster,resource {
							compatible = "resource";

							resource@1 {
								resource,label = "CPU";
								resource,value = <0x137090 0xfe650>;
							};

							resource@2 {
								resource,label = "DDR";
								resource,value = <0x10aa 0x10aa>;
							};
						};
					};

					booster_key@4 {
						input_booster,head_time = <0x3e8>;
						input_booster,label = "multitouch";
						input_booster,tail_time = <0x1f4>;
						input_booster,type = <0x3>;

						inputbooster,resource {
							compatible = "resource";

							resource@1 {
								resource,label = "CPU";
								resource,value = <0x176830 0x137090>;
							};

							resource@2 {
								resource,label = "DDR";
								resource,value = <0x0 0x0>;
							};
						};
					};

					booster_key@5 {
						input_booster,head_time = <0x82>;
						input_booster,label = "keyboard";
						input_booster,tail_time = <0x82>;
						input_booster,type = <0x4>;

						inputbooster,resource {
							compatible = "resource";

							resource@1 {
								resource,label = "CPU";
								resource,value = <0xfe650 0xfe650>;
							};

							resource@2 {
								resource,label = "DDR";
								resource,value = <0x0 0x0>;
							};
						};
					};

					booster_key@6 {
						input_booster,head_time = <0xc8>;
						input_booster,label = "MOUSE";
						input_booster,tail_time = <0x12c>;
						input_booster,type = <0x5>;

						inputbooster,resource {
							compatible = "resource";

							resource@1 {
								resource,label = "CPU";
								resource,value = <0x137090 0xfe650>;
							};

							resource@2 {
								resource,label = "DDR";
								resource,value = <0x0 0x0>;
							};
						};
					};

					booster_key@7 {
						input_booster,head_time = <0xc8>;
						input_booster,label = "mouse_wheel";
						input_booster,tail_time = <0x0>;
						input_booster,type = <0x6>;

						inputbooster,resource {
							compatible = "resource";

							resource@1 {
								resource,label = "CPU";
								resource,value = <0x137090 0x0>;
							};

							resource@2 {
								resource,label = "DDR";
								resource,value = <0x0 0x0>;
							};
						};
					};

					booster_key@8 {
						input_booster,head_time = <0xc8>;
						input_booster,label = "pen_hover";
						input_booster,tail_time = <0x12c>;
						input_booster,type = <0x7>;

						inputbooster,resource {
							compatible = "resource";

							resource@1 {
								resource,label = "CPU";
								resource,value = <0x137090 0xfe650>;
							};

							resource@2 {
								resource,label = "DDR";
								resource,value = <0x0 0x0>;
							};
						};
					};

					booster_key@9 {
						input_booster,head_time = <0xc8>;
						input_booster,label = "pen";
						input_booster,tail_time = <0x258>;
						input_booster,type = <0x8>;

						inputbooster,resource {
							compatible = "resource";

							resource@1 {
								resource,label = "CPU";
								resource,value = <0x1a3ad8 0xfe650>;
							};

							resource@2 {
								resource,label = "DDR";
								resource,value = <0x0 0x0>;
							};
						};
					};
				};

				mtk-charger {
					charger,gpio_chgenb = <0xffffffff 0x87 0x0>;
					charger,gpio_ilim = <0xffffffff 0x8c 0x0>;
					charger,ib_fcc = <0x64>;
					charger,max_icl = <0xcb2>;
					charger,vbus_min_charger_voltage = <0x44aa20>;
					charger,vbus_normal_mivr_voltage = <0x44aa20>;
					compatible = "samsung,mtk-charger";
					phandle = <0x92>;
				};

				mtk_battery {
					ACTIVE_TABLE = <0x6>;
					BatteryID_GPIO = <0xffffffff 0xb8 0x0>;
					CAR_TUNE_VALUE = <0x64>;
					COM_FG_METER_RESISTANCE = <0x64>;
					COM_R_FG_VALUE = <0x0>;
					DIFFERENCE_FULLOCV_ITH = <0x12c>;
					EMBEDDED_SEL = <0x0>;
					FG_METER_RESISTANCE = <0x64>;
					HWOCV_OLDOCV_DIFF = <0x64>;
					KEEP_100_PERCENT = <0x1>;
					MULTI_TEMP_GAUGE0 = <0x1>;
					PMIC_MIN_VOL = <0x82dc>;
					PMIC_SHUTDOWN_CURRENT = <0x14>;
					POWERON_SYSTEM_IBOOT = <0x1f4>;
					Q_MAX_SYS_VOLTAGE_BAT0 = <0xd16>;
					Q_MAX_SYS_VOLTAGE_BAT1 = <0xd16>;
					Q_MAX_SYS_VOLTAGE_BAT2 = <0xd16>;
					Q_MAX_SYS_VOLTAGE_BAT3 = <0xd16>;
					RBAT_PULL_UP_R = <0x186a0>;
					RBAT_TYPE = <0x64>;
					R_FG_VALUE = <0x5>;
					SHUTDOWN_1_TIME = <0x64>;
					SHUTDOWN_GAUGE0 = <0x0>;
					SHUTDOWN_GAUGE0_VOLTAGE = <0x84d0>;
					TEMPERATURE_T0 = <0x32>;
					TEMPERATURE_T1 = <0x19>;
					TEMPERATURE_T2 = <0xa>;
					TEMPERATURE_T3 = <0x0>;
					TEMPERATURE_T4 = <0xfffffff6>;
					TEMPERATURE_T5 = <0xffffffec>;
					UI_FULL_LIMIT_EN = <0x1>;
					UI_FULL_LIMIT_ITH0 = <0x2af8>;
					UI_FULL_LIMIT_ITH1 = <0x2134>;
					UI_FULL_LIMIT_ITH2 = <0x1c84>;
					UI_FULL_LIMIT_ITH3 = <0x1644>;
					UI_FULL_LIMIT_ITH4 = <0x10cc>;
					UI_FULL_LIMIT_SOC0 = <0x2549>;
					UI_FULL_LIMIT_SOC1 = <0x25ad>;
					UI_FULL_LIMIT_SOC2 = <0x2611>;
					UI_FULL_LIMIT_SOC3 = <0x2675>;
					UI_FULL_LIMIT_SOC4 = <0x26d9>;
					battery0_profile_t0 = <0x0 0xa8d4 0x384 0x1e0 0xa844 0x384 0x3c1 0xa7b6 0x384 0x5a1 0xa736 0x384 0x781 0xa6c1 0x38f 0x962 0xa647 0x385 0xb42 0xa5d7 0x39d 0xd22 0xa55d 0x384 0xf02 0xa4ed 0x384 0x10e3 0xa481 0x38f 0x12c3 0xa40d 0x385 0x14a3 0xa3a5 0x39d 0x1684 0xa334 0x396 0x1864 0xa2cd 0x39a 0x1a44 0xa25e 0x39d 0x1c25 0xa1f8 0x39d 0x1e05 0xa188 0x39d 0x1fe5 0xa120 0x39d 0x21c5 0xa0b9 0x3b4 0x23a6 0xa04f 0x39d 0x2586 0x9fef 0x3b6 0x2766 0x9f88 0x3a4 0x2947 0x9f25 0x3b6 0x2b27 0x9ec5 0x3b6 0x2d07 0x9e68 0x3c4 0x2ee8 0x9e24 0x3ec 0x30c8 0x9dcd 0x3ee 0x32a8 0x9d45 0x3bf 0x3488 0x9cc5 0x3cf 0x3669 0x9c65 0x3dd 0x3849 0x9c31 0x3e8 0x3a29 0x9bf0 0x3d4 0x3c0a 0x9ba4 0x3d9 0x3dea 0x9b50 0x3cf 0x3fca 0x9b0a 0x3e8 0x41ab 0x9abc 0x3ed 0x438b 0x9a74 0x401 0x456b 0x9a27 0x401 0x474c 0x99dc 0x41b 0x492c 0x9996 0x433 0x4b0c 0x9946 0x433 0x4cec 0x98ee 0x433 0x4ecd 0x986c 0x3eb 0x50ad 0x97dd 0x3b6 0x528d 0x977c 0x3b6 0x546e 0x9728 0x39d 0x564e 0x96e1 0x39d 0x582e 0x96a6 0x39d 0x5a0f 0x966c 0x39d 0x5bef 0x963c 0x39d 0x5dcf 0x960b 0x39d 0x5faf 0x95d1 0x39d 0x6190 0x95aa 0x39d 0x6370 0x957c 0x39d 0x6550 0x9554 0x3af 0x6731 0x9528 0x3a5 0x6911 0x9508 0x3b6 0x6af1 0x94dd 0x3ab 0x6cd2 0x94bd 0x3b6 0x6eb2 0x9495 0x3a3 0x7092 0x9473 0x3a6 0x7272 0x9453 0x3b6 0x7453 0x943d 0x3cf 0x7633 0x941d 0x3cf 0x7813 0x93fc 0x3bb 0x79f4 0x93e6 0x3cf 0x7bd4 0x93d0 0x3e8 0x7db4 0x93b6 0x3de 0x7f95 0x939a 0x3e3 0x8175 0x9382 0x3e3 0x8355 0x934e 0x3bb 0x8536 0x9306 0x3b5 0x8716 0x92b2 0x38d 0x88f6 0x9281 0x3a3 0x8ad6 0x9261 0x3b6 0x8cb7 0x9233 0x3ab 0x8e97 0x920d 0x3b5 0x9077 0x91e3 0x3ae 0x9258 0x91bb 0x3a4 0x9438 0x919a 0x3a0 0x9618 0x9182 0x3b6 0x97f9 0x9158 0x39f 0x99d9 0x912b 0x3b6 0x9bb9 0x90f5 0x3b6 0x9d99 0x90b3 0x3b6 0x9f7a 0x907d 0x3b6 0xa15a 0x9046 0x3cc 0xa33a 0x8fef 0x3a4 0xa51b 0x8fbd 0x3a5 0xa6fb 0x8fad 0x3b6 0xa8db 0x8fa2 0x3aa 0xaabc 0x8f98 0x3d2 0xac9c 0x8f89 0x3e8 0xae7c 0x8f6f 0x401 0xb05c 0x8f2c 0x419 0xb23d 0x8e32 0x3f6 0xb41d 0x8c95 0x401 0xb5fd 0x8a7f 0x427 0xb7de 0x8783 0x43c 0xb9be 0x8304 0x47e>;
					battery0_profile_t0_col = <0x3>;
					battery0_profile_t0_num = <0x64>;
					battery0_profile_t1 = <0x0 0xa870 0x47e 0x1e0 0xa7d6 0x47e 0x3c1 0xa752 0x497 0x5a1 0xa6da 0x4ab 0x781 0xa667 0x4a5 0x962 0xa5f7 0x4b0 0xb42 0xa587 0x4b0 0xd22 0xa517 0x4b0 0xf02 0xa4a7 0x4b0 0x10e3 0xa43b 0x4a2 0x12c3 0xa3d1 0x498 0x14a3 0xa365 0x4b0 0x1684 0xa2fb 0x4b7 0x1864 0xa292 0x4b3 0x1a44 0xa22c 0x4c9 0x1c25 0xa1bd 0x4cb 0x1e05 0xa156 0x4d1 0x1fe5 0xa0ee 0x4da 0x21c5 0xa07e 0x4c9 0x23a6 0xa01d 0x4e2 0x2586 0x9fb4 0x4cf 0x2766 0x9f64 0x4fb 0x2947 0x9f2e 0x535 0x2b27 0x9f08 0x55d 0x2d07 0x9ebd 0x551 0x2ee8 0x9e35 0x529 0x30c8 0x9d6d 0x501 0x32a8 0x9cb2 0x4eb 0x3488 0x9c25 0x4fb 0x3669 0x9bba 0x4e2 0x3849 0x9b67 0x4e2 0x3a29 0x9b2e 0x50a 0x3c0a 0x9b02 0x51e 0x3dea 0x9aec 0x546 0x3fca 0x9ad0 0x550 0x41ab 0x9a94 0x532 0x438b 0x9a4c 0x532 0x456b 0x9a09 0x550 0x474c 0x99be 0x55f 0x492c 0x9978 0x55f 0x4b0c 0x991c 0x546 0x4cec 0x98b3 0x531 0x4ecd 0x9830 0x4f3 0x50ad 0x97b5 0x4b0 0x528d 0x9754 0x48f 0x546e 0x970a 0x490 0x564e 0x96c3 0x47e 0x582e 0x968d 0x48b 0x5a0f 0x9658 0x480 0x5bef 0x9621 0x475 0x5dcf 0x95f4 0x490 0x5faf 0x95c6 0x495 0x6190 0x9596 0x48a 0x6370 0x9570 0x494 0x6550 0x9548 0x490 0x6731 0x951e 0x47e 0x6911 0x94fe 0x495 0x6af1 0x94dd 0x497 0x6cd2 0x94bd 0x497 0x6eb2 0x949d 0x497 0x7092 0x947d 0x497 0x7272 0x945d 0x497 0x7453 0x9447 0x4b0 0x7633 0x9428 0x4b0 0x7813 0x9410 0x4b0 0x79f4 0x93f4 0x4a1 0x7bd4 0x93e4 0x4c9 0x7db4 0x93ca 0x4b0 0x7f95 0x93b0 0x4b0 0x8175 0x9398 0x49c 0x8355 0x9382 0x4b0 0x8536 0x9357 0x496 0x8716 0x932d 0x47e 0x88f6 0x930d 0x47e 0x8ad6 0x92ed 0x47e 0x8cb7 0x92cd 0x489 0x8e97 0x92a3 0x47e 0x9077 0x9283 0x48f 0x9258 0x9262 0x47e 0x9438 0x9242 0x47e 0x9618 0x9222 0x48a 0x97f9 0x91f8 0x499 0x99d9 0x91cb 0x49f 0x9bb9 0x918b 0x497 0x9d99 0x9153 0x4ae 0x9f7a 0x911d 0x4b0 0xa15a 0x90dc 0x4b0 0xa33a 0x9085 0x49e 0xa51b 0x9050 0x4b0 0xa6fb 0x9039 0x4b0 0xa8db 0x9033 0x4bc 0xaabc 0x9022 0x4c9 0xac9c 0x9012 0x4dc 0xae7c 0x8ffb 0x4fb 0xb05c 0x8fc2 0x513 0xb23d 0x8ee6 0x514 0xb41d 0x8d3f 0x51c 0xb5fd 0x8b21 0x57f 0xb7de 0x8825 0x5be 0xb9be 0x83c2 0x640>;
					battery0_profile_t1_col = <0x3>;
					battery0_profile_t1_num = <0x64>;
					battery0_profile_t2 = <0x0 0xa726 0x947 0x1e0 0xa678 0x974 0x3c1 0xa5f4 0x9c4 0x5a1 0xa57c 0x9ec 0x781 0xa4ff 0x9e8 0x962 0xa490 0x9f7 0xb42 0xa429 0xa0f 0xd22 0xa3bc 0xa15 0xf02 0xa353 0xa28 0x10e3 0xa2ed 0xa41 0x12c3 0xa287 0xa5a 0x14a3 0xa215 0xa5a 0x1684 0xa1a7 0xa48 0x1864 0xa13e 0xa70 0x1a44 0xa0d8 0xa73 0x1c25 0xa073 0xa73 0x1e05 0xa013 0xa62 0x1fe5 0x9fc3 0xa9a 0x21c5 0x9f8b 0xb16 0x23a6 0x9f5b 0xb60 0x2586 0x9f1d 0xb6d 0x2766 0x9eae 0xb5b 0x2947 0x9df3 0xad8 0x2b27 0x9d13 0xa60 0x2d07 0x9c61 0xa28 0x2ee8 0x9bde 0xa0f 0x30c8 0x9b7e 0xa0f 0x32a8 0x9b2f 0xa0f 0x3488 0x9aef 0xa26 0x3669 0x9abe 0xa4e 0x3849 0x9a8f 0xa5d 0x3a29 0x9a6f 0xa85 0x3c0a 0x9a4c 0xa8c 0x3dea 0x9a1b 0xa8c 0x3fca 0x99db 0xa8c 0x41ab 0x998e 0xa88 0x438b 0x992e 0xa60 0x456b 0x98c6 0xa25 0x474c 0x9846 0x9de 0x492c 0x97cc 0x984 0x4b0c 0x9769 0x960 0x4cec 0x9719 0x94d 0x4ecd 0x96db 0x950 0x50ad 0x96a1 0x960 0x528d 0x9666 0x947 0x546e 0x9634 0x947 0x564e 0x95fc 0x947 0x582e 0x95d6 0x956 0x5a0f 0x95a6 0x947 0x5bef 0x9576 0x947 0x5dcf 0x954f 0x960 0x5faf 0x9528 0x974 0x6190 0x9503 0x960 0x6370 0x94de 0x979 0x6550 0x94bd 0x979 0x6731 0x949d 0x979 0x6911 0x947d 0x979 0x6af1 0x945d 0x979 0x6cd2 0x9447 0x979 0x6eb2 0x942d 0x989 0x7092 0x9411 0x98b 0x7272 0x93f9 0x98f 0x7453 0x93e4 0x9ab 0x7633 0x93cf 0x9ab 0x7813 0x93bf 0x9bc 0x79f4 0x93af 0x9cb 0x7bd4 0x939f 0x9f4 0x7db4 0x938f 0xa03 0x7f95 0x937e 0xa41 0x8175 0x9365 0xa64 0x8355 0x9348 0xa94 0x8536 0x9328 0xabc 0x8716 0x9303 0xafd 0x88f6 0x92dd 0xb29 0x8ad6 0x92bd 0xb79 0x8cb7 0x929a 0xbb8 0x8e97 0x9273 0xbff 0x9077 0x9248 0xc35 0x9258 0x9212 0xc6e 0x9438 0x91d9 0xcc0 0x9618 0x919f 0xd10 0x97f9 0x9165 0xd48 0x99d9 0x9125 0xdb0 0x9bb9 0x90d9 0xe00 0x9d99 0x9091 0xe3d 0x9f7a 0x9070 0xeb4 0xa15a 0x9060 0xf3b 0xa33a 0x904a 0xfcc 0xa51b 0x9036 0x106c 0xa6fb 0x901e 0x114c 0xa8db 0x8fd9 0x122d 0xaabc 0x8f43 0x12da 0xac9c 0x8de1 0x1321 0xae7c 0x8bcd 0x147b 0xb05c 0x88fa 0x1670 0xb23d 0x8476 0x18ef 0xb41d 0x8282 0x19e1 0xb5fd 0x8282 0x19e1 0xb7de 0x8282 0x19e1 0xb9be 0x8282 0x19e1>;
					battery0_profile_t2_col = <0x3>;
					battery0_profile_t2_num = <0x64>;
					battery0_profile_t3 = <0x0 0xa532 0x1243 0x1e0 0xa456 0x12bb 0x3c1 0xa3c4 0x137e 0x5a1 0xa344 0x13e2 0x781 0xa2c8 0x140f 0x962 0xa24e 0x1437 0xb42 0xa1de 0x146e 0xd22 0xa16b 0x1482 0xf02 0xa0fc 0x1496 0x10e3 0xa08d 0x149b 0x12c3 0xa031 0x14ce 0x14a3 0x9fe6 0x152f 0x1684 0x9fa6 0x159b 0x1864 0x9f66 0x15c3 0x1a44 0x9f13 0x15d5 0x1c25 0x9e93 0x1578 0x1e05 0x9ddc 0x1500 0x1fe5 0x9d08 0x145c 0x21c5 0x9c59 0x140c 0x23a6 0x9bd0 0x13ec 0x2586 0x9b6b 0x1404 0x2766 0x9b11 0x13ec 0x2947 0x9ad0 0x1412 0x2b27 0x9a96 0x1437 0x2d07 0x9a5b 0x1443 0x2ee8 0x9a2b 0x1469 0x30c8 0x99fb 0x147a 0x32a8 0x99c1 0x1470 0x3488 0x9988 0x1482 0x3669 0x9943 0x1476 0x3849 0x98e7 0x1450 0x3a29 0x9889 0x142b 0x3c0a 0x9819 0x13e4 0x3dea 0x97a9 0x13a4 0x3fca 0x9743 0x136f 0x41ab 0x96f3 0x136c 0x438b 0x96ab 0x1356 0x456b 0x9669 0x1356 0x474c 0x9633 0x136e 0x492c 0x95f9 0x1364 0x4b0c 0x95c9 0x136f 0x4cec 0x9599 0x136f 0x4ecd 0x9573 0x1391 0x50ad 0x9543 0x13a1 0x528d 0x9518 0x13a1 0x546e 0x94f8 0x13bf 0x564e 0x94d0 0x13d3 0x582e 0x94ae 0x13ec 0x5a0f 0x948e 0x13ec 0x5bef 0x9468 0x1405 0x5dcf 0x944e 0x1423 0x5faf 0x942e 0x1437 0x6190 0x941b 0x145b 0x6370 0x940b 0x149e 0x6550 0x93fb 0x14ee 0x6731 0x93ee 0x154b 0x6911 0x93e5 0x15d5 0x6af1 0x93d5 0x1664 0x6cd2 0x93cf 0x1711 0x6eb2 0x93bf 0x179c 0x7092 0x93af 0x1855 0x7272 0x939f 0x190c 0x7453 0x938a 0x19bb 0x7633 0x9374 0x1a81 0x7813 0x935b 0x1b32 0x79f4 0x933d 0x1bdd 0x7bd4 0x9327 0x1c95 0x7db4 0x92fd 0x1d1d 0x7f95 0x92dc 0x1dba 0x8175 0x92b3 0x1e45 0x8355 0x9290 0x1ee5 0x8536 0x9260 0x1f6d 0x8716 0x922f 0x1ff5 0x88f6 0x91f5 0x207d 0x8ad6 0x91bd 0x211d 0x8cb7 0x917d 0x21be 0x8e97 0x913d 0x2245 0x9077 0x90fd 0x230c 0x9258 0x90bf 0x23d4 0x9438 0x9096 0x24c8 0x9618 0x9076 0x25b4 0x97f9 0x9060 0x26c8 0x99d9 0x9040 0x27e0 0x9bb9 0x901b 0x2935 0x9d99 0x8fcb 0x2a74 0x9f7a 0x8f3a 0x2bb4 0xa15a 0x8e2e 0x2cae 0xa33a 0x8c90 0x2e80 0xa51b 0x8a31 0x3174 0xa6fb 0x86a8 0x3572 0xa8db 0x82b4 0x3953 0xaabc 0x82b4 0x3953 0xac9c 0x82b4 0x3953 0xae7c 0x82b4 0x3953 0xb05c 0x82b4 0x3953 0xb23d 0x82b4 0x3953 0xb41d 0x82b4 0x3953 0xb5fd 0x82b4 0x3953 0xb7de 0x82b4 0x3953 0xb9be 0x82b4 0x3953>;
					battery0_profile_t3_col = <0x3>;
					battery0_profile_t3_num = <0x64>;
					battery0_profile_t4 = <0x0 0xa37a 0x23a5 0x1e0 0xa190 0x2568 0x3c1 0xa06c 0x28bf 0x5a1 0x9fd4 0x2a12 0x781 0x9f55 0x2a6d 0x962 0x9edb 0x2a60 0xb42 0x9e3e 0x29f0 0xd22 0x9d7f 0x2944 0xf02 0x9caf 0x2893 0x10e3 0x9c04 0x287c 0x12c3 0x9b75 0x2836 0x14a3 0x9b0d 0x27e1 0x1684 0x9ab6 0x2823 0x1864 0x9a6f 0x2865 0x1a44 0x9a20 0x283c 0x1c25 0x99d0 0x2870 0x1e05 0x9987 0x2865 0x1fe5 0x993b 0x2878 0x21c5 0x98f2 0x2868 0x23a6 0x98a2 0x2855 0x2586 0x9852 0x2839 0x2766 0x97fb 0x2823 0x2947 0x979b 0x27d0 0x2b27 0x973b 0x27a8 0x2d07 0x96e3 0x278a 0x2ee8 0x9690 0x275b 0x30c8 0x9648 0x2748 0x32a8 0x9610 0x2752 0x3488 0x95d0 0x272a 0x3669 0x959f 0x276c 0x3849 0x956f 0x2791 0x3a29 0x953e 0x27a6 0x3c0a 0x9512 0x270b 0x3dea 0x94f2 0x2774 0x3fca 0x94c8 0x27f1 0x41ab 0x94a8 0x2797 0x438b 0x9488 0x27fb 0x456b 0x9476 0x2866 0x474c 0x9466 0x290e 0x492c 0x945c 0x2a5e 0x4b0c 0x9450 0x2b16 0x4cec 0x9440 0x2bc9 0x4ecd 0x9430 0x2c8d 0x50ad 0x9420 0x2d6d 0x528d 0x940f 0x2e42 0x546e 0x9406 0x2f3c 0x564e 0x93f8 0x3042 0x582e 0x93df 0x314d 0x5a0f 0x93cf 0x325b 0x5bef 0x93bf 0x338a 0x5dcf 0x93af 0x3484 0x5faf 0x939f 0x35bd 0x6190 0x9385 0x369a 0x6370 0x936b 0x373d 0x6550 0x9354 0x3755 0x6731 0x933e 0x383f 0x6911 0x931e 0x38ce 0x6af1 0x92fd 0x3961 0x6cd2 0x92dd 0x39a9 0x6eb2 0x92bd 0x3ac5 0x7092 0x9299 0x3b1e 0x7272 0x9269 0x3b46 0x7453 0x9239 0x3b87 0x7633 0x9209 0x3be5 0x7813 0x91d0 0x3c23 0x79f4 0x919a 0x3c96 0x7bd4 0x9164 0x3cd7 0x7db4 0x9124 0x3d1d 0x7f95 0x90f0 0x3d90 0x8175 0x90c0 0x3e30 0x8355 0x909e 0x3ee5 0x8536 0x907d 0x3fb1 0x8716 0x9057 0x4069 0x88f6 0x902e 0x4135 0x8ad6 0x8fe6 0x41d7 0x8cb7 0x8f67 0x4294 0x8e97 0x8e6c 0x431c 0x9077 0x8cb1 0x442a 0x9258 0x8a25 0x4682 0x9438 0x8658 0x49c1 0x9618 0x82f0 0x4989 0x97f9 0x82f0 0x4989 0x99d9 0x82f0 0x4989 0x9bb9 0x82f0 0x4989 0x9d99 0x82f0 0x4989 0x9f7a 0x82f0 0x4989 0xa15a 0x82f0 0x4989 0xa33a 0x82f0 0x4989 0xa51b 0x82f0 0x4989 0xa6fb 0x82f0 0x4989 0xa8db 0x82f0 0x4989 0xaabc 0x82f0 0x4989 0xac9c 0x82f0 0x4989 0xae7c 0x82f0 0x4989 0xb05c 0x82f0 0x4989 0xb23d 0x82f0 0x4989 0xb41d 0x82f0 0x4989 0xb5fd 0x82f0 0x4989 0xb7de 0x82f0 0x4989 0xb9be 0x82f0 0x4989>;
					battery0_profile_t4_col = <0x3>;
					battery0_profile_t4_num = <0x64>;
					battery0_profile_t5 = <0x0 0x9f6a 0x2cec 0x1e0 0x9da8 0x2e37 0x3c1 0x9cb4 0x30e9 0x5a1 0x9bec 0x3305 0x781 0x9b0d 0x3595 0x962 0x9a23 0x38c0 0xb42 0x9943 0x3bea 0xd22 0x9893 0x3e2c 0xf02 0x9801 0x3f1f 0x10e3 0x978f 0x3f56 0x12c3 0x972a 0x3f60 0x14a3 0x96da 0x3f48 0x1684 0x968c 0x3f2f 0x1864 0x964c 0x3f2f 0x1a44 0x961b 0x3f3a 0x1c25 0x95e0 0x3f2f 0x1e05 0x95b0 0x3f2f 0x1fe5 0x957f 0x3f53 0x21c5 0x9558 0x3f71 0x23a6 0x952e 0x3f6d 0x2586 0x950e 0x3f95 0x2766 0x94ee 0x3fce 0x2947 0x94d1 0x4028 0x2b27 0x94b8 0x4089 0x2d07 0x94a2 0x40ff 0x2ee8 0x948b 0x4194 0x30c8 0x9473 0x4234 0x32a8 0x9455 0x4306 0x3488 0x943f 0x43d4 0x3669 0x941f 0x4452 0x3849 0x93ff 0x450b 0x3a29 0x93d7 0x45d4 0x3c0a 0x93b5 0x4675 0x3dea 0x938b 0x4715 0x3fca 0x935b 0x47c3 0x41ab 0x932b 0x488b 0x438b 0x92f3 0x4940 0x456b 0x92b6 0x49f8 0x474c 0x927c 0x4ab5 0x492c 0x923c 0x4b3d 0x4b0c 0x91fc 0x4bf6 0x4cec 0x91bc 0x4c96 0x4ecd 0x917c 0x4d36 0x50ad 0x913c 0x4dbd 0x528d 0x910b 0x4e81 0x546e 0x90d1 0x4f1a 0x564e 0x90a1 0x4fba 0x582e 0x9058 0x504c 0x5a0f 0x9003 0x50e1 0x5bef 0x8f8c 0x5181 0x5dcf 0x8ed2 0x521b 0x5faf 0x8db8 0x52a8 0x6190 0x8bf8 0x5383 0x6370 0x894c 0x54f3 0x6550 0x8517 0x4ed1 0x6731 0x84b2 0x4dd5 0x6911 0x84b2 0x4dd5 0x6af1 0x84b2 0x4dd5 0x6cd2 0x84b2 0x4dd5 0x6eb2 0x84b2 0x4dd5 0x7092 0x84b2 0x4dd5 0x7272 0x84b2 0x4dd5 0x7453 0x84b2 0x4dd5 0x7633 0x84b2 0x4dd5 0x7813 0x84b2 0x4dd5 0x79f4 0x84b2 0x4dd5 0x7bd4 0x84b2 0x4dd5 0x7db4 0x84b2 0x4dd5 0x7f95 0x84b2 0x4dd5 0x8175 0x84b2 0x4dd5 0x8355 0x84b2 0x4dd5 0x8536 0x84b2 0x4dd5 0x8716 0x84b2 0x4dd5 0x88f6 0x84b2 0x4dd5 0x8ad6 0x84b2 0x4dd5 0x8cb7 0x84b2 0x4dd5 0x8e97 0x84b2 0x4dd5 0x9077 0x84b2 0x4dd5 0x9258 0x84b2 0x4dd5 0x9438 0x84b2 0x4dd5 0x9618 0x84b2 0x4dd5 0x97f9 0x84b2 0x4dd5 0x99d9 0x84b2 0x4dd5 0x9bb9 0x84b2 0x4dd5 0x9d99 0x84b2 0x4dd5 0x9f7a 0x84b2 0x4dd5 0xa15a 0x84b2 0x4dd5 0xa33a 0x84b2 0x4dd5 0xa51b 0x84b2 0x4dd5 0xa6fb 0x84b2 0x4dd5 0xa8db 0x84b2 0x4dd5 0xaabc 0x84b2 0x4dd5 0xac9c 0x84b2 0x4dd5 0xae7c 0x84b2 0x4dd5 0xb05c 0x84b2 0x4dd5 0xb23d 0x84b2 0x4dd5 0xb41d 0x84b2 0x4dd5 0xb5fd 0x84b2 0x4dd5 0xb7de 0x84b2 0x4dd5 0xb9be 0x84b2 0x4dd5>;
					battery0_profile_t5_col = <0x3>;
					battery0_profile_t5_num = <0x64>;
					battery1_profile_t0 = <0x0 0xa8d4 0x384 0x1e0 0xa844 0x384 0x3c1 0xa7b6 0x384 0x5a1 0xa736 0x384 0x781 0xa6c1 0x38f 0x962 0xa647 0x385 0xb42 0xa5d7 0x39d 0xd22 0xa55d 0x384 0xf02 0xa4ed 0x384 0x10e3 0xa481 0x38f 0x12c3 0xa40d 0x385 0x14a3 0xa3a5 0x39d 0x1684 0xa334 0x396 0x1864 0xa2cd 0x39a 0x1a44 0xa25e 0x39d 0x1c25 0xa1f8 0x39d 0x1e05 0xa188 0x39d 0x1fe5 0xa120 0x39d 0x21c5 0xa0b9 0x3b4 0x23a6 0xa04f 0x39d 0x2586 0x9fef 0x3b6 0x2766 0x9f88 0x3a4 0x2947 0x9f25 0x3b6 0x2b27 0x9ec5 0x3b6 0x2d07 0x9e68 0x3c4 0x2ee8 0x9e24 0x3ec 0x30c8 0x9dcd 0x3ee 0x32a8 0x9d45 0x3bf 0x3488 0x9cc5 0x3cf 0x3669 0x9c65 0x3dd 0x3849 0x9c31 0x3e8 0x3a29 0x9bf0 0x3d4 0x3c0a 0x9ba4 0x3d9 0x3dea 0x9b50 0x3cf 0x3fca 0x9b0a 0x3e8 0x41ab 0x9abc 0x3ed 0x438b 0x9a74 0x401 0x456b 0x9a27 0x401 0x474c 0x99dc 0x41b 0x492c 0x9996 0x433 0x4b0c 0x9946 0x433 0x4cec 0x98ee 0x433 0x4ecd 0x986c 0x3eb 0x50ad 0x97dd 0x3b6 0x528d 0x977c 0x3b6 0x546e 0x9728 0x39d 0x564e 0x96e1 0x39d 0x582e 0x96a6 0x39d 0x5a0f 0x966c 0x39d 0x5bef 0x963c 0x39d 0x5dcf 0x960b 0x39d 0x5faf 0x95d1 0x39d 0x6190 0x95aa 0x39d 0x6370 0x957c 0x39d 0x6550 0x9554 0x3af 0x6731 0x9528 0x3a5 0x6911 0x9508 0x3b6 0x6af1 0x94dd 0x3ab 0x6cd2 0x94bd 0x3b6 0x6eb2 0x9495 0x3a3 0x7092 0x9473 0x3a6 0x7272 0x9453 0x3b6 0x7453 0x943d 0x3cf 0x7633 0x941d 0x3cf 0x7813 0x93fc 0x3bb 0x79f4 0x93e6 0x3cf 0x7bd4 0x93d0 0x3e8 0x7db4 0x93b6 0x3de 0x7f95 0x939a 0x3e3 0x8175 0x9382 0x3e3 0x8355 0x934e 0x3bb 0x8536 0x9306 0x3b5 0x8716 0x92b2 0x38d 0x88f6 0x9281 0x3a3 0x8ad6 0x9261 0x3b6 0x8cb7 0x9233 0x3ab 0x8e97 0x920d 0x3b5 0x9077 0x91e3 0x3ae 0x9258 0x91bb 0x3a4 0x9438 0x919a 0x3a0 0x9618 0x9182 0x3b6 0x97f9 0x9158 0x39f 0x99d9 0x912b 0x3b6 0x9bb9 0x90f5 0x3b6 0x9d99 0x90b3 0x3b6 0x9f7a 0x907d 0x3b6 0xa15a 0x9046 0x3cc 0xa33a 0x8fef 0x3a4 0xa51b 0x8fbd 0x3a5 0xa6fb 0x8fad 0x3b6 0xa8db 0x8fa2 0x3aa 0xaabc 0x8f98 0x3d2 0xac9c 0x8f89 0x3e8 0xae7c 0x8f6f 0x401 0xb05c 0x8f2c 0x419 0xb23d 0x8e32 0x3f6 0xb41d 0x8c95 0x401 0xb5fd 0x8a7f 0x427 0xb7de 0x8783 0x43c 0xb9be 0x8304 0x47e>;
					battery1_profile_t0_col = <0x3>;
					battery1_profile_t0_num = <0x64>;
					battery1_profile_t1 = <0x0 0xa870 0x47e 0x1e0 0xa7d6 0x47e 0x3c1 0xa752 0x497 0x5a1 0xa6da 0x4ab 0x781 0xa667 0x4a5 0x962 0xa5f7 0x4b0 0xb42 0xa587 0x4b0 0xd22 0xa517 0x4b0 0xf02 0xa4a7 0x4b0 0x10e3 0xa43b 0x4a2 0x12c3 0xa3d1 0x498 0x14a3 0xa365 0x4b0 0x1684 0xa2fb 0x4b7 0x1864 0xa292 0x4b3 0x1a44 0xa22c 0x4c9 0x1c25 0xa1bd 0x4cb 0x1e05 0xa156 0x4d1 0x1fe5 0xa0ee 0x4da 0x21c5 0xa07e 0x4c9 0x23a6 0xa01d 0x4e2 0x2586 0x9fb4 0x4cf 0x2766 0x9f64 0x4fb 0x2947 0x9f2e 0x535 0x2b27 0x9f08 0x55d 0x2d07 0x9ebd 0x551 0x2ee8 0x9e35 0x529 0x30c8 0x9d6d 0x501 0x32a8 0x9cb2 0x4eb 0x3488 0x9c25 0x4fb 0x3669 0x9bba 0x4e2 0x3849 0x9b67 0x4e2 0x3a29 0x9b2e 0x50a 0x3c0a 0x9b02 0x51e 0x3dea 0x9aec 0x546 0x3fca 0x9ad0 0x550 0x41ab 0x9a94 0x532 0x438b 0x9a4c 0x532 0x456b 0x9a09 0x550 0x474c 0x99be 0x55f 0x492c 0x9978 0x55f 0x4b0c 0x991c 0x546 0x4cec 0x98b3 0x531 0x4ecd 0x9830 0x4f3 0x50ad 0x97b5 0x4b0 0x528d 0x9754 0x48f 0x546e 0x970a 0x490 0x564e 0x96c3 0x47e 0x582e 0x968d 0x48b 0x5a0f 0x9658 0x480 0x5bef 0x9621 0x475 0x5dcf 0x95f4 0x490 0x5faf 0x95c6 0x495 0x6190 0x9596 0x48a 0x6370 0x9570 0x494 0x6550 0x9548 0x490 0x6731 0x951e 0x47e 0x6911 0x94fe 0x495 0x6af1 0x94dd 0x497 0x6cd2 0x94bd 0x497 0x6eb2 0x949d 0x497 0x7092 0x947d 0x497 0x7272 0x945d 0x497 0x7453 0x9447 0x4b0 0x7633 0x9428 0x4b0 0x7813 0x9410 0x4b0 0x79f4 0x93f4 0x4a1 0x7bd4 0x93e4 0x4c9 0x7db4 0x93ca 0x4b0 0x7f95 0x93b0 0x4b0 0x8175 0x9398 0x49c 0x8355 0x9382 0x4b0 0x8536 0x9357 0x496 0x8716 0x932d 0x47e 0x88f6 0x930d 0x47e 0x8ad6 0x92ed 0x47e 0x8cb7 0x92cd 0x489 0x8e97 0x92a3 0x47e 0x9077 0x9283 0x48f 0x9258 0x9262 0x47e 0x9438 0x9242 0x47e 0x9618 0x9222 0x48a 0x97f9 0x91f8 0x499 0x99d9 0x91cb 0x49f 0x9bb9 0x918b 0x497 0x9d99 0x9153 0x4ae 0x9f7a 0x911d 0x4b0 0xa15a 0x90dc 0x4b0 0xa33a 0x9085 0x49e 0xa51b 0x9050 0x4b0 0xa6fb 0x9039 0x4b0 0xa8db 0x9033 0x4bc 0xaabc 0x9022 0x4c9 0xac9c 0x9012 0x4dc 0xae7c 0x8ffb 0x4fb 0xb05c 0x8fc2 0x513 0xb23d 0x8ee6 0x514 0xb41d 0x8d3f 0x51c 0xb5fd 0x8b21 0x57f 0xb7de 0x8825 0x5be 0xb9be 0x83c2 0x640>;
					battery1_profile_t1_col = <0x3>;
					battery1_profile_t1_num = <0x64>;
					battery1_profile_t2 = <0x0 0xa726 0x947 0x1e0 0xa678 0x974 0x3c1 0xa5f4 0x9c4 0x5a1 0xa57c 0x9ec 0x781 0xa4ff 0x9e8 0x962 0xa490 0x9f7 0xb42 0xa429 0xa0f 0xd22 0xa3bc 0xa15 0xf02 0xa353 0xa28 0x10e3 0xa2ed 0xa41 0x12c3 0xa287 0xa5a 0x14a3 0xa215 0xa5a 0x1684 0xa1a7 0xa48 0x1864 0xa13e 0xa70 0x1a44 0xa0d8 0xa73 0x1c25 0xa073 0xa73 0x1e05 0xa013 0xa62 0x1fe5 0x9fc3 0xa9a 0x21c5 0x9f8b 0xb16 0x23a6 0x9f5b 0xb60 0x2586 0x9f1d 0xb6d 0x2766 0x9eae 0xb5b 0x2947 0x9df3 0xad8 0x2b27 0x9d13 0xa60 0x2d07 0x9c61 0xa28 0x2ee8 0x9bde 0xa0f 0x30c8 0x9b7e 0xa0f 0x32a8 0x9b2f 0xa0f 0x3488 0x9aef 0xa26 0x3669 0x9abe 0xa4e 0x3849 0x9a8f 0xa5d 0x3a29 0x9a6f 0xa85 0x3c0a 0x9a4c 0xa8c 0x3dea 0x9a1b 0xa8c 0x3fca 0x99db 0xa8c 0x41ab 0x998e 0xa88 0x438b 0x992e 0xa60 0x456b 0x98c6 0xa25 0x474c 0x9846 0x9de 0x492c 0x97cc 0x984 0x4b0c 0x9769 0x960 0x4cec 0x9719 0x94d 0x4ecd 0x96db 0x950 0x50ad 0x96a1 0x960 0x528d 0x9666 0x947 0x546e 0x9634 0x947 0x564e 0x95fc 0x947 0x582e 0x95d6 0x956 0x5a0f 0x95a6 0x947 0x5bef 0x9576 0x947 0x5dcf 0x954f 0x960 0x5faf 0x9528 0x974 0x6190 0x9503 0x960 0x6370 0x94de 0x979 0x6550 0x94bd 0x979 0x6731 0x949d 0x979 0x6911 0x947d 0x979 0x6af1 0x945d 0x979 0x6cd2 0x9447 0x979 0x6eb2 0x942d 0x989 0x7092 0x9411 0x98b 0x7272 0x93f9 0x98f 0x7453 0x93e4 0x9ab 0x7633 0x93cf 0x9ab 0x7813 0x93bf 0x9bc 0x79f4 0x93af 0x9cb 0x7bd4 0x939f 0x9f4 0x7db4 0x938f 0xa03 0x7f95 0x937e 0xa41 0x8175 0x9365 0xa64 0x8355 0x9348 0xa94 0x8536 0x9328 0xabc 0x8716 0x9303 0xafd 0x88f6 0x92dd 0xb29 0x8ad6 0x92bd 0xb79 0x8cb7 0x929a 0xbb8 0x8e97 0x9273 0xbff 0x9077 0x9248 0xc35 0x9258 0x9212 0xc6e 0x9438 0x91d9 0xcc0 0x9618 0x919f 0xd10 0x97f9 0x9165 0xd48 0x99d9 0x9125 0xdb0 0x9bb9 0x90d9 0xe00 0x9d99 0x9091 0xe3d 0x9f7a 0x9070 0xeb4 0xa15a 0x9060 0xf3b 0xa33a 0x904a 0xfcc 0xa51b 0x9036 0x106c 0xa6fb 0x901e 0x114c 0xa8db 0x8fd9 0x122d 0xaabc 0x8f43 0x12da 0xac9c 0x8de1 0x1321 0xae7c 0x8bcd 0x147b 0xb05c 0x88fa 0x1670 0xb23d 0x8476 0x18ef 0xb41d 0x8282 0x19e1 0xb5fd 0x8282 0x19e1 0xb7de 0x8282 0x19e1 0xb9be 0x8282 0x19e1>;
					battery1_profile_t2_col = <0x3>;
					battery1_profile_t2_num = <0x64>;
					battery1_profile_t3 = <0x0 0xa532 0x1243 0x1e0 0xa456 0x12bb 0x3c1 0xa3c4 0x137e 0x5a1 0xa344 0x13e2 0x781 0xa2c8 0x140f 0x962 0xa24e 0x1437 0xb42 0xa1de 0x146e 0xd22 0xa16b 0x1482 0xf02 0xa0fc 0x1496 0x10e3 0xa08d 0x149b 0x12c3 0xa031 0x14ce 0x14a3 0x9fe6 0x152f 0x1684 0x9fa6 0x159b 0x1864 0x9f66 0x15c3 0x1a44 0x9f13 0x15d5 0x1c25 0x9e93 0x1578 0x1e05 0x9ddc 0x1500 0x1fe5 0x9d08 0x145c 0x21c5 0x9c59 0x140c 0x23a6 0x9bd0 0x13ec 0x2586 0x9b6b 0x1404 0x2766 0x9b11 0x13ec 0x2947 0x9ad0 0x1412 0x2b27 0x9a96 0x1437 0x2d07 0x9a5b 0x1443 0x2ee8 0x9a2b 0x1469 0x30c8 0x99fb 0x147a 0x32a8 0x99c1 0x1470 0x3488 0x9988 0x1482 0x3669 0x9943 0x1476 0x3849 0x98e7 0x1450 0x3a29 0x9889 0x142b 0x3c0a 0x9819 0x13e4 0x3dea 0x97a9 0x13a4 0x3fca 0x9743 0x136f 0x41ab 0x96f3 0x136c 0x438b 0x96ab 0x1356 0x456b 0x9669 0x1356 0x474c 0x9633 0x136e 0x492c 0x95f9 0x1364 0x4b0c 0x95c9 0x136f 0x4cec 0x9599 0x136f 0x4ecd 0x9573 0x1391 0x50ad 0x9543 0x13a1 0x528d 0x9518 0x13a1 0x546e 0x94f8 0x13bf 0x564e 0x94d0 0x13d3 0x582e 0x94ae 0x13ec 0x5a0f 0x948e 0x13ec 0x5bef 0x9468 0x1405 0x5dcf 0x944e 0x1423 0x5faf 0x942e 0x1437 0x6190 0x941b 0x145b 0x6370 0x940b 0x149e 0x6550 0x93fb 0x14ee 0x6731 0x93ee 0x154b 0x6911 0x93e5 0x15d5 0x6af1 0x93d5 0x1664 0x6cd2 0x93cf 0x1711 0x6eb2 0x93bf 0x179c 0x7092 0x93af 0x1855 0x7272 0x939f 0x190c 0x7453 0x938a 0x19bb 0x7633 0x9374 0x1a81 0x7813 0x935b 0x1b32 0x79f4 0x933d 0x1bdd 0x7bd4 0x9327 0x1c95 0x7db4 0x92fd 0x1d1d 0x7f95 0x92dc 0x1dba 0x8175 0x92b3 0x1e45 0x8355 0x9290 0x1ee5 0x8536 0x9260 0x1f6d 0x8716 0x922f 0x1ff5 0x88f6 0x91f5 0x207d 0x8ad6 0x91bd 0x211d 0x8cb7 0x917d 0x21be 0x8e97 0x913d 0x2245 0x9077 0x90fd 0x230c 0x9258 0x90bf 0x23d4 0x9438 0x9096 0x24c8 0x9618 0x9076 0x25b4 0x97f9 0x9060 0x26c8 0x99d9 0x9040 0x27e0 0x9bb9 0x901b 0x2935 0x9d99 0x8fcb 0x2a74 0x9f7a 0x8f3a 0x2bb4 0xa15a 0x8e2e 0x2cae 0xa33a 0x8c90 0x2e80 0xa51b 0x8a31 0x3174 0xa6fb 0x86a8 0x3572 0xa8db 0x82b4 0x3953 0xaabc 0x82b4 0x3953 0xac9c 0x82b4 0x3953 0xae7c 0x82b4 0x3953 0xb05c 0x82b4 0x3953 0xb23d 0x82b4 0x3953 0xb41d 0x82b4 0x3953 0xb5fd 0x82b4 0x3953 0xb7de 0x82b4 0x3953 0xb9be 0x82b4 0x3953>;
					battery1_profile_t3_col = <0x3>;
					battery1_profile_t3_num = <0x64>;
					battery1_profile_t4 = <0x0 0xa37a 0x23a5 0x1e0 0xa190 0x2568 0x3c1 0xa06c 0x28bf 0x5a1 0x9fd4 0x2a12 0x781 0x9f55 0x2a6d 0x962 0x9edb 0x2a60 0xb42 0x9e3e 0x29f0 0xd22 0x9d7f 0x2944 0xf02 0x9caf 0x2893 0x10e3 0x9c04 0x287c 0x12c3 0x9b75 0x2836 0x14a3 0x9b0d 0x27e1 0x1684 0x9ab6 0x2823 0x1864 0x9a6f 0x2865 0x1a44 0x9a20 0x283c 0x1c25 0x99d0 0x2870 0x1e05 0x9987 0x2865 0x1fe5 0x993b 0x2878 0x21c5 0x98f2 0x2868 0x23a6 0x98a2 0x2855 0x2586 0x9852 0x2839 0x2766 0x97fb 0x2823 0x2947 0x979b 0x27d0 0x2b27 0x973b 0x27a8 0x2d07 0x96e3 0x278a 0x2ee8 0x9690 0x275b 0x30c8 0x9648 0x2748 0x32a8 0x9610 0x2752 0x3488 0x95d0 0x272a 0x3669 0x959f 0x276c 0x3849 0x956f 0x2791 0x3a29 0x953e 0x27a6 0x3c0a 0x9512 0x270b 0x3dea 0x94f2 0x2774 0x3fca 0x94c8 0x27f1 0x41ab 0x94a8 0x2797 0x438b 0x9488 0x27fb 0x456b 0x9476 0x2866 0x474c 0x9466 0x290e 0x492c 0x945c 0x2a5e 0x4b0c 0x9450 0x2b16 0x4cec 0x9440 0x2bc9 0x4ecd 0x9430 0x2c8d 0x50ad 0x9420 0x2d6d 0x528d 0x940f 0x2e42 0x546e 0x9406 0x2f3c 0x564e 0x93f8 0x3042 0x582e 0x93df 0x314d 0x5a0f 0x93cf 0x325b 0x5bef 0x93bf 0x338a 0x5dcf 0x93af 0x3484 0x5faf 0x939f 0x35bd 0x6190 0x9385 0x369a 0x6370 0x936b 0x373d 0x6550 0x9354 0x3755 0x6731 0x933e 0x383f 0x6911 0x931e 0x38ce 0x6af1 0x92fd 0x3961 0x6cd2 0x92dd 0x39a9 0x6eb2 0x92bd 0x3ac5 0x7092 0x9299 0x3b1e 0x7272 0x9269 0x3b46 0x7453 0x9239 0x3b87 0x7633 0x9209 0x3be5 0x7813 0x91d0 0x3c23 0x79f4 0x919a 0x3c96 0x7bd4 0x9164 0x3cd7 0x7db4 0x9124 0x3d1d 0x7f95 0x90f0 0x3d90 0x8175 0x90c0 0x3e30 0x8355 0x909e 0x3ee5 0x8536 0x907d 0x3fb1 0x8716 0x9057 0x4069 0x88f6 0x902e 0x4135 0x8ad6 0x8fe6 0x41d7 0x8cb7 0x8f67 0x4294 0x8e97 0x8e6c 0x431c 0x9077 0x8cb1 0x442a 0x9258 0x8a25 0x4682 0x9438 0x8658 0x49c1 0x9618 0x82f0 0x4989 0x97f9 0x82f0 0x4989 0x99d9 0x82f0 0x4989 0x9bb9 0x82f0 0x4989 0x9d99 0x82f0 0x4989 0x9f7a 0x82f0 0x4989 0xa15a 0x82f0 0x4989 0xa33a 0x82f0 0x4989 0xa51b 0x82f0 0x4989 0xa6fb 0x82f0 0x4989 0xa8db 0x82f0 0x4989 0xaabc 0x82f0 0x4989 0xac9c 0x82f0 0x4989 0xae7c 0x82f0 0x4989 0xb05c 0x82f0 0x4989 0xb23d 0x82f0 0x4989 0xb41d 0x82f0 0x4989 0xb5fd 0x82f0 0x4989 0xb7de 0x82f0 0x4989 0xb9be 0x82f0 0x4989>;
					battery1_profile_t4_col = <0x3>;
					battery1_profile_t4_num = <0x64>;
					battery1_profile_t5 = <0x0 0x9f6a 0x2cec 0x1e0 0x9da8 0x2e37 0x3c1 0x9cb4 0x30e9 0x5a1 0x9bec 0x3305 0x781 0x9b0d 0x3595 0x962 0x9a23 0x38c0 0xb42 0x9943 0x3bea 0xd22 0x9893 0x3e2c 0xf02 0x9801 0x3f1f 0x10e3 0x978f 0x3f56 0x12c3 0x972a 0x3f60 0x14a3 0x96da 0x3f48 0x1684 0x968c 0x3f2f 0x1864 0x964c 0x3f2f 0x1a44 0x961b 0x3f3a 0x1c25 0x95e0 0x3f2f 0x1e05 0x95b0 0x3f2f 0x1fe5 0x957f 0x3f53 0x21c5 0x9558 0x3f71 0x23a6 0x952e 0x3f6d 0x2586 0x950e 0x3f95 0x2766 0x94ee 0x3fce 0x2947 0x94d1 0x4028 0x2b27 0x94b8 0x4089 0x2d07 0x94a2 0x40ff 0x2ee8 0x948b 0x4194 0x30c8 0x9473 0x4234 0x32a8 0x9455 0x4306 0x3488 0x943f 0x43d4 0x3669 0x941f 0x4452 0x3849 0x93ff 0x450b 0x3a29 0x93d7 0x45d4 0x3c0a 0x93b5 0x4675 0x3dea 0x938b 0x4715 0x3fca 0x935b 0x47c3 0x41ab 0x932b 0x488b 0x438b 0x92f3 0x4940 0x456b 0x92b6 0x49f8 0x474c 0x927c 0x4ab5 0x492c 0x923c 0x4b3d 0x4b0c 0x91fc 0x4bf6 0x4cec 0x91bc 0x4c96 0x4ecd 0x917c 0x4d36 0x50ad 0x913c 0x4dbd 0x528d 0x910b 0x4e81 0x546e 0x90d1 0x4f1a 0x564e 0x90a1 0x4fba 0x582e 0x9058 0x504c 0x5a0f 0x9003 0x50e1 0x5bef 0x8f8c 0x5181 0x5dcf 0x8ed2 0x521b 0x5faf 0x8db8 0x52a8 0x6190 0x8bf8 0x5383 0x6370 0x894c 0x54f3 0x6550 0x8517 0x4ed1 0x6731 0x84b2 0x4dd5 0x6911 0x84b2 0x4dd5 0x6af1 0x84b2 0x4dd5 0x6cd2 0x84b2 0x4dd5 0x6eb2 0x84b2 0x4dd5 0x7092 0x84b2 0x4dd5 0x7272 0x84b2 0x4dd5 0x7453 0x84b2 0x4dd5 0x7633 0x84b2 0x4dd5 0x7813 0x84b2 0x4dd5 0x79f4 0x84b2 0x4dd5 0x7bd4 0x84b2 0x4dd5 0x7db4 0x84b2 0x4dd5 0x7f95 0x84b2 0x4dd5 0x8175 0x84b2 0x4dd5 0x8355 0x84b2 0x4dd5 0x8536 0x84b2 0x4dd5 0x8716 0x84b2 0x4dd5 0x88f6 0x84b2 0x4dd5 0x8ad6 0x84b2 0x4dd5 0x8cb7 0x84b2 0x4dd5 0x8e97 0x84b2 0x4dd5 0x9077 0x84b2 0x4dd5 0x9258 0x84b2 0x4dd5 0x9438 0x84b2 0x4dd5 0x9618 0x84b2 0x4dd5 0x97f9 0x84b2 0x4dd5 0x99d9 0x84b2 0x4dd5 0x9bb9 0x84b2 0x4dd5 0x9d99 0x84b2 0x4dd5 0x9f7a 0x84b2 0x4dd5 0xa15a 0x84b2 0x4dd5 0xa33a 0x84b2 0x4dd5 0xa51b 0x84b2 0x4dd5 0xa6fb 0x84b2 0x4dd5 0xa8db 0x84b2 0x4dd5 0xaabc 0x84b2 0x4dd5 0xac9c 0x84b2 0x4dd5 0xae7c 0x84b2 0x4dd5 0xb05c 0x84b2 0x4dd5 0xb23d 0x84b2 0x4dd5 0xb41d 0x84b2 0x4dd5 0xb5fd 0x84b2 0x4dd5 0xb7de 0x84b2 0x4dd5 0xb9be 0x84b2 0x4dd5>;
					battery1_profile_t5_col = <0x3>;
					battery1_profile_t5_num = <0x64>;
					compatible = "mediatek,bat_gm30";
					enable_tmp_intr_suspend = <0x0>;
					g_FG_PSEUDO100 = <0x5d 0x5d 0x64 0x64 0x5d 0x5d 0x64 0x64 0x5d 0x5d 0x64 0x64 0x5d 0x5d 0x64 0x64 0x5d 0x5d 0x64 0x64 0x5d 0x5d 0x64 0x64 0x5d 0x5d 0x64 0x64 0x64 0x64 0x64 0x64 0x64 0x64 0x64 0x64 0x64 0x64 0x64 0x64>;
					g_FG_PSEUDO100_T0 = <0x64>;
					g_FG_PSEUDO100_T1 = <0x64>;
					g_FG_PSEUDO100_T2 = <0x64>;
					g_FG_PSEUDO100_T3 = <0x64>;
					g_FG_PSEUDO100_T4 = <0x64>;
					g_FG_PSEUDO100_T5 = <0x64>;
					g_FG_PSEUDO100_col = <0xa>;
					g_FG_PSEUDO100_row = <0x4>;
					g_PMIC_MIN_VOL = <0x7fbc 0x7fbc 0x7fbc 0x7fbc 0x7fbc 0x7fbc 0x7fbc 0x7fbc 0x7fbc 0x7fbc 0x7fbc 0x7fbc 0x7dc8 0x7dc8 0x7dc8 0x7dc8 0x7918 0x7918 0x7918 0x7918 0x7b0c 0x7b0c 0x7b0c 0x7b0c 0x7918 0x7918 0x7918 0x7918 0x7918 0x7918 0x7918 0x7918 0x7918 0x7918 0x7918 0x7918 0x7918 0x7918 0x7918 0x79e0>;
					g_PMIC_MIN_VOL_col = <0xa>;
					g_PMIC_MIN_VOL_row = <0x4>;
					g_PON_SYS_IBOOT = <0x1388 0x1388 0x1388 0x1388 0x1388 0x1388 0x1388 0x1388 0x1388 0x1388 0x1388 0x1388 0x1388 0x1388 0x1388 0x1388 0x1388 0x1388 0x1388 0x1388 0x1388 0x1388 0x1388 0x1388 0x1388 0x1388 0x1388 0x1388 0x1388 0x1388 0x1388 0x1388 0x1388 0x1388 0x1388 0x1388 0x1388 0x1388 0x1388 0x1388>;
					g_PON_SYS_IBOOT_col = <0xa>;
					g_PON_SYS_IBOOT_row = <0x4>;
					g_QMAX_SYS_VOL = <0x8340 0x8340 0x8340 0x8340 0x8340 0x8340 0x8340 0x8340 0x8340 0x8340 0x8340 0x8340 0x8340 0x8340 0x8340 0x8340 0x8340 0x8340 0x8340 0x8340 0x7ef4 0x7ef4 0x7ef4 0x7ef4 0x8020 0x8020 0x8020 0x8020 0x8020 0x8020 0x8020 0x8020 0x8020 0x8020 0x8020 0x8020 0x8020 0x8020 0x8020 0x8020>;
					g_QMAX_SYS_VOL_col = <0xa>;
					g_QMAX_SYS_VOL_row = <0x4>;
					phandle = <0x95>;
					rbat_battery_temperature = <0xffffffd8 0x43183f 0xffffffdd 0x2f20d6 0xffffffe2 0x2186e9 0xffffffe7 0x182338 0xffffffec 0x11903c 0xfffffff1 0xceaf2 0xfffffff6 0x998fc 0xfffffffb 0x73250 0x0 0x57293 0x5 0x42873 0xa 0x3332d 0xf 0x27b5a 0x14 0x1f068 0x19 0x186a0 0x1e 0x13575 0x23 0xf6bf 0x28 0xc5f4 0x2d 0x9fc7 0x32 0x81aa 0x37 0x69d2 0x3c 0x56d0>;
					rbat_temperature_table_num = <0x15>;
				};

				sec_abc {
					compatible = "samsung,sec_abc";
					status = "okay";

					aicl {
						aicl,label = "battery aicl";
						aicl,threshold_count = <0x5>;
						aicl,threshold_time = <0x12c>;
					};

					gpu {
						gpu,label = "GPU fault";
						gpu,threshold_count = <0x14>;
						gpu,threshold_time = <0x4b0>;
					};
				};

				sec_thermistor@0 {
					adc_array = <0x6c 0x7c 0xb1 0xd1 0xfe 0x134 0x175 0x1ba 0x20d 0x24e 0x28c 0x2f6 0x357 0x390 0x444 0x526 0x614 0x720 0x789 0x852 0x913 0x99a 0xaeb 0xc10 0xcf8>;
					compatible = "samsung,sec-thermistor";
					id = <0x0>;
					io-channel-names = "ap_therm";
					io-channel-ranges;
					io-channels = <0xffffffff 0x0>;
					phandle = <0x99>;
					status = "okay";
					temp_array = <0x352 0x320 0x2bc 0x28a 0x258 0x226 0x1f4 0x1c2 0x190 0x172 0x15e 0x12c 0x10e 0xfa 0xc8 0x96 0x64 0x32 0x1e 0x0 0xffffffe2 0xffffffce 0xffffff9c 0xffffff6a 0xffffff38>;
					thermistor_name = "sec-ap-thermistor";
					use_iio_processed;
				};

				sec_thermistor@1 {
					adc_array = <0x18a 0x1db 0x28c 0x2f6 0x380 0x41a 0x4ca 0x57a 0x640 0x6d0 0x752 0x829 0x8d4 0x934 0xa49 0xb76 0xc82 0xd85 0xde6 0xe80 0xf0d 0xf64>;
					compatible = "samsung,sec-thermistor";
					id = <0x1>;
					io-channel-names = "pa_therm";
					io-channel-ranges;
					io-channels = <0xffffffff 0x1>;
					phandle = <0x98>;
					status = "okay";
					temp_array = <0x352 0x320 0x2bc 0x28a 0x258 0x226 0x1f4 0x1c2 0x190 0x172 0x15e 0x12c 0x10e 0xfa 0xc8 0x96 0x64 0x32 0x1e 0x0 0xffffffe2 0xffffffce>;
					thermistor_name = "sec-pa-thermistor";
					use_iio_processed;
				};

				sec_thermistor@2 {
					adc_array = <0x17e 0x1db 0x28c 0x2f5 0x37f 0x419 0x4c8 0x57a 0x63b 0x6cd 0x74c 0x824 0x8cf 0x930 0xa45 0xb72 0xc7f 0xd80 0xdde 0xe7e 0xf09 0xf63>;
					compatible = "samsung,sec-thermistor";
					id = <0x2>;
					io-channel-names = "cp_therm";
					io-channel-ranges;
					io-channels = <0xffffffff 0x2>;
					phandle = <0x97>;
					status = "okay";
					temp_array = <0x352 0x320 0x2bc 0x28a 0x258 0x226 0x1f4 0x1c2 0x190 0x172 0x15e 0x12c 0x10e 0xfa 0xc8 0x96 0x64 0x32 0x1e 0x0 0xffffffe2 0xffffffce>;
					thermistor_name = "sec-cp-thermistor";
					use_iio_processed;
				};

				sec_thermistor@3 {
					adc_array = <0x189 0x1db 0x28a 0x2f6 0x375 0x41a 0x4ca 0x577 0x63d 0x6cc 0x749 0x81a 0x8bf 0x925 0xa3b 0xb45 0xc72 0xd76 0xde6 0xe77 0xefd 0xf60>;
					compatible = "samsung,sec-thermistor";
					id = <0x3>;
					io-channel-names = "wf_therm";
					io-channel-ranges;
					io-channels = <0xffffffff 0x4>;
					phandle = <0x96>;
					status = "okay";
					temp_array = <0x352 0x320 0x2bc 0x28a 0x258 0x226 0x1f4 0x1c2 0x190 0x172 0x15e 0x12c 0x10e 0xfa 0xc8 0x96 0x64 0x32 0x1e 0x0 0xffffffe2 0xffffffce>;
					thermistor_name = "sec-wf-thermistor";
					use_iio_processed;
				};

				vibrator_info {
					compatible = "samsung,vib-info";
					functions = [00];
					phandle = <0x93>;
					samsung,haptic_intensities;
					samsung,intensities;
					status = "okay";
				};
			};
		};
	};
};
